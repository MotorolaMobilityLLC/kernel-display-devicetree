/* This is derivated from qcom cliffs-sde-display-mtp-overlay.dts */

/dts-v1/;
/plugin/;

#include "cliffs-sde-display-ctwo-common.dtsi"

/ {
	model = "ctwo";
	compatible = "qcom,cliffs-mtp", "qcom,cliffs", "qcom,mtp";
	qcom,msm-id = <614 0x10000>, <632 0x10000>;
	qcom,board-id = <0x41 0x9300>, <0x41 0xB100>, <0x41 0xB1B0>;
};
