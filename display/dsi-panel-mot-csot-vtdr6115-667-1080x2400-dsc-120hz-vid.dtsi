/* Copyright (c) 2019-2021, The Linux Foundation. All rights reserved.
 *
 * This program is free software; you can redistribute it and/or modify
 * it under the terms of the GNU General Public License version 2 and
 * only version 2 as published by the Free Software Foundation.
 *
 * This program is distributed in the hope that it will be useful,
 * but WITHOUT ANY WARRANTY; without even the implied warranty of
 * MERCHANTABILITY or FITNESS FOR A PARTICULAR PURPOSE.  See the
 * GNU General Public License for more details.
 */
&mdss_mdp {
	mot_csot_vtdr6115_667_1080x2400_dsc_120hz_vid: qcom,mdss_dsi_mot_csot_vtdr6115_667_1080x2400_dsc_120hz_vid {
		qcom,mdss-dsi-panel-name = "mipi_mot_vid_csot_667_1080p_dsc_120hz";
		qcom,mdss-dsi-panel-supplier = "csot";
		qcom,mdss-dsi-panel-type = "dsi_video_mode";
		qcom,mdss-dsi-panel-physical-type = "oled";
		qcom,dsi-ctrl-num = <0>;
		qcom,dsi-phy-num = <0>;
		qcom,mdss-dsi-virtual-channel-id = <0>;
		qcom,mdss-dsi-stream = <0>;
		qcom,mdss-pan-physical-width-dimension = <69>;
		qcom,mdss-pan-physical-height-dimension = <155>;
		qcom,mdss-dsi-bpp = <30>;
		qcom,mdss-dsi-underflow-color = <0xff>;
		qcom,mdss-dsi-border-color = <0>;

		qcom,mdss-dsi-traffic-mode = "non_burst_sync_event";
		qcom,mdss-dsi-bllp-eof-power-mode;
		qcom,mdss-dsi-bllp-power-mode;
		qcom,mdss-dsi-lp11-init;
		qcom,mdss-dsi-lane-0-state;
		qcom,mdss-dsi-lane-1-state;
		qcom,mdss-dsi-lane-2-state;
		qcom,mdss-dsi-lane-3-state;
		qcom,mdss-dsi-dma-trigger = "trigger_sw";
		qcom,mdss-dsi-mdp-trigger = "none";
		qcom,mdss-dsi-reset-sequence = <1 2>, <0 5>, <1 20>;

		qcom,mdss-dsi-dc-off-command = [
				39 01 00 00 00 00 02 5E 00];
		qcom,mdss-dsi-dc-off-command-state = "dsi_hs_mode";
		qcom,mdss-dsi-dc-on-command = [
				39 01 00 00 00 00 02 5E 01];
		qcom,mdss-dsi-dc-on-command-state = "dsi_hs_mode";


		qcom,mdss-dsi-hbm-detect-fps;
		qcom,mdss-dsi-hbm-on-command = [
				39 00 00 40 00 00 02 62 00
				39 00 00 40 00 00 03 51 0F FF
				39 00 00 40 00 00 03 F0 AA 13
				39 01 00 00 00 00 02 C6 00];
		qcom,mdss-dsi-hbm-off-command = [
				39 00 00 40 00 00 02 62 00
				39 00 00 40 00 00 03 51 0D BA
				39 00 00 40 00 00 03 F0 AA 13
				39 01 00 00 00 00 02 C6 00];

		qcom,mdss-dsi-hbm-fod;
		qcom,mdss-dsi-hbm-fod-on-command = [
				39 00 00 40 00 00 03 F0 AA 13
				39 00 00 40 00 00 02 C6 01
				39 00 00 40 00 00 03 63 03 FF
				39 00 00 40 00 00 03 51 05 2A
				39 01 00 00 00 00 02 62 03];

		qcom,mdss-dsi-panel-lhbm-wait-fps-valid;
		qcom,mdss-dsi-panel-local-hbm-wait-fps-count = <30>;
		qcom,mdss-dsi-panel-local-hbm-wait-fps-interval = <1>;
		qcom,mdss-dsi-panel-lhbm-not-allowed-fps-list = <60 90>;

		qcom,mdss-dsi-panel-local-hbm-enabled;
		qcom,mdss-dsi-panel-local-hbm-DC-HYBIRD-THRESHOLD-BL = <1322>; //0x052a
		qcom,mdss-dsi-panel-local-hbm-alpha-register = <0x63>;
		qcom,mdss-dsi-panel-local-hbm-alpha-size = <4096>;
		qcom,mdss-dsi-panel-local-hbm-alpha-table = <
				0   221	221 221 221 221 221 222 222 225 225 225 225 225 225 225
				226 226 226 226 226 226 226 229 229 229 229 229 230 230 230 230
				230 231 231 231 231 233 233 233 233 234 234 234 234 234 234 235
				235 235 235 235 238 238 238 239 239 239 239 239 239 239 239 239
				240 240 242 243 243 243 243 243 244 244 244 244 244 244 245 245
				247 247 247 248 248 248 248 248 248 248 249 249 249 249 249 252
				252 252 252 253 253 253 253 253 253 253 254 254 254 256 257 257
				257 257 257 258 258 258 258 258 258 258 258 261 261 261 262 262
				261 262 262 262 262 263 263 263 263 263 266 266 266 266 266 267
				267 267 267 267 267 267 268 268 271 271 271 271 271 271 271 272
				272 272 272 272 272 273 275 276 276 276 276 276 276 276 276 277
				277 277 277 277 277 280 281 281 281 281 281 281 282 282 282 282
				282 282 282 285 285 285 285 286 286 286 286 286 286 287 287 287
				287 289 289 290 290 290 290 291 290 291 291 291 291 292 292 292
				294 294 295 295 295 295 295 296 296 296 296 296 296 297 299 299
				299 300 300 300 300 301 301 301 301 301 302 302 304 304 304 305
				305 305 305 305 306 306 306 306 306 306 307 309 309 309 310 310
				310 310 310 310 310 311 311 311 311 314 314 314 314 314 314 315
				315 315 315 316 316 316 316 318 319 319 319 319 319 320 320 320
				320 320 321 321 321 321 324 324 324 324 324 324 325 325 325 326
				326 326 326 326 328 328 329 329 329 329 329 330 330 330 330 330
				331 331 333 334 334 334 334 334 334 335 335 335 337 337 338 338
				340 340 341 341 341 343 343 344 344 346 346 347 347 347 349 350
				350 350 352 353 353 353 353 355 355 355 356 358 358 358 359 361
				361 361 361 362 364 364 364 365 367 367 367 367 368 370 370 370
				370 372 372 373 373 373 376 376 376 376 378 379 379 379 379 382
				382 382 382 384 384 384 384 384 387 387 387 387 390 390 390 390
				391 393 393 393 393 395 395 395 396 398 398 398 399 399 401 401
				402 402 404 404 404 404 404 407 407 408 408 410 410 410 410 410
				412 413 413 413 415 416 416 416 416 419 419 419 419 421 421 421
				421 422 424 424 424 425 427 427 427 428 428 430 430 430 430 432
				432 433 433 435 435 436 436 436 438 438 438 438 440 440 441 441
				441 443 444 444 444 446 446 446 447 447 449 449 449 449 452 452
				452 452 453 455 455 455 455 457 457 458 458 460 460 460 461 462
				462 464 465 465 466 467 467 468 468 469 470 470 470 472 473 473
				475 475 475 476 476 477 479 479 479 481 481 481 483 484 484 485
				485 485 488 488 490 490 490 492 492 492 494 494 494 496 496 497
				499 499 499 501 501 501 503 503 503 505 505 505 507 508 508 509
				510 510 511 512 512 514 514 514 515 516 516 518 518 518 519 520
				520 522 522 522 524 524 524 526 526 528 528 528 530 530 530 532
				532 532 534 534 534 536 536 536 539 538 538 540 541 541 542 542
				542 544 545 545 546 546 546 548 548 549 551 551 551 552 552 553
				555 554 554 556 556 556 558 558 558 560 560 560 561 562 564 564
				564 566 566 566 568 568 568 570 570 570 572 572 572 573 573 574
				575 576 576 578 578 578 579 580 580 581 581 582 584 584 585 586
				586 587 588 588 588 590 590 590 592 592 592 594 594 594 596 596
				596 598 599 600 600 600 602 602 602 604 605 605 606 606 606 608
				608 608 610 610 610 611 612 612 613 614 614 615 615 615 617 617
				618 619 619 619 621 621 621 623 623 623 626 626 627 627 629 629
				630 631 631 633 633 634 635 636 636 637 638 639 639 641 640 642
				644 644 645 645 647 647 648 648 649 649 651 651 653 654 654 655
				656 657 657 658 658 660 660 661 661 663 664 665 666 667 668 668
				670 670 671 671 672 672 674 674 676 678 678 679 679 681 681 682
				682 683 683 684 684 686 686 687 689 689 691 691 692 692 693 693
				695 695 697 696 697 699 699 700 700 702 702 704 704 705 705 707
				707 708 708 709 710 711 711 711 714 714 715 715 716 717 718 718
				719 720 720 722 722 723 723 725 725 727 727 728 728 729 729 730
				731 731 733 733 734 734 735 735 737 737 739 739 740 741 741 742
				743 744 744 745 745 746 746 748 748 749 750 751 752 752 753 754
				755 755 756 757 757 757 759 760 761 762 762 763 763 764 764 765
				765 767 767 768 768 769 769 771 772 772 773 773 775 775 777 777
				777 777 778 779 780 781 781 783 784 785 785 786 786 787 787 788
				788 790 790 791 792 792 794 794 795 795 796 796 797 797 798 798
				800 801 801 802 802 803 804 805 805 807 807 808 808 809 809 810
				811 811 813 813 814 814 815 815 816 816 817 817 819 819 820 820
				821 822 822 823 823 825 825 826 826 828 828 829 830 830 831 831
				832 832 833 833 835 835 836 836 837 838 838 840 840 841 841 842
				842 843 843 845 845 847 847 848 850 850 850 851 852 852 852 852
				853 853 855 856 857 858 858 859 859 860 860 861 861 863 864 864
				866 866 866 866 868 870 870 871 871 872 872 873 873 874 876 877
				877 877 878 879 879 880 882 882 883 883 883 884 885 886 887 888
				889 889 890 890 891 891 892 894 894 896 896 896 897 897 899 899
				901 901 901 901 902 903 904 904 905 906 906 907 907 908 910 910
				911 912 913 914 914 914 915 916 916 918 918 919 919 920 921 922
				923 923 925 925 926 926 927 928 928 929 930 932 932 933 933 934
				935 935 936 937 939 939 939 941 941 942 942 944 944 945 945 945
				947 947 948 948 950 950 951 952 952 953 953 954 955 956 956 957
				958 958 959 960 960 961 963 963 963 964 965 965 965 968 968 968
				969 970 971 971 972 972 974 974 975 976 977 977 977 978 980 980
				981 981 983 983 983 984 984 986 987 987 988 989 989 990 990 992
				992 992 993 993 994 994 995 995 997 998 999 1000 1000 1001 1001 1001
				1002 1003 1005 1005 1005 1006 1006 1006 1008 1010 1011 1012 1012 1012 1012 1013
				1013 1015 1016 1016 1017 1018 1018 1019 1020 1021 1023 1023 1023 1023 1023 1023
				1023 1023 1023 1023 1023 1023 1023 1023 1023 1023 1023 1023 1023 1023 1023 1023
				1023 1023 1023 1023 1023 1023 1023 1023 1023 1023 1023 1023 1023 1023 1023 1023
				1023 1023 1023 1023 1023 1023 1023 1023 1023 1023 1023 1023 1023 1023 1023 1023
				1023 1023 1023 1023 1023 1023 1023 1023 1023 1023 1023 1023 1023 1023 1023 1023
				1023 1023 1023 1023 1023 1023 1023 1023 1023 1023 1023 1023 1023 1023 1023 1023
				1023 1023 1023 1023 1023 1023 1023 1023 1023 1023 1023 1023 1023 1023 1023 1023
				1023 1023 1023 1023 1023 1023 1023 1023 1023 1023 1023 1023 1023 1023 1023 1023
				1023 1023 1023 1023 1023 1023 1023 1023 1023 1023 1023 1023 1023 1023 1023 1023
				1023 1023 1023 1023 1023 1023 1023 1023 1023 1023 1023 1023 1023 1023 1023 1023
				1023 1023 1023 1023 1023 1023 1023 1023 1023 1023 1023 1023 1023 1023 1023 1023
				1023 1023 1023 1023 1023 1023 1023 1023 1023 1023 1023 1023 1023 1023 1023 1023
				1023 1023 1023 1023 1023 1023 1023 1023 1023 1023 1023 1023 1023 1023 1023 1023
				1023 1023 1023 1023 1023 1023 1023 1023 1023 1023 1023 1023 1023 1023 1023 1023
				1023 1023 1023 1023 1023 1023 1023 1023 1023 1023 1023 1023 1023 1023 1023 1023
				1023 1023 1023 1023 1023 1023 1023 1023 1023 1023 1023 1023 1023 1023 1023 1023
				1023 1023 1023 1023 1023 1023 1023 1023 1023 1023 1023 1023 1023 1023 1023 1023
				1023 1023 1023 1023 1023 1023 1023 1023 1023 1023 1023 1023 1023 1023 1023 1023
				1023 1023 1023 1023 1023 1023 1023 1023 1023 1023 1023 1023 1023 1023 1023 1023
				1023 1023 1023 1023 1023 1023 1023 1023 1023 1023 1023 1023 1023 1023 1023 1023
				1023 1023 1023 1023 1023 1023 1023 1023 1023 1023 1023 1023 1023 1023 1023 1023
				1023 1023 1023 1023 1023 1023 1023 1023 1023 1023 1023 1023 1023 1023 1023 1023
				1023 1023 1023 1023 1023 1023 1023 1023 1023 1023 1023 1023 1023 1023 1023 1023
				1023 1023 1023 1023 1023 1023 1023 1023 1023 1023 1023 1023 1023 1023 1023 1023
				1023 1023 1023 1023 1023 1023 1023 1023 1023 1023 1023 1023 1023 1023 1023 1023
				1023 1023 1023 1023 1023 1023 1023 1023 1023 1023 1023 1023 1023 1023 1023 1023
				1023 1023 1023 1023 1023 1023 1023 1023 1023 1023 1023 1023 1023 1023 1023 1023
				1023 1023 1023 1023 1023 1023 1023 1023 1023 1023 1023 1023 1023 1023 1023 1023
				1023 1023 1023 1023 1023 1023 1023 1023 1023 1023 1023 1023 1023 1023 1023 1023
				1023 1023 1023 1023 1023 1023 1023 1023 1023 1023 1023 1023 1023 1023 1023 1023
				1023 1023 1023 1023 1023 1023 1023 1023 1023 1023 1023 1023 1023 1023 1023 1023
				1023 1023 1023 1023 1023 1023 1023 1023 1023 1023 1023 1023 1023 1023 1023 1023
				1023 1023 1023 1023 1023 1023 1023 1023 1023 1023 1023 1023 1023 1023 1023 1023
				1023 1023 1023 1023 1023 1023 1023 1023 1023 1023 1023 1023 1023 1023 1023 1023
				1023 1023 1023 1023 1023 1023 1023 1023 1023 1023 1023 1023 1023 1023 1023 1023
				1023 1023 1023 1023 1023 1023 1023 1023 1023 1023 1023 1023 1023 1023 1023 1023
				1023 1023 1023 1023 1023 1023 1023 1023 1023 1023 1023 1023 1023 1023 1023 1023
				1023 1023 1023 1023 1023 1023 1023 1023 1023 1023 1023 1023 1023 1023 1023 1023
				1023 1023 1023 1023 1023 1023 1023 1023 1023 1023 1023 1023 1023 1023 1023 1023
				1023 1023 1023 1023 1023 1023 1023 1023 1023 1023 1023 1023 1023 1023 1023 1023
				1023 1023 1023 1023 1023 1023 1023 1023 1023 1023 1023 1023 1023 1023 1023 1023
				1023 1023 1023 1023 1023 1023 1023 1023 1023 1023 1023 1023 1023 1023 1023 1023
				1023 1023 1023 1023 1023 1023 1023 1023 1023 1023 1023 1023 1023 1023 1023 1023
				1023 1023 1023 1023 1023 1023 1023 1023 1023 1023 1023 1023 1023 1023 1023 1023
				1023 1023 1023 1023 1023 1023 1023 1023 1023 1023 1023 1023 1023 1023 1023 1023
				1023 1023 1023 1023 1023 1023 1023 1023 1023 1023 1023 1023 1023 1023 1023 1023
				1023 1023 1023 1023 1023 1023 1023 1023 1023 1023 1023 1023 1023 1023 1023 1023
				1023 1023 1023 1023 1023 1023 1023 1023 1023 1023 1023 1023 1023 1023 1023 1023
				1023 1023 1023 1023 1023 1023 1023 1023 1023 1023 1023 1023 1023 1023 1023 1023
				1023 1023 1023 1023 1023 1023 1023 1023 1023 1023 1023 1023 1023 1023 1023 1023
				1023 1023 1023 1023 1023 1023 1023 1023 1023 1023 1023 1023 1023 1023 1023 1023
				1023 1023 1023 1023 1023 1023 1023 1023 1023 1023 1023 1023 1023 1023 1023 1023
				1023 1023 1023 1023 1023 1023 1023 1023 1023 1023 1023 1023 1023 1023 1023 1023
				1023 1023 1023 1023 1023 1023 1023 1023 1023 1023 1023 1023 1023 1023 1023 1023
				1023 1023 1023 1023 1023 1023 1023 1023 1023 1023 1023 1023 1023 1023 1023 1023
				1023 1023 1023 1023 1023 1023 1023 1023 1023 1023 1023 1023 1023 1023 1023 1023
				1023 1023 1023 1023 1023 1023 1023 1023 1023 1023 1023 1023 1023 1023 1023 1023
				1023 1023 1023 1023 1023 1023 1023 1023 1023 1023 1023 1023 1023 1023 1023 1023
				1023 1023 1023 1023 1023 1023 1023 1023 1023 1023 1023 1023 1023 1023 1023 1023
				1023 1023 1023 1023 1023 1023 1023 1023 1023 1023 1023 1023 1023 1023 1023 1023
				1023 1023 1023 1023 1023 1023 1023 1023 1023 1023 1023 1023 1023 1023 1023 1023
				1023 1023 1023 1023 1023 1023 1023 1023 1023 1023 1023 1023 1023 1023 1023 1023
				1023 1023 1023 1023 1023 1023 1023 1023 1023 1023 1023 1023 1023 1023 1023 1023
				1023 1023 1023 1023 1023 1023 1023 1023 1023 1023 1023 1023 1023 1023 1023 1023
				1023 1023 1023 1023 1023 1023 1023 1023 1023 1023 1023 1023 1023 1023 1023 1023
				1023 1023 1023 1023 1023 1023 1023 1023 1023 1023 1023 1023 1023 1023 1023 1023
				1023 1023 1023 1023 1023 1023 1023 1023 1023 1023 1023 1023 1023 1023 1023 1023
				1023 1023 1023 1023 1023 1023 1023 1023 1023 1023 1023 1023 1023 1023 1023 1023
				1023 1023 1023 1023 1023 1023 1023 1023 1023 1023 1023 1023 1023 1023 1023 1023
				1023 1023 1023 1023 1023 1023 1023 1023 1023 1023 1023 1023 1023 1023 1023 1023
				1023 1023 1023 1023 1023 1023 1023 1023 1023 1023 1023 1023 1023 1023 1023 1023
				1023 1023 1023 1023 1023 1023 1023 1023 1023 1023 1023 1023 1023 1023 1023 1023
				1023 1023 1023 1023 1023 1023 1023 1023 1023 1023 1023 1023 1023 1023 1023 1023
				1023 1023 1023 1023 1023 1023 1023 1023 1023 1023 1023 1023 1023 1023 1023 1023
				1023 1023 1023 1023 1023 1023 1023 1023 1023 1023 1023 1023 1023 1023 1023 1023
				1023 1023 1023 1023 1023 1023 1023 1023 1023 1023 1023 1023 1023 1023 1023 1023
				1023 1023 1023 1023 1023 1023 1023 1023 1023 1023 1023 1023 1023 1023 1023 1023
				1023 1023 1023 1023 1023 1023 1023 1023 1023 1023 1023 1023 1023 1023 1023 1023
				1023 1023 1023 1023 1023 1023 1023 1023 1023 1023 1023 1023 1023 1023 1023 1023
				1023 1023 1023 1023 1023 1023 1023 1023 1023 1023 1023 1023 1023 1023 1023 1023
				1023 1023 1023 1023 1023 1023 1023 1023 1023 1023 1023 1023 1023 1023 1023 1023
				1023 1023 1023 1023 1023 1023 1023 1023 1023 1023 1023 1023 1023 1023 1023 1023
				1023 1023 1023 1023 1023 1023 1023 1023 1023 1023 1023 1023 1023 1023 1023 1023
				1023 1023 1023 1023 1023 1023 1023 1023 1023 1023 1023 1023 1023 1023 1023 1023
				1023 1023 1023 1023 1023 1023 1023 1023 1023 1023 1023 1023 1023 1023 1023 1023
				1023 1023 1023 1023 1023 1023 1023 1023 1023 1023 1023 1023 1023 1023 1023 1023
				1023 1023 1023 1023 1023 1023 1023 1023 1023 1023 1023 1023 1023 1023 1023 1023
				1023 1023 1023 1023 1023 1023 1023 1023 1023 1023 1023 1023 1023 1023 1023 1023
				1023 1023 1023 1023 1023 1023 1023 1023 1023 1023 1023 1023 1023 1023 1023 1023
				1023 1023 1023 1023 1023 1023 1023 1023 1023 1023 1023 1023 1023 1023 1023 1023
				1023 1023 1023 1023 1023 1023 1023 1023 1023 1023 1023 1023 1023 1023 1023 1023
				1023 1023 1023 1023 1023 1023 1023 1023 1023 1023 1023 1023 1023 1023 1023 1023
				1023 1023 1023 1023 1023 1023 1023 1023 1023 1023 1023 1023 1023 1023 1023 1023
				1023 1023 1023 1023 1023 1023 1023 1023 1023 1023 1023 1023 1023 1023 1023 1023
				1023 1023 1023 1023 1023 1023 1023 1023 1023 1023 1023 1023 1023 1023 1023 1023
				1023 1023 1023 1023 1023 1023 1023 1023 1023 1023 1023 1023 1023 1023 1023 1023
				1023 1023 1023 1023 1023 1023 1023 1023 1023 1023 1023 1023 1023 1023 1023 1023
				1023 1023 1023 1023 1023 1023 1023 1023 1023 1023 1023 1023 1023 1023 1023 1023
				1023 1023 1023 1023 1023 1023 1023 1023 1023 1023 1023 1023 1023 1023 1023 1023
				1023 1023 1023 1023 1023 1023 1023 1023 1023 1023 1023 1023 1023 1023 1023 1023
				1023 1023 1023 1023 1023 1023 1023 1023 1023 1023 1023 1023 1023 1023 1023 1023
				1023 1023 1023 1023 1023 1023 1023 1023 1023 1023 1023 1023 1023 1023 1023 1023
				1023 1023 1023 1023 1023 1023 1023 1023 1023 1023 1023 1023 1023 1023 1023 1023
				1023 1023 1023 1023 1023 1023 1023 1023 1023 1023 1023 1023 1023 1023 1023 1023
				1023 1023 1023 1023 1023 1023 1023 1023 1023 1023 1023 1023 1023 1023 1023 1023
				1023 1023 1023 1023 1023 1023 1023 1023 1023 1023 1023 1023 1023 1023 1023 1023
				1023 1023 1023 1023 1023 1023 1023 1023 1023 1023 1023 1023 1023 1023 1023 1023
				1023 1023 1023 1023 1023 1023 1023 1023 1023 1023 1023 1023 1023 1023 1023 1023
				1023 1023 1023 1023 1023 1023 1023 1023 1023 1023 1023 1023 1023 1023 1023 1023
				1023 1023 1023 1023 1023 1023 1023 1023 1023 1023 1023 1023 1023 1023 1023 1023
				1023 1023 1023 1023 1023 1023 1023 1023 1023 1023 1023 1023 1023 1023 1023 1023
				1023 1023 1023 1023 1023 1023 1023 1023 1023 1023 1023 1023 1023 1023 1023 1023
				1023 1023 1023 1023 1023 1023 1023 1023 1023 1023 1023 1023 1023 1023 1023 1023
				1023 1023 1023 1023 1023 1023 1023 1023 1023 1023 1023 1023 1023 1023 1023 1023
				1023 1023 1023 1023 1023 1023 1023 1023 1023 1023 1023 1023 1023 1023 1023 1023
				1023 1023 1023 1023 1023 1023 1023 1023 1023 1023 1023 1023 1023 1023 1023 1023
				1023 1023 1023 1023 1023 1023 1023 1023 1023 1023 1023 1023 1023 1023 1023 1023
				1023 1023 1023 1023 1023 1023 1023 1023 1023 1023 1023 1023 1023 1023 1023 1023
				1023 1023 1023 1023 1023 1023 1023 1023 1023 1023 1023 1023 1023 1023 1023 1023
				1023 1023 1023 1023 1023 1023 1023 1023 1023 1023 1023 1023 1023 1023 1023 1023
				1023 1023 1023 1023 1023 1023 1023 1023 1023 1023 1023 1023 1023 1023 1023 1023
				1023 1023 1023 1023 1023 1023 1023 1023 1023 1023 1023 1023 1023 1023 1023 1023
				1023 1023 1023 1023 1023 1023 1023 1023 1023 1023 1023 1023 1023 1023 1023 1023
				1023 1023 1023 1023 1023 1023 1023 1023 1023 1023 1023 1023 1023 1023 1023 1023
				1023 1023 1023 1023 1023 1023 1023 1023 1023 1023 1023 1023 1023 1023 1023 1023
				1023 1023 1023 1023 1023 1023 1023 1023 1023 1023 1023 1023 1023 1023 1023 1023
				1023 1023 1023 1023 1023 1023 1023 1023 1023 1023 1023 1023 1023 1023 1023 1023
				1023 1023 1023 1023 1023 1023 1023 1023 1023 1023 1023 1023 1023 1023 1023 1023
				1023 1023 1023 1023 1023 1023 1023 1023 1023 1023 1023 1023 1023 1023 1023 1023
				1023 1023 1023 1023 1023 1023 1023 1023 1023 1023 1023 1023 1023 1023 1023 1023
				1023 1023 1023 1023 1023 1023 1023 1023 1023 1023 1023 1023 1023 1023 1023 1023
				1023 1023 1023 1023 1023 1023 1023 1023 1023 1023 1023 1023 1023 1023 1023 1023
				1023 1023 1023 1023 1023 1023 1023 1023 1023 1023 1023 1023 1023 1023 1023 1023
				1023 1023 1023 1023 1023 1023 1023 1023 1023 1023 1023 1023 1023 1023 1023 1023
				1023 1023 1023 1023 1023 1023 1023 1023 1023 1023 1023 1023 1023 1023 1023 1023
				1023 1023 1023 1023 1023 1023 1023 1023 1023 1023 1023 1023 1023 1023 1023 1023
				1023 1023 1023 1023 1023 1023 1023 1023 1023 1023 1023 1023 1023 1023 1023 1023
				1023 1023 1023 1023 1023 1023 1023 1023 1023 1023 1023 1023 1023 1023 1023 1023
				1023 1023 1023 1023 1023 1023 1023 1023 1023 1023 1023 1023 1023 1023 1023 1023
				1023 1023 1023 1023 1023 1023 1023 1023 1023 1023 1023 1023 1023 1023 1023 1023
				1023 1023 1023 1023 1023 1023 1023 1023 1023 1023 1023 1023 1023 1023 1023 1023
				1023 1023 1023 1023 1023 1023 1023 1023 1023 1023 1023 1023 1023 1023 1023 1023
				1023 1023 1023 1023 1023 1023 1023 1023 1023 1023 1023 1023 1023 1023 1023 1023
				1023 1023 1023 1023 1023 1023 1023 1023 1023 1023 1023 1023 1023 1023 1023 1023
				1023 1023 1023 1023 1023 1023 1023 1023 1023 1023 1023 1023 1023 1023 1023 1023
				1023 1023 1023 1023 1023 1023 1023 1023 1023 1023 1023 1023 1023 1023 1023 1023
				1023 1023 1023 1023 1023 1023 1023 1023 1023 1023 1023 1023 1023 1023 1023 1023
				1023 1023 1023 1023 1023 1023 1023 1023 1023 1023 1023 1023 1023 1023 1023 1023
				1023 1023 1023 1023 1023 1023 1023 1023 1023 1023 1023 1023 1023 1023 1023 1023
				1023 1023 1023 1023 1023 1023 1023 1023 1023 1023 1023 1023 1023 1023 1023 1023
				1023 1023 1023 1023 1023 1023 1023 1023 1023 1023 1023 1023 1023 1023 1023 1023
				1023 1023 1023 1023 1023 1023 1023 1023 1023 1023 1023 1023 1023 1023 1023 1023
				1023 1023 1023 1023 1023 1023 1023 1023 1023 1023 1023 1023 1023 1023 1023 1023
				1023 1023 1023 1023 1023 1023 1023 1023 1023 1023 1023 1023 1023 1023 1023 1023
				1023 1023 1023 1023 1023 1023 1023 1023 1023 1023 1023 1023 1023 1023 1023 1023
				1023 1023 1023 1023 1023 1023 1023 1023 1023 1023 1023 1023 1023 1023 1023 1023
				1023 1023 1023 1023 1023 1023 1023 1023 1023 1023 1023 1023 1023 1023 1023 1023
				1023 1023 1023 1023 1023 1023 1023 1023 1023 1023 1023 1023 1023 1023 1023 1023
				1023 1023 1023 1023 1023 1023 1023 1023 1023 1023 1023 1023 1023 1023 1023 1023
				1023 1023 1023 1023 1023 1023 1023 1023 1023 1023 1023 1023 1023 1023 1023 1023
				1023 1023 1023 1023 1023 1023 1023 1023 1023 1023 1023 1023 1023 1023 1023 1023
				1023 1023 1023 1023 1023 1023 1023 1023 1023 1023 1023 1023 1023 1023 1023 1023
				1023 1023 1023 1023 1023 1023 1023 1023 1023 1023 1023 1023 1023 1023 1023 1023
				1023 1023 1023 1023 1023 1023 1023 1023 1023 1023 1023 1023 1023 1023 1023 1023
				1023 1023 1023 1023 1023 1023 1023 1023 1023 1023 1023 1023 1023 1023 1023 1023
				1023 1023 1023 1023 1023 1023 1023 1023 1023 1023 1023 1023 1023 1023 1023 1023
				1023 1023 1023 1023 1023 1023 1023 1023 1023 1023 1023 1023 1023 1023 1023 1023
				1023 1023 1023 1023 1023 1023 1023 1023 1023 1023 1023 1023 1023 1023 1023 1023
				1023 1023 1023 1023 1023 1023 1023 1023 1023 1023 1023 1023 1023 1023 1023 1023
				1023 1023 1023 1023 1023 1023 1023 1023 1023 1023 1023 1023 1023 1023 1023 1023
				1023 1023 1023 1023 1023 1023 1023 1023 1023 1023 1023 1023 1023 1023 1023 1023
				1023 1023 1023 1023 1023 1023 1023 1023 1023 1023 1023 1023 1023 1023 1023 1023
				1023 1023 1023 1023 1023 1023 1023 1023 1023 1023 1023 1023 1023 1023 1023 1023
				1023 1023 1023 1023 1023 1023 1023 1023 1023 1023 1023 1023 1023 1023 1023 1023>;

		qcom,mdss-dsi-display-timings {
			timing@0 {
				cell-index = <0>;
				qcom,mdss-dsi-panel-framerate = <120>;
				qcom,mdss-dsi-panel-width = <1080>;
				qcom,mdss-dsi-panel-height = <2400>;
				qcom,mdss-dsi-h-front-porch = <22>;
				qcom,mdss-dsi-h-back-porch = <20>;
				qcom,mdss-dsi-h-pulse-width = <10>;
				qcom,mdss-dsi-h-sync-skew = <0>;
				qcom,mdss-dsi-v-back-porch = <8>;
				qcom,mdss-dsi-v-front-porch = <516>;
				qcom,mdss-dsi-v-pulse-width = <4>;
				qcom,mdss-dsi-h-left-border = <0>;
				qcom,mdss-dsi-h-right-border = <0>;
				qcom,mdss-dsi-v-top-border = <0>;
				qcom,mdss-dsi-v-bottom-border = <0>;

				qcom,mdss-dsi-on-command = [
						39 01 00 00 00 00 03 F0 AA 10
						39 01 00 00 00 00 17 D0 84 15 50 14 20 00 39 0B 1D 19 16 00 0B 2F 19 00 00 1B 05 05 1D 1D

						39 01 00 00 00 00 03 F0 AA 13
						39 01 00 00 00 00 07 C5 02 C2 02 A2 03 5D

						39 01 00 00 00 00 02 03 01
						39 01 00 00 00 00 02 53 20
						39 01 00 00 00 00 03 51 00 00
						39 01 00 00 00 00 02 6F 01
						39 01 00 00 00 00 02 35 00
						39 01 00 00 00 00 02 59 09
						39 01 00 00 00 00 02 6C 01
						39 01 00 00 00 00 02 62 00

						39 01 00 00 00 00 5F 70 11 00 00 AB 30 80 09 60 04 38 00 0C 02 1C 02 1C 02 00 02 0E 00 20 01 1F 00 07 00 0C 08 BB 08 7A 18 00 10 F0 07 10 20 00 06 0F 0F 33 0E 1C 2A 38 46 54 62 69 70 77 79 7B 7D 7E 02 02 22 00 2A 40 2A BE 3A FC 3A FA 3A F8 3B 38 3B 78 3B B6 4B B6 4B F4 4B F4 6C 34 84 74 00 00 00 00 00 00

						39 01 00 00 00 00 03 F0 AA 12
						39 01 00 00 00 00 02 65 10
						39 01 00 00 00 00 02 D9 41

						39 01 00 00 00 00 03 FF 5A 80
						39 01 00 00 00 00 02 65 0A
						39 01 00 00 00 00 02 F9 A8
						39 01 00 00 00 00 02 65 0E
						39 01 00 00 00 00 02 F9 B9

						39 01 00 00 00 00 03 FF 5A 81
						39 01 00 00 00 00 02 65 03
						39 01 00 00 00 00 02 F4 03
						39 01 00 00 00 00 02 65 08
						39 01 00 00 00 00 03 F6 51 44

						05 01 00 00 50 00 01 11

						39 01 00 00 00 00 03 F0 AA 12
						39 01 00 00 00 00 02 65 10
						39 01 00 00 00 00 02 D9 0B

						39 01 00 00 00 00 03 FF 5A 81
						39 01 00 00 00 00 02 F3 08

						39 01 00 00 00 00 03 FF 5A 00
						39 01 00 00 00 00 03 F0 AA 00

						05 01 00 00 00 00 01 29
				];

				qcom,mdss-dsi-off-command = [
						05 01 00 00 00 00 01 28
						05 01 00 00 78 00 01 10];
				qcom,mdss-dsi-on-command-state = "dsi_lp_mode";
				qcom,mdss-dsi-off-command-state = "dsi_lp_mode";
				qcom,mdss-dsi-h-sync-pulse = <0>;
				qcom,compression-mode = "dsc";
				qcom,mdss-dsc-slice-height = <12>;
				qcom,mdss-dsc-slice-width = <540>;
				qcom,mdss-dsc-slice-per-pkt = <2>;
				qcom,mdss-dsc-bit-per-component = <10>;
				qcom,mdss-dsc-bit-per-pixel = <8>;
				qcom,mdss-dsc-block-prediction-enable;

				qcom,mdss-dsi-dfps-60-command = [
						39 00 00 40 00 00 02 6C 00
						39 01 00 00 00 00 02 62 00];
				qcom,mdss-dsi-dfps-60-command-state = "dsi_hs_mode";

				qcom,mdss-dsi-dfps-90-command = [
						39 00 00 40 00 00 02 6C 01
						39 00 00 40 00 00 02 62 01
						39 00 00 40 00 00 03 F0 AA 10
						39 01 00 00 00 00 0E B1 01 57 00 0C 0D 74 00 01 57 00 0C 05 D4];
				qcom,mdss-dsi-dfps-90-command-state = "dsi_hs_mode";

				qcom,mdss-dsi-dfps-120-command = [
						39 00 00 40 00 00 02 6C 01
						39 00 00 40 00 00 02 62 00
						39 00 00 40 00 00 03 F0 AA 10
						39 01 00 00 00 00 0E B1 01 57 00 0C 0D 74 00 01 57 00 0C 02 04];
				qcom,mdss-dsi-dfps-120-command-state = "dsi_hs_mode";

			};
		};
	};
};
