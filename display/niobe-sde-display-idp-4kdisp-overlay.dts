/dts-v1/;
/plugin/;

#include "niobe-sde-display-idp-4kdisp.dtsi"

/ {
	model = "Qualcomm Technologies, Inc. Niobe IDP";
	compatible = "qcom,niobe-idp", "qcom,niobe", "qcom,idp";
	qcom,msm-id = <652 0x10000>;
	qcom,board-id = <0x10022 0>;
};
