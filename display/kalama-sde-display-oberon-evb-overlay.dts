/* Copyright (c) 2022, The Linux Foundation. All rights reserved.
 *
 * This program is free software; you can redistribute it and/or modify
 * it under the terms of the GNU General Public License version 2 and
 * only version 2 as published by the Free Software Foundation.
 *
 * This program is distributed in the hope that it will be useful,
 * but WITHOUT ANY WARRANTY; without even the implied warranty of
 * MERCHANTABILITY or FITNESS FOR A PARTICULAR PURPOSE.  See the
 * GNU General Public License for more details.
 */

/* This is derivated from qcom kalama-sde-display-mtp-overlay.dts */

/dts-v1/;
/plugin/;

#include "kalama-sde-display-oberon-common.dtsi"

/ {
	model = "oberon";
	compatible = "qcom,kalama-mtp", "qcom,kalama", "qcom,mtp", "mot,oberon";
	qcom,msm-id = <519 0x10000>, <536 0x10000>, <519 0x20000>, <536 0x20000>;
	qcom,board-id = <0x47 0x9000>;
};

&qupv3_se4_i2c {
	goodix_ts_i2c@5d {
		panel = <&mot_tianma_nt37701A_667_1080x2400_dsc_cmd>;
	};
};
