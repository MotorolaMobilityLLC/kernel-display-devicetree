&mdss_mdp {
	dsi_nt36528_csot_hd_video: qcom,mdss_dsi_nt36528_csot_hd_video {
		qcom,mdss-dsi-panel-name =
			"mipi_mot_vid_csot_nt36528_hd_720_1600";
		qcom,mdss-dsi-panel-type = "dsi_video_mode";
		qcom,dsi-ctrl-num = <0>;
		qcom,dsi-phy-num = <0>;
		//qcom,mdss-dsi-panel-mode-switch;
		qcom,mdss-dsi-virtual-channel-id = <0>;
		qcom,mdss-dsi-stream = <0>;
		qcom,mdss-dsi-bpp = <24>;
		qcom,mdss-dsi-color-order = "rgb_swap_rgb";
		qcom,mdss-dsi-underflow-color = <0xff>;
		qcom,mdss-dsi-border-color = <0>;
		qcom,mdss-dsi-traffic-mode = "non_burst_sync_event";
		qcom,mdss-dsi-lane-map = "lane_map_0123";
		qcom,mdss-dsi-bllp-eof-power-mode;
		qcom,mdss-dsi-bllp-power-mode;
		qcom,mdss-dsi-tx-eot-append;
		qcom,mdss-dsi-lane-0-state;
		qcom,mdss-dsi-lane-1-state;
		qcom,mdss-dsi-lane-2-state;
		qcom,mdss-dsi-lane-3-state;
		qcom,mdss-dsi-dma-trigger = "trigger_sw";
		qcom,mdss-dsi-mdp-trigger = "none";
		qcom,mdss-dsi-lp11-init;
		qcom,bklt-dcs-2bytes-enabled;
		qcom,mdss-dsi-bl-pmic-control-type = "bl_ctrl_dcs";
		qcom,mdss-dsi-reset-sequence = <0 5>, <1 5>, <0 5>, <1 10>;
		qcom,mdss-pan-physical-width-dimension = <70>;
		qcom,mdss-pan-physical-height-dimension = <156>;
		//qcom,mdss-dsi-te-pin-select = <1>;
		//qcom,mdss-dsi-te-dcs-command = <1>;
		//qcom,mdss-dsi-te-check-enable;
		//qcom,mdss-dsi-te-using-te-pin;
		qcom,mdss-dsi-cabc-mv-command = [15 01 00 00 00 00 02 55 03];
		qcom,mdss-dsi-cabc-mv-command-state =  "dsi_hs_mode";
		qcom,mdss-dsi-cabc-ui-command = [15 01 00 00 00 00 02 55 01];
		qcom,mdss-dsi-cabc-ui-command-state =  "dsi_hs_mode";
		qcom,mdss-dsi-cabc-dis-command = [15 01 00 00 00 00 02 55 00];
		qcom,mdss-dsi-cabc-dis-command-state =  "dsi_hs_mode";
		qcom,mdss-dsi-display-timings {
			timing@0 {
				qcom,mdss-dsi-video-mode;
				qcom,mdss-dsi-panel-width = <720>;
				qcom,mdss-dsi-panel-height = <1600>;
				qcom,mdss-dsi-h-front-porch = <80>;
				qcom,mdss-dsi-h-back-porch = <140>;
				qcom,mdss-dsi-h-pulse-width = <20>;
				qcom,mdss-dsi-h-sync-skew = <0>;
				qcom,mdss-dsi-v-back-porch = <18>;
				qcom,mdss-dsi-v-front-porch = <1232>;
				qcom,mdss-dsi-v-pulse-width = <1>;
				qcom,mdss-dsi-panel-framerate = <60>;
				qcom,mdss-dsi-on-command = [
					39 01 00 00 00 00 02 FF 23
					39 01 00 00 00 00 02 FB 01
					39 01 00 00 00 00 02 00 60
					39 01 00 00 00 00 02 07 00
					39 01 00 00 00 00 02 08 01
					39 01 00 00 00 00 02 09 AE
					39 01 00 00 00 00 02 10 7F
					39 01 00 00 00 00 02 11 00
					39 01 00 00 00 00 02 12 B4
					39 01 00 00 00 00 02 15 E9
					39 01 00 00 00 00 02 16 14
					39 01 00 00 00 00 02 29 10
					39 01 00 00 00 00 02 2A 20
					39 01 00 00 00 00 02 2B 20
					39 01 00 00 00 00 02 30 FF
					39 01 00 00 00 00 02 31 FF
					39 01 00 00 00 00 02 32 FF
					39 01 00 00 00 00 02 33 F8
					39 01 00 00 00 00 02 34 F0
					39 01 00 00 00 00 02 35 ED
					39 01 00 00 00 00 02 36 E9
					39 01 00 00 00 00 02 37 E6
					39 01 00 00 00 00 02 38 E2
					39 01 00 00 00 00 02 39 DE
					39 01 00 00 00 00 02 3A DA
					39 01 00 00 00 00 02 3B D6
					39 01 00 00 00 00 02 3D D2
					39 01 00 00 00 00 02 3F CE
					39 01 00 00 00 00 02 40 CA
					39 01 00 00 00 00 02 41 C6
					39 01 00 00 00 00 02 58 FF
					39 01 00 00 00 00 02 59 FC
					39 01 00 00 00 00 02 5A F6
					39 01 00 00 00 00 02 5B E7
					39 01 00 00 00 00 02 5C D9
					39 01 00 00 00 00 02 5D D1
					39 01 00 00 00 00 02 5E C8
					39 01 00 00 00 00 02 5F BF
					39 01 00 00 00 00 02 60 BB
					39 01 00 00 00 00 02 61 B7
					39 01 00 00 00 00 02 62 B3
					39 01 00 00 00 00 02 63 AF
					39 01 00 00 00 00 02 64 AB
					39 01 00 00 00 00 02 65 A7
					39 01 00 00 00 00 02 66 A3
					39 01 00 00 00 00 02 67 9F
					39 01 00 00 00 00 02 FF 10
					39 01 00 00 00 00 02 FB 01
					39 01 00 00 00 00 02 35 00
					39 01 00 00 00 00 03 51 00 00
					39 01 00 00 00 00 02 53 2C
					39 01 00 00 00 00 02 55 01
					39 01 00 00 00 00 03 68 02 01
					39 01 00 00 64 00 02 11 00
					39 01 00 00 14 00 02 29 00
				];
				qcom,mdss-dsi-off-command = [
					39 01 00 00 0A 00 02 28 00
					39 01 00 00 78 00 02 10 00
				];
				qcom,mdss-dsi-on-command-state = "dsi_lp_mode";
				qcom,mdss-dsi-off-command-state = "dsi_lp_mode";
			};
		};
	};
};
