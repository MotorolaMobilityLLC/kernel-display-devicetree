/* Copyright (c) 2025-2026, The Linux Foundation. All rights reserved.
 *
 * This program is free software; you can redistribute it and/or modify
 * it under the terms of the GNU General Public License version 2 and
 * only version 2 as published by the Free Software Foundation.
 *
 * This program is distributed in the hope that it will be useful,
 * but WITHOUT ANY WARRANTY; without even the implied warranty of
 * MERCHANTABILITY or FITNESS FOR A PARTICULAR PURPOSE.  See the
 * GNU General Public License for more details.
 */
&mdss_mdp {
mot_boe_ili97701A_682_1440x3168_dsc_cmd_v0: qcom,mdss_dsi_mot_boe_ili97701A_682_1440x3168_dsc_cmd_v0 {
compatible = "qcom,mdss-dsi-panel";
qcom,mdss-dsi-panel-name = "mipi_mot_cmd_boe_1440p_dsc_682";
qcom,mdss-dsi-panel-supplier = "boe";
qcom,mdss-dsi-panel-type = "dsi_cmd_mode";
qcom,mdss-dsi-virtual-channel-id = <0>;
qcom,mdss-dsi-stream = <0>;
qcom,mdss-pan-physical-width-dimension = <72>;
qcom,mdss-pan-physical-height-dimension = <157>;
qcom,mdss-dsi-bpp = <30>;
qcom,mdss-dsi-underflow-color = <0xff>;
qcom,mdss-dsi-border-color = <0>;

qcom,mdss-dsi-traffic-mode = "burst_mode";
qcom,mdss-dsi-bllp-eof-power-mode;
qcom,mdss-dsi-bllp-power-mode;
qcom,mdss-dsi-lane-0-state;
qcom,mdss-dsi-lane-1-state;
qcom,mdss-dsi-lane-2-state;
qcom,mdss-dsi-lane-3-state;

qcom,mdss-dsi-dma-trigger = "trigger_sw";
qcom,mdss-dsi-mdp-trigger = "none";
qcom,mdss-dsi-reset-sequence = <0 3>, <1 1>, <0 1>, <1 20>;
qcom,mdss-dsi-lp11-init;
qcom,mdss-dsi-tx-eot-append;
qcom,mdss-dsi-te-pin-select = <1>;
qcom,mdss-dsi-te-dcs-command = <1>;
qcom,mdss-dsi-te-using-te-pin;

//qcom,bklt-dcs-2bytes-enabled;
qcom,mdss-dsi-bl-min-level = <4>;
qcom,mdss-dsi-bl-max-level = <14056>;
qcom,mdss-dsi-bl-pmic-control-type = "bl_ctrl_dcs";

qcom,mdss-dsi-panel-hdr-enabled;
qcom,mdss-dsi-panel-hdr-color-primaries = <14500 15500 32000
	        17000 15500 30000 8000 3000>;
qcom,mdss-dsi-panel-peak-brightness = <4200000>;

qcom,mdss-dsi-panel-blackness-level = <3230>;

qcom,check_pcd;
qcom,pcd-reg-read-enabled;
qcom,pcd-reg-check-before-read;
qcom,mdss-dsi-panel-pcd-reg-read-length = <1>;
qcom,mdss-dsi-panel-pcd-reg-mask = <0xFF>;
qcom,mdss-dsi-panel-pcd-reg-command = [
		06 01 00 01 00 00 01 C5];
qcom,mdss-dsi-panel-pcd-reg-pass-min = <0x0>;
qcom,mdss-dsi-panel-pcd-reg-pass-max = <0x29>;
qcom,mdss-dsi-panel-pcd-reg-read-delay-ms = <0>; //150ms delay before read pcd reg per IC req
qcom,mdss-dsi-panel-pcd-reg-seq-interval = <30>; //30 seq interval per screen on times
qcom,mdss-dsi-panel-pcd-check-time-interval-in-minutes = <480>; //480 minutes check time interval for pcd reg read

qcom,mdss-dsi-dc-off-command = [
			39 00 00 40 00 00 04 FF 5A A5 4F
			39 00 00 40 00 00 02 81 0C
			39 00 00 40 00 00 02 82 7F
			39 00 00 40 00 00 04 FF 5A A5 08
			39 00 00 40 00 00 02 98 02
			39 00 00 40 00 00 04 FF 5A A5 4F
			39 00 00 40 00 00 02 88 78
			39 00 00 40 00 00 04 FF 5A A5 24
			39 00 00 40 00 00 05 91 01 27 34 56
			39 00 00 40 00 00 04 FF 5A A5 24
			39 00 00 40 00 00 02 9D 0E
			39 00 00 40 00 00 02 9E 11
			39 00 00 40 00 00 04 FF 5A A5 23
			39 00 00 40 00 00 02 80 50
			39 00 00 40 00 00 04 FF 5A A5 53
			39 00 00 40 00 00 03 85 CC E1
			39 00 00 40 00 00 02 86 3D
			39 00 00 40 00 00 03 95 60 66
			39 00 00 40 00 00 04 FF 5A A5 51
			39 00 00 40 00 00 06 A1 AC AC AC AC 22
			39 00 00 40 00 00 02 FE 22
			39 00 00 40 00 00 06 A2 AC A5 A5 A5 22
			39 00 00 40 00 00 02 FE 22
			39 00 00 40 00 00 06 A3 A5 98 98 98 22
			39 00 00 40 00 00 02 FE 22
			39 00 00 40 00 00 04 FF 5A A5 52
			39 00 00 40 00 00 06 81 E2 94 77 77 00
			39 00 00 40 00 00 02 FE 00
			39 00 00 40 00 00 06 82 77 76 76 76 00
			39 00 00 40 00 00 02 FE 00
			39 00 00 40 00 00 06 83 76 6E 6E 6E 00
			39 00 00 40 00 00 02 FE 00
			39 00 00 40 00 00 04 FF 5A A5 4F
			39 00 00 40 00 00 02 81 04
			39 00 00 40 00 00 04 FF 5A A5 08
			39 00 00 40 00 00 02 98 A6
			39 00 00 40 00 00 04 FF 5A A5 00
			39 00 00 40 00 00 02 00 00
			39 00 00 40 00 00 04 FF 5A A5 4F
			39 00 00 40 00 00 02 8B 78
			39 00 00 00 00 00 04 FF 5A A5 00
		];

qcom,mdss-dsi-dc-off-command-state = "dsi_hs_mode";
qcom,mdss-dsi-dc-on-command = [
			39 00 00 40 00 00 04 FF 5A A5 4F
			39 00 00 40 00 00 02 81 0C
			39 00 00 40 00 00 02 82 7F
			39 00 00 40 00 00 04 FF 5A A5 08
			39 00 00 40 00 00 02 98 02
			39 00 00 40 00 00 04 FF 5A A5 4F
			39 00 00 40 00 00 02 88 78
			39 00 00 40 00 00 04 FF 5A A5 24
			39 00 00 40 00 00 05 91 11 77 44 66
			39 00 00 40 00 00 04 FF 5A A5 24
			39 00 00 40 00 00 02 9D 8E
			39 00 00 40 00 00 02 9E 11
			39 00 00 40 00 00 04 FF 5A A5 23
			39 00 00 40 00 00 02 80 90
			39 00 00 40 00 00 04 FF 5A A5 53
			39 00 00 40 00 00 03 85 CC E3
			39 00 00 40 00 00 02 86 3D
			39 00 00 40 00 00 03 95 88 88
			39 00 00 40 00 00 04 FF 5A A5 51
			39 00 00 40 00 00 06 A1 B2 B2 B5 AE 22
			39 00 00 40 00 00 02 FE 22
			39 00 00 40 00 00 06 A2 AE AC AC AB 22
			39 00 00 40 00 00 02 FE 22
			39 00 00 40 00 00 06 A3 AA 98 98 98 22
			39 00 00 40 00 00 02 FE 22
			39 00 00 40 00 00 04 FF 5A A5 52
			39 00 00 40 00 00 06 81 E3 94 77 77 00
			39 00 00 40 00 00 02 FE 00
			39 00 00 40 00 00 06 82 77 77 77 77 00
			39 00 00 40 00 00 02 FE 00
			39 00 00 40 00 00 06 83 77 6E 6E 6E 00
			39 00 00 40 00 00 02 FE 00
			39 00 00 40 00 00 04 FF 5A A5 4F
			39 00 00 40 00 00 02 81 04
			39 00 00 40 00 00 04 FF 5A A5 08
			39 00 00 40 00 00 02 98 A6
			39 00 00 40 00 00 04 FF 5A A5 00
			39 00 00 40 00 00 02 00 00
			39 00 00 40 00 00 04 FF 5A A5 4F
			39 00 00 40 00 00 02 8B 78
			39 00 00 00 00 00 04 FF 5A A5 00
		];
qcom,mdss-dsi-dc-on-command-state = "dsi_hs_mode";
//qcom,mdss-dsi-nt37705-dc-detect-fps;
//qcom,check_pcd;

qcom,mdss-dsi-display-timings {
	timing@0{
		qcom,mdss-dsi-cmd-mode;
		qcom,mdss-dsi-panel-framerate = <120>;
		qcom,mdss-dsi-panel-width = <1440>;
		qcom,mdss-dsi-panel-height = <3168>;
		qcom,mdss-dsi-h-front-porch = <16>;
		qcom,mdss-dsi-h-back-porch = <16>;
		qcom,mdss-dsi-h-pulse-width = <16>;
		qcom,mdss-dsi-h-sync-skew = <0>;
		qcom,mdss-dsi-h-sync-pulse = <0>;
		qcom,mdss-dsi-v-back-porch = <2>;
		qcom,mdss-dsi-v-front-porch = <2>;
		qcom,mdss-dsi-v-pulse-width = <2>;
		qcom,mdss-dsi-h-left-border = <0>;
		qcom,mdss-dsi-h-right-border = <0>;
		qcom,mdss-dsi-v-top-border = <0>;
		qcom,mdss-dsi-v-bottom-border = <0>;
	        qcom,mdss-dsi-panel-jitter = <0x20 0xa>;
	        qcom,mdss-dsi-timing-switch-command = [
			39 00 00 40 00 00 04 FF 5A A5 4F //120hz
			39 00 00 40 00 00 02 88 78
			39 00 00 40 00 00 04 FF 5A A5 00
			39 00 00 40 00 00 02 60 00
			39 00 00 40 00 00 04 FF 5A A5 2D
			39 00 00 40 00 00 02 83 00
			39 00 00 40 00 00 04 FF 5A A5 51
			39 00 00 40 00 00 07 82 44 44 56 7A 22 22
			39 00 00 40 00 00 07 83 7A 7A 7A 7A 22 22
			39 00 00 40 00 00 07 8A 44 44 56 7A 22 22
			39 00 00 40 00 00 07 8B 7A 7A 7A 7A 22 22
			39 00 00 40 00 00 07 92 44 44 56 7A 22 22
			39 00 00 40 00 00 07 93 7A 7A 7A 7A 22 22
			39 00 00 40 00 00 07 9A 44 44 56 7A 22 22
			39 00 00 40 00 00 07 9B 7A 7A 7A 7A 22 22
			39 00 00 40 00 00 07 A2 4F 53 61 7E 22 22
			39 00 00 40 00 00 07 A3 7E 42 7A 7A 22 22
			39 00 00 40 00 00 07 AA 4F 53 61 7D 22 22
			39 00 00 40 00 00 07 AB 80 42 7A 7A 22 22
			39 00 00 40 00 00 07 B2 4F 53 55 82 22 22
			39 00 00 40 00 00 07 B3 82 42 7A 7A 22 22
			39 00 00 40 00 00 07 BA 52 4E 5B 7E 22 22
			39 00 00 40 00 00 07 BB 7D 42 7A 7A 22 22
			39 00 00 40 00 00 04 FF 5A A5 00
			39 00 00 40 00 00 04 FF 5A A5 4F
			39 00 00 00 00 00 02 8B 78
	        ];
		qcom,mdss-dsi-on-command = [
			39 00 00 40 00 00 04 FF 5A A5 07 //initcode
			39 00 00 40 00 00 02 8A 01
			39 00 00 40 00 00 03 8B 00 21
			39 00 00 40 00 00 04 FF 5A A5 31
			39 00 00 40 00 00 02 D0 80
			39 00 00 40 00 00 04 FF 5A A5 08
			39 00 00 40 00 00 02 C8 62
			39 00 00 40 00 00 04 FF 5A A5 21
			39 00 00 40 00 00 02 A4 18
			39 00 00 40 00 00 04 FF 5A A5 00
			39 00 00 40 00 00 02 5E 01
			39 00 00 40 00 00 02 60 00
			39 00 00 40 00 00 02 61 0F
			39 00 00 40 00 00 02 6D 01
			39 00 00 40 00 00 01 35
			39 00 00 40 00 00 02 53 20
			39 00 00 40 00 00 03 51 00 00

			39 00 00 40 00 00 04 FF 5A A5 4F //120hz
			39 00 00 40 00 00 02 88 78
			39 00 00 40 00 00 04 FF 5A A5 00
			39 00 00 40 00 00 02 60 00
			39 00 00 40 00 00 04 FF 5A A5 2D
			39 00 00 40 00 00 02 83 00
			39 00 00 40 00 00 04 FF 5A A5 51
			39 00 00 40 00 00 07 82 44 44 56 7A 22 22
			39 00 00 40 00 00 07 83 7A 7A 7A 7A 22 22
			39 00 00 40 00 00 07 8A 44 44 56 7A 22 22
			39 00 00 40 00 00 07 8B 7A 7A 7A 7A 22 22
			39 00 00 40 00 00 07 92 44 44 56 7A 22 22
			39 00 00 40 00 00 07 93 7A 7A 7A 7A 22 22
			39 00 00 40 00 00 07 9A 44 44 56 7A 22 22
			39 00 00 40 00 00 07 9B 7A 7A 7A 7A 22 22
			39 00 00 40 00 00 07 A2 4F 53 61 7E 22 22
			39 00 00 40 00 00 07 A3 7E 42 7A 7A 22 22
			39 00 00 40 00 00 07 AA 4F 53 61 7D 22 22
			39 00 00 40 00 00 07 AB 80 42 7A 7A 22 22
			39 00 00 40 00 00 07 B2 4F 53 55 82 22 22
			39 00 00 40 00 00 07 B3 82 42 7A 7A 22 22
			39 00 00 40 00 00 07 BA 52 4E 5B 7E 22 22
			39 00 00 40 00 00 07 BB 7D 42 7A 7A 22 22
			39 00 00 40 00 00 04 FF 5A A5 00
			39 00 00 40 00 00 04 FF 5A A5 4F
			39 00 00 40 00 00 02 8B 78

			39 00 00 40 00 00 04 FF 5A A5 07 //10bit 3.75x
			39 00 00 40 00 00 02 8A 01
			39 00 00 40 00 00 03 8B A0 21
			39 00 00 40 00 00 64 81 00 00 00 00 00 11 00 00 AB 30 80 0C 60 05 A0 00 16 02 D0 02 D0 02 00 02 68 00 20 02 68 00 0A 00 0C 04 93 03 78 18 00 10 F0 07 10 20 00 06 0F 0F 33 0E 1C 2A 38 46 54 62 69 70 77 79 7B 7D 7E 01 02 22 00 2A 40 2A BE 3A FC 3A FA 3A F8 3B 38 3B 78 3B B6 4B F6 4C 34 4C 74 5C 74 8C F4 00 00 00 00 00 00
			39 00 00 00 00 00 04 FF 5A A5 00

			05 00 00 00 78 00 01 11 //Delay 120ms
			05 00 00 00 14 00 01 29];	/* display on */
		qcom,mdss-dsi-off-command = [
			39 00 00 40 00 00 04 FF 5A A5 00
			05 00 00 00 14 00 01 28		/* display_off */
			05 00 00 00 BE 00 01 10];	/* enter sleep mode */

		qcom,mdss-dsi-on-command-state = "dsi_lp_mode";
		qcom,mdss-dsi-off-command-state = "dsi_lp_mode";
		qcom,mdss-dsi-timing-switch-command-state = "dsi_lp_mode";
		qcom,compression-mode = "dsc";
		/* Why QCOM doesn't use this, even it used 2 encoder
		 * as for that dsi_sw43404_amoled_cmd, for ex */
		/* qcom,mdss-dsc-encoders = <2>; */
		qcom,mdss-dsc-version = <0x11>;
		qcom,mdss-dsc-slice-height = <22>;
		qcom,mdss-dsc-slice-width = <720>;
		qcom,mdss-dsc-slice-per-pkt = <2>;
		qcom,mdss-dsc-bit-per-component = <10>;
		qcom,mdss-dsc-bit-per-pixel = <8>;
		qcom,mdss-dsc-block-prediction-enable;
		qcom,mdss-dsi-pcd-check-enable-command = [
			39 00 00 00 00 00 04 FF 5A A5 03
			];
		qcom,mdss-dsi-pcd-check-enable-command-state = "dsi_hs_mode";
		qcom,mdss-dsi-pcd-check-disable-command = [
			39 00 00 00 00 00 04 FF 5A A5 00
			];
		qcom,mdss-dsi-pcd-check-disable-command-state = "dsi_hs_mode";
	};
};

};

};
