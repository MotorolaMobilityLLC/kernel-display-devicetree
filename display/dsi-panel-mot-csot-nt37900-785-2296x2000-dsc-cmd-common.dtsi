/* Copyright (c) 2019-2020, The Linux Foundation. All rights reserved.
 *
 * This program is free software; you can redistribute it and/or modify
 * it under the terms of the GNU General Public License version 2 and
 * only version 2 as published by the Free Software Foundation.
 *
 * This program is distributed in the hope that it will be useful,
 * but WITHOUT ANY WARRANTY; without even the implied warranty of
 * MERCHANTABILITY or FITNESS FOR A PARTICULAR PURPOSE.  See the
 * GNU General Public License for more details.
 */
&mdss_mdp {
mot_csot_nt37900_785_2296x2000_dsc_cmd: qcom,mdss_dsi_mot_csot_nt37900_785_2296x2000_dsc_cmd {
compatible = "qcom,mdss-dsi-panel";
qcom,mdss-dsi-panel-name = "mipi_mot_cmd_csot_1440p_dsc_785";
qcom,mdss-dsi-panel-supplier = "csot";
qcom,mdss-dsi-panel-type = "dsi_cmd_mode";
qcom,mdss-dsi-virtual-channel-id = <0>;
qcom,mdss-dsi-stream = <0>;
qcom,mdss-pan-physical-width-dimension = <150>;
qcom,mdss-pan-physical-height-dimension = <131>;
qcom,mdss-dsi-bpp = <24>;
qcom,mdss-dsi-underflow-color = <0xff>;
qcom,mdss-dsi-border-color = <0>;

qcom,dsi-ctrl-num = <0>;
qcom,dsi-phy-num = <0>;

qcom,mdss-dsi-traffic-mode = "burst_mode";
qcom,mdss-dsi-bllp-eof-power-mode;
qcom,mdss-dsi-bllp-power-mode;
qcom,mdss-dsi-lane-0-state;
qcom,mdss-dsi-lane-1-state;
qcom,mdss-dsi-lane-2-state;
qcom,mdss-dsi-lane-3-state;

qcom,mdss-dsi-dma-trigger = "trigger_sw";
qcom,mdss-dsi-mdp-trigger = "none";
qcom,mdss-dsi-reset-sequence = <0 3>, <1 1>, <0 1>, <1 20>;
qcom,mdss-dsi-lp11-init;
qcom,mdss-dsi-tx-eot-append;
qcom,mdss-dsi-te-pin-select = <1>;
qcom,mdss-dsi-te-dcs-command = <1>;
qcom,mdss-dsi-te-using-te-pin;

//qcom,bklt-dcs-2bytes-enabled;
qcom,mdss-dsi-bl-min-level = <4>;
qcom,mdss-dsi-bl-max-level = <14056>;
qcom,mdss-dsi-bl-pmic-control-type = "bl_ctrl_dcs";

qcom,mdss-dsi-panel-hdr-enabled;
qcom,mdss-dsi-panel-hdr-color-primaries = <14500 15500 32000
	        17000 15500 30000 8000 3000>;
qcom,mdss-dsi-panel-peak-brightness = <4200000>;

qcom,mdss-dsi-panel-blackness-level = <3230>;

qcom,mdss-dsi-dc-off-command = [
		39 00 00 40 00 00 02 6F 01
		39 00 00 40 00 00 02 8B 00
		39 00 00 00 00 00 03 6D 00 00
		];

qcom,mdss-dsi-dc-off-command-state = "dsi_hs_mode";
qcom,mdss-dsi-dc-on-command = [
		39 00 00 40 00 00 02 6F 01
		39 00 00 40 00 00 02 8B 81
		39 00 00 00 00 00 03 6D 00 00
		];
qcom,mdss-dsi-dc-on-command-state = "dsi_hs_mode";
//qcom,mdss-dsi-nt37705-dc-detect-fps;

qcom,mdss-dsi-display-timings {
	timing@0{
		qcom,mdss-dsi-cmd-mode;
		qcom,mdss-dsi-panel-framerate = <120>;
		qcom,mdss-dsi-panel-width = <2296>;
		qcom,mdss-dsi-panel-height = <2000>;
		qcom,mdss-dsi-h-front-porch = <20>;
		qcom,mdss-dsi-h-back-porch = <20>;
		qcom,mdss-dsi-h-pulse-width = <16>;
		qcom,mdss-dsi-h-sync-skew = <0>;
		qcom,mdss-dsi-h-sync-pulse = <0>;
		qcom,mdss-dsi-v-back-porch = <25>;
		qcom,mdss-dsi-v-front-porch = <27>;
		qcom,mdss-dsi-v-pulse-width = <2>;
		qcom,mdss-dsi-h-left-border = <0>;
		qcom,mdss-dsi-h-right-border = <0>;
		qcom,mdss-dsi-v-top-border = <0>;
		qcom,mdss-dsi-v-bottom-border = <0>;
		qcom,mdss-dsi-timing-switch-command = [
			39 00 00 40 00 00 02 35 00 //TE1=0
		];
		qcom,mdss-dsi-on-command = [
		39 00 00 00 00 00 06 F0 55 AA 52 08 00
		39 00 00 40 00 00 02 E1 01
		39 00 00 40 00 00 02 6F 01
		39 00 00 40 00 00 09 E1 10 18 24 00 00 00 00 00
		39 00 00 40 00 00 06 F0 55 AA 52 08 00
		39 00 00 40 00 00 02 6F 1C
		39 00 00 40 00 00 11 BA 01 01 01 01 00 00 00 00 00 00 00 00 00 00 00 00
		39 00 00 40 00 00 02 6F 2C
		39 00 00 40 00 00 11 BA 00 01 01 01 00 01 01 01 00 01 01 01 00 00 00 00
		39 00 00 40 00 00 02 6F 3C
		39 00 00 40 00 00 11 BA 00 00 01 01 00 00 03 02 00 00 03 02 00 00 00 00
		39 00 00 40 00 00 02 6F 4C
		39 00 00 40 00 00 11 BA 00 00 00 00 00 00 00 00 00 00 00 00 00 00 00 00
		39 00 00 40 00 00 02 6F 5C
		39 00 00 40 00 00 11 BA 01 01 01 01 01 01 01 01 01 01 01 01 01 01 01 01
		39 00 00 40 00 00 02 6F 6C
		39 00 00 40 00 00 11 BA 01 03 04 0B 01 05 77 01 02 08 11 00 00 00 00 00
		39 00 00 40 00 00 02 6F 7C
		39 00 00 40 00 00 11 BA 01 03 04 0B 01 05 77 01 02 08 11 00 00 00 00 00
		39 00 00 40 00 00 02 6F 8C
		39 00 00 40 00 00 11 BA 00 00 00 00 00 00 00 00 00 00 00 00 00 00 00 00
		39 00 00 40 00 00 02 6F 9C
		39 00 00 40 00 00 09 BA 11 11 30 33 00 33 00 00
		39 00 00 40 00 00 02 6F A4
		39 00 00 40 00 00 05 BA 94 25 3D 00
		39 00 00 40 00 00 02 6F A8
		39 00 00 40 00 00 09 BA 00 00 11 20 22 02 00 00
		39 00 00 40 00 00 02 6F B0
		39 00 00 40 00 00 09 BA 00 00 11 20 22 02 00 00
		39 00 00 40 00 00 05 FF AA 55 A5 80
		39 00 00 40 00 00 02 6F 02
		39 00 00 40 00 00 02 F7 60
		39 00 00 40 00 00 05 FF AA 55 A5 81
		39 00 00 40 00 00 02 6F 0D
		39 00 00 40 00 00 02 FB 80 
		39 00 00 40 00 00 02 6F 10
		39 00 00 40 00 00 02 FB 04
		39 00 00 40 00 00 02 6F 04
		39 00 00 40 00 00 03 FE 34 14
		39 00 00 40 00 00 05 2A 00 00 08 F7
		39 00 00 40 00 00 05 2B 00 00 07 CF
		39 00 00 40 00 00 02 35 00
		39 00 00 40 00 00 07 51 00 00 00 00 00 00
		39 00 00 40 00 00 02 53 20
		39 00 00 40 00 00 03 90 03 43
		39 00 00 40 00 00 13 91 89 28 00 10 C2 00 03 3F 02 0E 00 0F 06 67 02 F2 10 D0
		39 00 00 40 00 00 02 2F 00
		39 00 00 40 00 00 02 5F 00
		39 00 00 40 00 00 06 F0 55 AA 52 08 00
		39 00 00 40 00 00 02 6F 2A
		39 00 00 40 00 00 02 B2 00
		39 00 00 40 00 00 02 53 28
		39 00 00 40 00 00 06 F0 55 AA 52 08 00
		39 00 00 40 00 00 02 B2 09
		39 00 00 40 00 00 02 6F 05
		39 00 00 40 00 00 03 B2 20 20
		39 00 00 40 00 00 06 F0 55 AA 52 08 05
		39 00 00 40 00 00 08 CB 33 33 33 33 33 33 33  
		39 00 00 40 00 00 06 F0 55 AA 52 08 00
		39 00 00 40 00 00 02 6F C5
		39 00 00 40 00 00 02 BA 10
		39 00 00 40 00 00 06 F0 55 AA 52 08 00
		39 00 00 40 00 00 02 6F 09
		39 00 00 40 00 00 07 C8 13 13 13 13 0D 13  
                05 00 00 00 78 00 01 11
                05 00 00 00 00 00 01 29];	/* display on */
		qcom,mdss-dsi-off-command = [
			05 00 00 00 00 00 01 28		/* display_off */
			05 00 00 00 64 00 01 10];	/* enter sleep mode */

		qcom,mdss-dsi-on-command-state = "dsi_lp_mode";
		qcom,mdss-dsi-off-command-state = "dsi_lp_mode";
		qcom,mdss-dsi-timing-switch-command-state =
			"dsi_hs_mode";
		qcom,compression-mode = "dsc";
		/* Why QCOM doesn't use this, even it used 2 encoder
		 * as for that dsi_sw43404_amoled_cmd, for ex */
		/* qcom,mdss-dsc-encoders = <2>; */
		qcom,mdss-dsc-version = <0x11>;
		qcom,mdss-dsc-slice-height = <16>;
		qcom,mdss-dsc-slice-width = <1148>;
		qcom,mdss-dsc-slice-per-pkt = <2>;
		qcom,mdss-dsc-bit-per-component = <8>;
		qcom,mdss-dsc-bit-per-pixel = <8>;
		qcom,mdss-dsc-block-prediction-enable;
		qcom,mdss-dsc-novateck-ic;
	};

};

};

};
