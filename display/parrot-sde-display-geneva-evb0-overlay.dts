/dts-v1/;
/plugin/;

#include "parrot-sde-display-geneva-common.dtsi"

/{
	model = "geneva";
	compatible = "qcom,parrot-qrd", "qcom,parrot", "moto,parrot", "moto,geneva";
	qcom,msm-id = <537 0x10000>;
	qcom,board-id = <0x43 0x9000>, <0x41 0x9000>;
};

