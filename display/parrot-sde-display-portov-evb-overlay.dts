/dts-v1/;
/plugin/;

#include "parrot-sde-display-portov-common.dtsi"

/ {
	model = "portov";
	compatible = "qcom,parrot-qrd", "qcom,parrot", "qcom,qrd", "moto,portov";
	qcom,msm-id = <613 0x10000>;
	qcom,board-id = <0x46 0x9000>;
};

