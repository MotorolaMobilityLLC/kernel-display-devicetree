/dts-v1/;
/plugin/;

#include "crow-sde-display-idp-wcd.dtsi"

/ {
	model = "Qualcomm Technologies, Inc. Crow IDP WCD";
	compatible = "qcom,crow-idp", "qcom,crow", "qcom,idp";
	qcom,msm-id = <608 0x10000>;
	qcom,board-id = <34 1>, <34 3>;
};
