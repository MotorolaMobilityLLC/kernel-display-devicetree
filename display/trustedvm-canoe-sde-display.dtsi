// SPDX-License-Identifier: BSD-3-Clause
/*
 * Copyright (c) Qualcomm Technologies, Inc. and/or its subsidiaries.
 */

#include "canoe-sde-display-common.dtsi"

&sde_dsi {
	clocks = <&clock_cpucc 0>,
			<&clock_cpucc 1>,
			<&clock_cpucc 2>,
			<&clock_cpucc 3>;
	clock-names = "pll_byte_clk0", "pll_dsi_clk0",
			"pll_byte_clk1", "pll_dsi_clk1";
};

&sde_dsi1 {
	clocks = <&clock_cpucc 0>,
			<&clock_cpucc 1>,
			<&clock_cpucc 2>,
			<&clock_cpucc 3>;
	clock-names = "pll_byte_clk0", "pll_dsi_clk0",
			"pll_byte_clk1", "pll_dsi_clk1";
};

&dsi_nt37802_amoled_video_psr_vhm {
	qcom,hwfence_sw_override_always;
};

&mdss_mdp {
	connectors = <&sde_dsi &sde_dsi1 &smmu_sde_unsec>;
};
