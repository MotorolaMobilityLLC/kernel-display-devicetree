/* Copyright (c) 2019-2025, Motorola Mobility LLC. All rights reserved.
 *
 * This program is free software; you can redistribute it and/or modify
 * it under the terms of the GNU General Public License version 2 and
 * only version 2 as published by the Free Software Foundation.
 *
 * This program is distributed in the hope that it will be useful,
 * but WITHOUT ANY WARRANTY; without even the implied warranty of
 * MERCHANTABILITY or FITNESS FOR A PARTICULAR PURPOSE.  See the
 * GNU General Public License for more details.
 */
&mdss_mdp {
	mot_csot_vtdr6126a_678_1272x2772_dsc_vid: qcom,mdss_dsi_mot_csot_vtdr6126a_678_1272x2772_dsc_vid {
		qcom,mdss-dsi-panel-name = "mipi_mot_vid_csot_1272p_dsc_678_144hz";
		qcom,mdss-dsi-panel-supplier = "csot";
		qcom,mdss-dsi-panel-type = "dsi_video_mode";
		qcom,mdss-dsi-panel-physical-type = "oled";
		qcom,dsi-ctrl-num = <0>;
		qcom,dsi-phy-num = <0>;
		qcom,mdss-dsi-virtual-channel-id = <0>;
		qcom,mdss-dsi-stream = <0>;
		qcom,mdss-pan-physical-width-dimension = <72>;
		qcom,mdss-pan-physical-height-dimension = <157>;
		qcom,mdss-dsi-bpp = <30>;
		qcom,mdss-dsi-underflow-color = <0xff>;
		qcom,mdss-dsi-border-color = <0>;

		qcom,mdss-dsi-traffic-mode = "non_burst_sync_event";
		qcom,mdss-dsi-bllp-eof-power-mode;
		qcom,mdss-dsi-bllp-power-mode;
		qcom,mdss-dsi-lp11-init;
		qcom,mdss-dsi-lane-0-state;
		qcom,mdss-dsi-lane-1-state;
		qcom,mdss-dsi-lane-2-state;
		qcom,mdss-dsi-lane-3-state;
		qcom,mdss-dsi-dma-trigger = "trigger_sw";
		qcom,mdss-dsi-mdp-trigger = "none";
		qcom,mdss-dsi-reset-sequence = <1 2>, <0 5>, <1 25>;
		qcom,mdss-dsi-force-clock-lane-hs;

		qcom,mdss-dsi-dc-off-command = [
			39 00 00 00 00 00 02 5E 00];
		qcom,mdss-dsi-dc-off-command-state = "dsi_hs_mode";
		qcom,mdss-dsi-dc-on-command = [
			39 00 00 00 00 00 02 5E 01];
		qcom,mdss-dsi-dc-on-command-state = "dsi_hs_mode";

		qcom,mdss-dsi-hbm-on-command = [
			39 00 00 40 00 00 02 62 00
			39 00 00 00 00 00 03 51 3E 80];
		qcom,mdss-dsi-hbm-off-command = [
			39 00 00 40 00 00 02 62 00
			39 00 00 00 00 00 03 51 2C 50];

		qcom,mdss-dsi-hbm-fod;
		qcom,mdss-dsi-hbm-fod-on-command = [
			39 00 00 40 00 00 05 63 10 00 1A 3C
			39 01 00 00 00 00 02 62 03];

		qcom,mdss-dsi-panel-local-hbm-enabled;
		qcom,mdss-dsi-panel-local-hbm-DC-HYBIRD-THRESHOLD-BL = <3519>;
		qcom,mdss-dsi-panel-local-hbm-alpha-register = <0x63>;
		qcom,mdss-dsi-panel-local-hbm-alpha-size = <16001>;
		qcom,mdss-dsi-panel-bl-num = <1>;

		qcom,mdss-dsi-display-timings {
			timing@0 {
				cell-index = <0>;
				qcom,mdss-dsi-video-mode;
				qcom,mdss-dsi-cmd-mode;
				qcom,mdss-dsi-panel-framerate = <60>;
				qcom,mdss-dsi-panel-width = <1272>;
				qcom,mdss-dsi-panel-height = <2772>;
				qcom,mdss-dsi-h-front-porch = <108>;
				qcom,mdss-dsi-h-back-porch = <16>;
				qcom,mdss-dsi-h-pulse-width = <16>;
				qcom,mdss-dsi-h-sync-skew = <0>;
				qcom,mdss-dsi-h-sync-pulse = <0>;
				qcom,mdss-dsi-v-back-porch = <22>;
				qcom,mdss-dsi-v-front-porch = <2964>;
				qcom,mdss-dsi-v-pulse-width = <2>;
				qcom,mdss-dsi-h-left-border = <0>;
				qcom,mdss-dsi-h-right-border = <0>;
				qcom,mdss-dsi-v-top-border = <0>;
				qcom,mdss-dsi-v-bottom-border = <0>;
				qcom,vid-on-commands = [
					39 00 00 00 00 00 02 A4 01
					39 00 00 00 00 00 01 38
					39 00 00 00 00 00 02 6F 01
					39 00 00 00 00 00 02 A4 00

					39 00 00 00 00 00 02 03 01
					39 00 00 00 00 00 05 2A 00 00 04 F8
					39 00 00 00 00 00 05 2B 00 00 05 40
					39 00 00 00 00 00 02 35 00
					39 00 00 00 00 00 03 51 00 00
					39 00 00 00 00 00 02 53 20
					39 00 00 00 00 00 02 59 09
					39 00 00 00 00 00 03 F0 AA 18
					39 00 00 00 00 00 02 B0 80
					39 00 00 00 00 00 02 5E 00
					39 00 00 00 00 00 02 6B 01
					39 00 00 00 00 00 02 6C 03
					39 00 00 00 00 00 02 6D 00
					39 00 00 00 00 00 02 6F 01
					39 00 00 00 00 00 5F 70 12 00 00 AB 30 80 0A D4 04 F8 00 0C 02 7C 02 7C 02 00 01 1B 00 20 02 71 00 08 00 01 00 BB 07 32 18 00 10 F0 07 10 20 00 06 0F 0F 33 0E 1C 2A 38 46 54 62 69 70 77 79 7B 7D 7E 02 02 22 00 2A 40 2A BE 3A FC 3A FA 3A F8 3B 38 3B 78 3B B6 4B B6 4B F4 4B F4 6C 34 84 74 00 00 00 00 00 00

					39 00 00 00 00 00 02 72 00

					39 00 00 00 00 00 03 ff 5a 80
					39 00 00 00 00 00 02 65 25
					39 00 00 00 00 00 02 fd 01
					39 00 00 00 00 00 03 f0 aa 1c
					39 00 00 00 00 00 15 c1 0D C0 0F E4 12 08 1D 28 36 E8 39 70 3B F8 3E 80 3F 3E 3F FC
					39 00 00 00 00 00 1F c2 5E 52 73 50 44 62 40 34 4F 2A 22 36 18 14 20 09 06 0F 97 97 97 B4 B3 BA C3 BF CB C3 BF CB
					39 00 00 00 00 00 21 c4 01 FF 02 02 02 04 04 04 04 04 04 06 06 07 1B 16 1C 1E 1A 1F 21 20 25 28 28 2C 3F 3C 44 47 44 4D
					39 00 00 00 00 00 03 FF 5A 83
					39 00 00 00 00 00 02 65 0B
					39 00 00 00 00 00 02 F7 03
					39 00 00 00 00 00 03 FF 5A 83
					39 00 00 00 00 00 02 65 09
					39 00 00 00 00 00 03 F7 10 10
					39 00 00 00 00 00 03 F0 AA 16
					39 00 00 00 00 00 11 D1 00 00 00 00 00 00 00 00 00 00 00 00 00 00 00 00
					39 00 00 00 00 00 03 FF 5A 81
					39 00 00 00 00 00 02 65 03
					39 00 00 00 00 00 02 f3 49
					39 00 00 00 00 00 02 65 0B
					39 00 00 00 00 00 02 f3 58
					39 00 00 00 00 00 03 FF 5A 80
					39 00 00 00 00 00 02 65 0A
					39 00 00 00 00 00 02 F9 1E

					39 00 00 00 00 00 03 F0 AA 00
					39 00 00 00 00 00 03 FF 5A 00

					05 00 00 00 55 00 01 11
					05 00 00 00 00 00 01 29
				];

				qcom,cmd-on-commands = [
					39 00 00 00 00 00 02 A4 01
					39 00 00 00 00 00 01 38
					39 00 00 00 00 00 02 6F 01
					39 00 00 00 00 00 02 A4 00

					39 00 00 00 00 00 02 03 01
					39 00 00 00 00 00 05 2A 00 00 04 F8
					39 00 00 00 00 00 05 2B 00 00 05 40
					39 00 00 00 00 00 02 35 00
					39 00 00 00 00 00 03 51 00 00
					39 00 00 00 00 00 02 53 20
					39 00 00 00 00 00 02 59 09
					39 00 00 00 00 00 03 F0 AA 18
					39 00 00 00 00 00 02 B0 80
					39 00 00 00 00 00 02 5E 00
					39 00 00 00 00 00 02 6B 01
					39 00 00 00 00 00 02 6C 03
					39 00 00 00 00 00 02 6D 00
					39 00 00 00 00 00 02 6F 01
					39 00 00 00 00 00 5F 70 12 00 00 AB 30 80 0A D4 04 F8 00 0C 02 7C 02 7C 02 00 01 1B 00 20 02 71 00 08 00 01 00 BB 07 32 18 00 10 F0 07 10 20 00 06 0F 0F 33 0E 1C 2A 38 46 54 62 69 70 77 79 7B 7D 7E 02 02 22 00 2A 40 2A BE 3A FC 3A FA 3A F8 3B 38 3B 78 3B B6 4B B6 4B F4 4B F4 6C 34 84 74 00 00 00 00 00 00

					39 00 00 00 00 00 02 72 00

					39 00 00 00 00 00 03 ff 5a 80
					39 00 00 00 00 00 02 65 25
					39 00 00 00 00 00 02 fd 01
					39 00 00 00 00 00 03 f0 aa 1c
					39 00 00 00 00 00 15 c1 0D C0 0F E4 12 08 1D 28 36 E8 39 70 3B F8 3E 80 3F 3E 3F FC
					39 00 00 00 00 00 1F c2 5E 52 73 50 44 62 40 34 4F 2A 22 36 18 14 20 09 06 0F 97 97 97 B4 B3 BA C3 BF CB C3 BF CB
					39 00 00 00 00 00 21 c4 01 FF 02 02 02 04 04 04 04 04 04 06 06 07 1B 16 1C 1E 1A 1F 21 20 25 28 28 2C 3F 3C 44 47 44 4D
					39 00 00 00 00 00 03 FF 5A 83
					39 00 00 00 00 00 02 65 0B
					39 00 00 00 00 00 02 F7 03
					39 00 00 00 00 00 03 FF 5A 83
					39 00 00 00 00 00 02 65 09
					39 00 00 00 00 00 03 F7 10 10
					39 00 00 00 00 00 03 F0 AA 16
					39 00 00 00 00 00 11 D1 00 00 00 00 00 00 00 00 00 00 00 00 00 00 00 00
					39 00 00 00 00 00 03 FF 5A 81
					39 00 00 00 00 00 02 65 03
					39 00 00 00 00 00 02 f3 49
					39 00 00 00 00 00 02 65 0B
					39 00 00 00 00 00 02 f3 58
					39 00 00 00 00 00 03 FF 5A 80
					39 00 00 00 00 00 02 65 0A
					39 00 00 00 00 00 02 F9 1E

					39 00 00 00 00 00 03 F0 AA 00
					39 00 00 00 00 00 03 FF 5A 00

					05 00 00 00 55 00 01 11
					05 00 00 00 00 00 01 29

					//cmd aod mode
					05 00 00 40 00 00 01 28
					39 00 00 40 00 00 02 6F 02
					05 00 00 40 00 00 01 39
					39 00 00 00 11 00 02 6D 01
					05 00 00 00 00 00 01 29
				];

				qcom,mdss-dsi-off-command = [
					05 01 00 00 11 00 01 28
					05 01 00 00 78 00 01 10];
				qcom,mdss-dsi-on-command-state = "dsi_lp_mode";
				qcom,mdss-dsi-off-command-state = "dsi_lp_mode";

				qcom,compression-mode = "dsc";
				qcom,mdss-dsc-version = <0x12>;
				qcom,mdss-dsc-slice-height = <12>;
				qcom,mdss-dsc-slice-width = <636>;
				qcom,mdss-dsc-slice-per-pkt = <2>;
				qcom,mdss-dsc-bit-per-component = <10>;
				qcom,mdss-dsc-bit-per-pixel = <8>;
				qcom,mdss-dsc-block-prediction-enable;

				qcom,mdss-dsi-dfps-60-command = [
					39 00 00 00 00 00 02 6C 03];
				qcom,mdss-dsi-dfps-60-command-state = "dsi_lp_mode";

				qcom,mdss-dsi-dfps-90-command = [
					39 00 00 00 00 00 02 6C 02];
				qcom,mdss-dsi-dfps-90-command-state = "dsi_lp_mode";

				qcom,mdss-dsi-dfps-120-command = [
					39 00 00 00 00 00 02 6C 01];
				qcom,mdss-dsi-dfps-120-command-state = "dsi_lp_mode";

				qcom,mdss-dsi-dfps-144-command = [
					39 00 00 00 00 00 02 6C 00];
				qcom,mdss-dsi-dfps-144-command-state = "dsi_lp_mode";

				qcom,mdss-dsi-pcd-check-enable-command = [
					39 00 00 40 00 00 03 F0 AA 12
					39 00 00 00 00 00 03 D0 08 02];
				qcom,mdss-dsi-pcd-check-enable-command-state = "dsi_hs_mode";

				qcom,mdss-dsi-pcd-check-disable-command = [
					39 00 00 40 00 00 03 D0 08 00
					39 00 00 40 00 00 03 F0 AA 00
					39 00 00 00 00 00 03 FF 5A 00];
				qcom,mdss-dsi-pcd-check-disable-command-state = "dsi_hs_mode";

				qcom,cmd-mode-switch-in-commands = [
					05 00 00 40 00 00 01 28
					39 00 00 40 00 00 02 6F 02
					05 00 00 40 00 00 01 39
					39 00 00 00 11 00 02 6D 01
					05 00 00 00 00 00 01 29];

				qcom,cmd-mode-switch-in-commands-state = "dsi_lp_mode";

				qcom,cmd-mode-switch-out-commands = [
					39 00 00 40 00 00 03 51 19 1A
					39 00 00 00 5A 00 02 A6 01];
				qcom,cmd-mode-switch-out-commands-state = "dsi_lp_mode";

				qcom,cmd-mode-backlight-commands = [
					39 00 00 00 00 00 02 6D 01];
				qcom,cmd-mode-backlight-commands-state = "dsi_lp_mode";
			};
		};
	};
};
