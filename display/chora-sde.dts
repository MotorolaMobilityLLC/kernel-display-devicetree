// SPDX-License-Identifier: BSD-3-Clause
/*
 * Copyright (c) Qualcomm Technologies, Inc. and/or its subsidiaries.
 */

/dts-v1/;
/plugin/;

#include "chora-sde.dtsi"

/ {
	qcom,msm-id = <724 0x10000>, <744 0x10000>;
	qcom,board-id = <0 0>;
};

