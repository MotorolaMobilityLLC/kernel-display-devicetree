/dts-v1/;
/plugin/;

#include "trustedvm-crow-sde.dtsi"
#include "trustedvm-crow-sde-display-qrd.dtsi"

/ {
	model = "Qualcomm Technologies, Inc. Crow QRD - TrustedVM";
	compatible = "qcom,crow-qrd", "qcom,crow", "qcom,qrd";
	qcom,msm-id = <608 0x10000>;
	qcom,board-id = <11 0>;
};
