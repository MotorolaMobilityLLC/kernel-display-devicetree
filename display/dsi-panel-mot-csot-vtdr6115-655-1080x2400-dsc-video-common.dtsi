/* Copyright (c) 2019-2021, The Linux Foundation. All rights reserved.
 *
 * This program is free software; you can redistribute it and/or modify
 * it under the terms of the GNU General Public License version 2 and
 * only version 2 as published by the Free Software Foundation.
 *
 * This program is distributed in the hope that it will be useful,
 * but WITHOUT ANY WARRANTY; without even the implied warranty of
 * MERCHANTABILITY or FITNESS FOR A PARTICULAR PURPOSE.  See the
 * GNU General Public License for more details.
 */
&mdss_mdp {
	mot_csot_vtdr6115_655_1080x2400_dsc_vid: qcom,mdss_dsi_mot_csot_vtdr6115_655_1080x2400_dsc_vid {
		qcom,mdss-dsi-panel-name = "mipi_mot_vid_csot_1080p_dsc_655";
		qcom,mdss-dsi-panel-supplier = "csot";
		qcom,mdss-dsi-panel-type = "dsi_video_mode";
		qcom,mdss-dsi-panel-physical-type = "oled";
		qcom,dsi-ctrl-num = <0>;
		qcom,dsi-phy-num = <0>;
		qcom,mdss-dsi-virtual-channel-id = <0>;
		qcom,mdss-dsi-stream = <0>;
		qcom,mdss-pan-physical-width-dimension = <69>;
		qcom,mdss-pan-physical-height-dimension = <154>;
		qcom,mdss-dsi-bpp = <24>;
		qcom,mdss-dsi-underflow-color = <0xff>;
		qcom,mdss-dsi-border-color = <0>;

		qcom,mdss-dsi-traffic-mode = "non_burst_sync_event";
		qcom,mdss-dsi-bllp-eof-power-mode;
		qcom,mdss-dsi-bllp-power-mode;
		qcom,mdss-dsi-lane-0-state;
		qcom,mdss-dsi-lane-1-state;
		qcom,mdss-dsi-lane-2-state;
		qcom,mdss-dsi-lane-3-state;
		qcom,mdss-dsi-dma-trigger = "trigger_sw";
		qcom,mdss-dsi-mdp-trigger = "none";
		qcom,mdss-dsi-reset-sequence = <1 10>, <0 10>, <1 10>;


		//qcom,bklt-dcs-2bytes-enabled;
		qcom,mdss-dsi-bl-min-level = <3>;
		qcom,mdss-dsi-bl-max-level = <4095>;
		qcom,mdss-dsi-bl-pmic-control-type = "bl_ctrl_dcs";

		qcom,mdss-dsi-panel-hdr-enabled;
		qcom,mdss-dsi-panel-hdr-color-primaries = <14500 15500 32000
			        17000 15500 30000 8000 3000>;
		qcom,mdss-dsi-panel-peak-brightness = <4200000>;

		qcom,mdss-dsi-panel-blackness-level = <3230>;

		/*qcom,mdss-dsi-hbm-on-command = [
				39 00 00 00 00 00 03 51 0F FF];
		qcom,mdss-dsi-hbm-off-command = [
				39 00 00 00 00 00 03 51 07 FF];

		qcom,mdss-dsi-dc-off-command = [
				39 00 00 00 00 00 06 F0 55 AA 52 08 00
				39 00 00 40 00 00 02 B2 18
				//DBV_TH00~DBV_TH05
				39 00 00 00 00 00 25 B3 00 08 00 20 00 20 00 48 00 48 00 80
						         00 80 00 F0 00 F0 01 C1 01 C1 01 C2
						         01 C2 03 33 03 33 07 FF 07 FF 0F FF

				39 00 00 00 00 00 06 F0 55 AA 52 08 04
				//60HZ
				39 00 00 00 00 00 4C D2 20 20 1A 0A 04 20 16 10 10 08 40 15 10 10 08 20 15 10 14 06 20 10 10 10 03
						         FF 40 30 1B 08 A0 34 24 18 14 40 28 22 18 18 40 26 26 24 12 40 24 22 20 07
						         20 20 1A 0A 04 20 16 10 12 08 20 15 10 10 08 20 15 10 14 06 20 10 10 10 03
				//120Hz Nor
				39 00 00 00 00 00 4C D4 40 28 20 10 05 50 25 12 12 0A 40 20 10 09 08 40 20 0B 10 06 30 18 0B 06 06
					                         FF 50 40 20 0B A0 40 20 16 10 80 30 1F 12 10 60 2F 1F 20 0B 50 28 18 10 0B
						         40 28 20 10 05 50 25 12 06 0A 40 20 10 09 08 40 20 0B 10 06 30 18 0B 06 06
				//144Hz Nor
				39 00 00 00 00 00 4C D9 88 30 20 10 04 48 2A 18 0A 08 48 21 10 08 08 60 15 10 10 05 60 15 10 08 05
						        FF 60 44 20 08 8F 50 30 12 12 8F 42 25 12 12 60 20 20 20 10 60 20 1F 10 10
						        88 30 20 10 04 48 2A 18 0A 08 48 21 10 08 08 40 15 08 10 05 40 15 10 08 05];
		qcom,mdss-dsi-dc-off-command-state = "dsi_hs_mode";
		qcom,mdss-dsi-dc-on-command = [
				39 00 00 00 00 00 06 F0 55 AA 52 08 00
				39 00 00 40 00 00 02 B2 98
				39 00 00 00 00 00 25 B3 00 00 00 00 00 00 00 00 00 00 00 00
		                                                                         00 00 00 00 00 00 00 00 01 C1 01 C2
						         01 C2 03 33 03 33 07 FF 07 FF 0F FF
				39 00 00 00 00 00 06 F0 55 AA 52 08 04
				//60Hz DC
				39 00 00 00 00 00 4C D2 1A 1A 1A 0A 04 10 10 10 10 08 10 10 10 10 08 10 10 10 08 06 10 10 10 04 03
						         30 30 30 1B 08 24 24 24 18 14 22 22 22 18 18 24 24 24 24 12 20 20 20 20 07
						         1A 1A 1A 0A 04 10 10 10 12 08 10 10 10 10 08 14 14 14 14 06 10 10 10 10 03

				//120Hz DC
				39 00 00 00 00 00 4C D4 20 20 20 10 05 12 12 12 12 0A 10 10 10 09 08 10 10 10 10 06 06 06 06 06 06
						         40 40 40 20 0B 20 20 20 16 10 1F 1F 1F 12 10 20 20 20 20 0B 10 10 10 10 0B
						         20 20 20 10 05 12 12 12 06 0A 10 10 10 09 08 10 10 10 10 06  06 06 06 06 06


				//144Hz DC
				39 00 00 00 00 00 4C D9 20 20 20 10 04 18 18 18 0A 08 10 10 10 08 08 10 10 10 10 05 08 08 08 08 05
						         44 44 44 20 08 30 30 30 12 12 25 25 25 12 12 20 20 20 20 10 10 10 10 10 10
						         20 20 20 10 04 18 18 18 0A 08 10 10 10 08 08 10 10 10 10 05 08 08 08 08 05];
		qcom,mdss-dsi-dc-on-command-state = "dsi_hs_mode";
		qcom,mdss-dsi-color-vbt-command = [
		                15 00 00 00 00 00 02 55 90];
		qcom,mdss-dsi-color-vbt-command-state = "dsi_lp_mode";
		qcom,mdss-dsi-color-std-command = [
		                15 00 00 00 00 00 02 55 90];
		qcom,mdss-dsi-color-std-command-state = "dsi_lp_mode";
		qcom,mdss-dsi-color-game-command = [
				15 00 00 00 00 00 02 55 80];
		qcom,mdss-dsi-color-game-command-state = "dsi_lp_mode";
		qcom,mdss-dsi-color-none-command = [
				15 00 00 00 00 00 02 55 90];
		qcom,mdss-dsi-color-none-command-state = "dsi_lp_mode";

		//qcom,mdss-dsi-acl-on-command = [
		//		39 01 00 00 00 00 06 F0 55 AA 52 08 00
		//		15 00 00 00 00 00 02 B0 0C
		//		15 01 00 00 00 00 02 55 05];
		//qcom,mdss-dsi-acl-off-command = [
		//		15 01 00 00 00 00 02 55 00];
*/
		qcom,mdss-dsi-display-timings {
			timing@0 {
				cell-index = <0>;
				qcom,mdss-dsi-panel-framerate = <120>;
				qcom,mdss-dsi-panel-width = <1080>;
				qcom,mdss-dsi-panel-height = <2400>;
				qcom,mdss-dsi-h-front-porch = <32>;
				qcom,mdss-dsi-h-back-porch = <32>;
				qcom,mdss-dsi-h-pulse-width = <32>;
				qcom,mdss-dsi-h-sync-skew = <0>;
				qcom,mdss-dsi-v-back-porch = <16>;
				qcom,mdss-dsi-v-front-porch = <12>;
				qcom,mdss-dsi-v-pulse-width = <4>;
				qcom,mdss-dsi-h-left-border = <0>;
				qcom,mdss-dsi-h-right-border = <0>;
				qcom,mdss-dsi-v-top-border = <0>;
				qcom,mdss-dsi-v-bottom-border = <0>;

				qcom,mdss-dsi-on-command = [
					39 01 00 00 00 00 33 70 11 00 00 AB 30 80 09 60 04 38 00 0C 02 1C 02 1C 02 00 02 0E 00 20 01 1F 00 07 00 0C 08 BB 08 7A 18 00 10 F0 07 10 20 00 06 0F 0F 33 0E 1C 2A 38 46 54
					39 01 00 00 00 00 02 65 32
					39 01 00 00 00 00 2D 70 62 69 70 77 79 7B 7D 7E 02 02 22 00 2A 40 2A BE 3A FC 3A FA 3A F8 3B 38 3B 78 3B B6 4B B6 4B F4 4B F4 6C 34 84 74 00 00 00 00 00 00
					39 01 00 00 00 00 02 53 20
					39 01 00 00 00 00 03 51 00 00
 					39 01 00 00 00 00 02 6F 01
					39 01 00 00 00 00 02 03 01
					39 01 00 00 00 00 02 35 00

					39 01 00 00 00 00 02 6C 02
					/*39 01 00 00 00 00 5E 70 11 00 00 89 30 80 09 60 04 38 00 0c 02 1c 02 1c 02 00 02 0e
								 00 20 01 1f 00 07 00 0c 08 bb 08 7a 18 00 10 f0 03 0c 20 00
								 06 0b 0b 33 0e 1c 2a 38 46 54 62 69 70 77 79 7b 7d 7e 01 02
								 01 00 09 40 09 be 19 fc 19 fa 19 f8 1a 38 1a 78 1a b6 2a b6
								 2a f4 2a f4 4b 34 63 74 00 00 00 00 00 00*/



					39 01 00 00 00 00 03 F0 AA 10
					39 01 00 00 00 00 06 CF 09 07 1D 1C 77
					39 01 00 00 00 00 03 F0 AA 12
					39 01 00 00 00 00 02 CA 00
					39 01 00 00 00 00 03 F0 AA 14
					39 01 00 00 00 00 0D B4 01 18 18 10 01 18 18 10 01 18 18 10
					39 01 00 00 00 00 03 F0 AA 18
					39 01 00 00 00 00 02 B0 00
					39 01 00 00 00 00 02 B2 00
					39 01 00 00 00 00 02 59 09
					39 01 00 00 00 00 03 FF 5A 81
					39 01 00 00 00 00 02 65 05
					39 01 00 00 00 00 02 F4 20

					05 01 00 00 78 00 01 11
					05 01 00 00 00 00 01 29
				];

				qcom,mdss-dsi-off-command = [
					05 01 00 00 14 00 02 28 00
					05 01 00 00 78 00 02 10 00];
				qcom,mdss-dsi-on-command-state = "dsi_lp_mode";
				qcom,mdss-dsi-off-command-state = "dsi_lp_mode";
				qcom,mdss-dsi-h-sync-pulse = <0>;
				qcom,compression-mode = "dsc";
				qcom,mdss-dsc-slice-height = <12>;
				qcom,mdss-dsc-slice-width = <540>;
				qcom,mdss-dsc-slice-per-pkt = <2>;
				qcom,mdss-dsc-bit-per-component = <8>;
				qcom,mdss-dsc-bit-per-pixel = <8>;
				qcom,mdss-dsc-block-prediction-enable;
			};
		};
	};
};
