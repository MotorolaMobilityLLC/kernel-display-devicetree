/* Copyright (c) 2019-2020, The Linux Foundation. All rights reserved.
 *
 * This program is free software; you can redistribute it and/or modify
 * it under the terms of the GNU General Public License version 2 and
 * only version 2 as published by the Free Software Foundation.
 *
 * This program is distributed in the hope that it will be useful,
 * but WITHOUT ANY WARRANTY; without even the implied warranty of
 * MERCHANTABILITY or FITNESS FOR A PARTICULAR PURPOSE.  See the
 * GNU General Public License for more details.
 */
&mdss_mdp {
mot_csot_nt37707_697_1224x2992_dsc_cmd_v1: qcom,mdss_dsi_mot_csot_nt37707_697_1224x2992_dsc_cmd_v1 {
compatible = "qcom,mdss-dsi-panel";
qcom,mdss-dsi-panel-name = "mipi_mot_cmd_csot_1224p_dsc_697";
qcom,mdss-dsi-panel-supplier = "csot";
qcom,mdss-dsi-panel-type = "dsi_cmd_mode";
qcom,mdss-dsi-virtual-channel-id = <0>;
qcom,mdss-dsi-stream = <0>;
qcom,mdss-pan-physical-width-dimension = <67>;
qcom,mdss-pan-physical-height-dimension = <164>;
qcom,mdss-dsi-bpp = <30>;
qcom,mdss-dsi-underflow-color = <0xff>;
qcom,mdss-dsi-border-color = <0>;

qcom,dsi-ctrl-num = <0>;
qcom,dsi-phy-num = <0>;

qcom,mdss-dsi-traffic-mode = "burst_mode";
qcom,mdss-dsi-bllp-eof-power-mode;
qcom,mdss-dsi-bllp-power-mode;
qcom,mdss-dsi-lane-0-state;
qcom,mdss-dsi-lane-1-state;
qcom,mdss-dsi-lane-2-state;
qcom,mdss-dsi-lane-3-state;

qcom,mdss-dsi-dma-trigger = "trigger_sw";
qcom,mdss-dsi-mdp-trigger = "none";
qcom,mdss-dsi-reset-sequence = <0 3>, <1 1>, <0 1>, <1 20>;
qcom,mdss-dsi-lp11-init;
qcom,mdss-dsi-tx-eot-append;
qcom,mdss-dsi-te-pin-select = <1>;
qcom,mdss-dsi-te-dcs-command = <1>;
qcom,mdss-dsi-te-using-te-pin;

//qcom,bklt-dcs-2bytes-enabled;
qcom,mdss-dsi-bl-min-level = <4>;
qcom,mdss-dsi-bl-max-level = <14056>;
qcom,mdss-dsi-bl-pmic-control-type = "bl_ctrl_dcs";

qcom,mdss-dsi-panel-hdr-enabled;
qcom,mdss-dsi-panel-hdr-color-primaries = <14500 15500 32000
	        17000 15500 30000 8000 3000>;
qcom,mdss-dsi-panel-peak-brightness = <4200000>;

qcom,mdss-dsi-panel-blackness-level = <3230>;

qcom,mdss-dsi-dc-off-command = [
		39 00 00 40 00 00 02 6F 01
		39 00 00 40 00 00 02 8B 00
		39 00 00 00 00 00 03 6D 00 00
		];

qcom,mdss-dsi-dc-off-command-state = "dsi_hs_mode";
qcom,mdss-dsi-dc-on-command = [
		39 00 00 40 00 00 02 6F 01
		39 00 00 40 00 00 02 8B 81
		39 00 00 00 00 00 03 6D 00 00
		];
qcom,mdss-dsi-dc-on-command-state = "dsi_hs_mode";
//qcom,mdss-dsi-nt37705-dc-detect-fps;
qcom,check_pcd;

qcom,mdss-dsi-display-timings {
	timing@0{
		qcom,mdss-dsi-cmd-mode;
		qcom,mdss-dsi-panel-framerate = <120>;
		qcom,mdss-dsi-panel-width = <1224>;
		qcom,mdss-dsi-panel-height = <2992>;
		qcom,mdss-dsi-h-front-porch = <16>;
		qcom,mdss-dsi-h-back-porch = <16>;
		qcom,mdss-dsi-h-pulse-width = <16>;
		qcom,mdss-dsi-h-sync-skew = <0>;
		qcom,mdss-dsi-h-sync-pulse = <0>;
		qcom,mdss-dsi-v-back-porch = <2>;
		qcom,mdss-dsi-v-front-porch = <2>;
		qcom,mdss-dsi-v-pulse-width = <2>;
		qcom,mdss-dsi-h-left-border = <0>;
		qcom,mdss-dsi-h-right-border = <0>;
		qcom,mdss-dsi-v-top-border = <0>;
		qcom,mdss-dsi-v-bottom-border = <0>;
		qcom,mdss-dsi-timing-switch-command = [
			39 00 00 40 00 00 02 6F 04
			39 00 00 40 00 00 02 35 00 //TE1=0
			39 00 00 40 00 00 02 53 20 //DBV Diming Disable
			39 00 00 00 00 00 02 2F 02 //120hz
		];
		qcom,mdss-dsi-on-command = [
			39 00 00 40 00 00 02 5A 01
			39 00 00 40 00 00 05 FF AA 55 A5 81
			39 00 00 40 00 00 02 6F 0B
			39 00 00 40 00 00 02 FD 04
			39 00 00 40 00 00 05 FF AA 55 A5 80
			39 00 00 40 00 00 02 6F 32
			39 00 00 40 00 00 02 F9 00
			39 00 00 40 00 00 06 F0 55 AA 52 08 01
			39 00 00 40 00 00 02 E5 00
			39 00 00 40 00 00 05 FF AA 55 A5 81
			39 00 00 40 00 00 02 6F 02
			39 00 00 40 00 00 02 F9 04
			39 00 00 40 00 00 05 FF AA 55 A5 81
			39 00 00 40 00 00 02 6F 0C
			39 00 00 40 00 00 02 FD 08
			39 00 00 40 00 00 05 FF AA 55 A5 81
			39 00 00 40 00 00 02 6F 10
			39 00 00 40 00 00 02 FB 40
			39 00 00 40 00 00 05 FF AA 55 A5 81
			39 00 00 40 00 00 02 6F 05
			39 00 00 40 00 00 03 FE 3C 3C
			39 00 00 40 00 00 05 FF AA 55 A5 80
			39 00 00 40 00 00 02 6F 42
			39 00 00 40 00 00 02 F4 00
			39 00 00 40 00 00 02 6F 49
			39 00 00 40 00 00 02 F2 10
			39 00 00 40 00 00 05 FF AA 55 A5 81
			39 00 00 40 00 00 02 6F 05
			39 00 00 40 00 00 03 FE 3C 3C
			39 00 00 40 00 00 05 FF AA 55 A5 80
			39 00 00 40 00 00 02 6F 0A
			39 00 00 40 00 00 06 F6 70 70 70 70 70
			39 00 00 40 00 00 05 FF AA 55 A5 80
			39 00 00 40 00 00 02 6F 16
			39 00 00 40 00 00 03 F4 02 74
			39 00 00 40 00 00 05 FF AA 55 A5 81
			39 00 00 40 00 00 02 6F 0D
			39 00 00 40 00 00 02 FB 80
			39 00 00 40 00 00 02 17 10
			39 00 00 40 00 00 05 2A 00 00 04 C7
			39 00 00 40 00 00 05 2B 00 00 0B AF
			39 00 00 40 00 00 02 2F 02
			39 00 00 40 00 00 03 5F 00 00
			39 00 00 40 00 00 02 35 00
			39 00 00 40 00 00 03 51 00 00
			39 00 00 40 00 00 02 6F 04
			39 00 00 40 00 00 03 51 00 00
			39 00 00 40 00 00 02 53 20
			39 00 00 40 00 00 02 90 03
			39 00 00 40 00 00 02 6F 01
			39 00 00 40 00 00 02 90 43
			39 00 00 40 00 00 13 91 AB 28 00 10 C2 00 02 32 01 9C 00 08 06 67 05 9C 10 F0
			39 00 00 40 00 00 05 FF AA 55 A5 80
			39 00 00 40 00 00 02 6F 31
			39 00 00 40 00 00 03 F8 01 8C
			39 00 00 40 00 00 06 F0 55 AA 52 08 01
			39 00 00 40 00 00 02 6F 02
			39 00 00 40 00 00 03 C7 00 00
			39 00 00 00 00 00 02 26 00
                	05 00 00 00 78 00 01 11
                	05 00 00 00 00 00 01 29];	/* display on */
		qcom,mdss-dsi-off-command = [
			05 00 00 00 00 00 01 28		/* display_off */
			05 00 00 00 64 00 01 10];	/* enter sleep mode */

		qcom,mdss-dsi-on-command-state = "dsi_lp_mode";
		qcom,mdss-dsi-off-command-state = "dsi_lp_mode";
		qcom,mdss-dsi-timing-switch-command-state =
			"dsi_hs_mode";
		qcom,compression-mode = "dsc";
		/* Why QCOM doesn't use this, even it used 2 encoder
		 * as for that dsi_sw43404_amoled_cmd, for ex */
		/* qcom,mdss-dsc-encoders = <2>; */
		qcom,mdss-dsc-version = <0x11>;
		qcom,mdss-dsc-slice-height = <16>;
		qcom,mdss-dsc-slice-width = <612>;
		qcom,mdss-dsc-slice-per-pkt = <2>;
		qcom,mdss-dsc-bit-per-component = <10>;
		qcom,mdss-dsc-bit-per-pixel = <8>;
		qcom,mdss-dsc-block-prediction-enable;
		qcom,mdss-dsc-novateck-ic;
		qcom,mdss-dsi-pcd-check-enable-command = [
			39 00 00 40 00 00 06 F0 55 AA 52 08 06
			39 00 00 40 00 00 03 B1 35 35
			39 00 00 40 00 00 02 6F 01
			39 00 00 40 00 00 02 B2 37
			39 00 00 40 00 00 03 B7 35 35
			39 00 00 40 00 00 02 6F 01
			39 00 00 40 00 00 02 B8 37
			39 00 00 40 00 00 05 FF AA 55 A5 80
			39 00 00 40 00 00 02 6F 12
			39 00 00 40 00 00 04 F4 01 0C 11
			39 00 00 00 00 00 02 9B 00];

		qcom,mdss-dsi-pcd-check-enable-command-state = "dsi_hs_mode";
		qcom,mdss-dsi-pcd-check-disable-command = [
			39 00 00 40 00 00 06 F0 55 AA 52 08 06
			39 00 00 40 00 00 03 B1 37 37
			39 00 00 40 00 00 02 6F 01
			39 00 00 40 00 00 02 B2 36
			39 00 00 40 00 00 03 B7 37 37
			39 00 00 40 00 00 02 6F 01
			39 00 00 40 00 00 02 B8 36
			39 00 00 40 00 00 05 FF AA 55 A5 80
			39 00 00 40 00 00 02 6F 12
			39 00 00 40 00 00 04 F4 00 00 00
			39 00 00 00 00 00 02 9B 01];
		qcom,mdss-dsi-pcd-check-disable-command-state = "dsi_hs_mode";
	};
};

};

};
