/* Copyright (c) 2019-2020, The Linux Foundation. All rights reserved.
 *
 * This program is free software; you can redistribute it and/or modify
 * it under the terms of the GNU General Public License version 2 and
 * only version 2 as published by the Free Software Foundation.
 *
 * This program is distributed in the hope that it will be useful,
 * but WITHOUT ANY WARRANTY; without even the implied warranty of
 * MERCHANTABILITY or FITNESS FOR A PARTICULAR PURPOSE.  See the
 * GNU General Public License for more details.
 */
&mdss_mdp {
mot_csot_nt37705_667_curve_1080x2400_dsc_cmd_v0: qcom,mdss_dsi_mot_csot_nt37705_667_curve_1080x2400_dsc_cmd_v0 {
compatible = "qcom,mdss-dsi-panel";
qcom,mdss-dsi-panel-name = "mipi_mot_cmd_csot_1080p_dsc_667";
qcom,mdss-dsi-panel-supplier = "csot";
qcom,mdss-dsi-panel-type = "dsi_cmd_mode";
qcom,mdss-dsi-virtual-channel-id = <0>;
qcom,mdss-dsi-stream = <0>;
qcom,mdss-pan-physical-width-dimension = <69>;
qcom,mdss-pan-physical-height-dimension = <154>;
qcom,mdss-dsi-bpp = <30>;
qcom,mdss-dsi-underflow-color = <0xff>;
qcom,mdss-dsi-border-color = <0>;

qcom,dsi-ctrl-num = <0>;
qcom,dsi-phy-num = <0>;

qcom,mdss-dsi-traffic-mode = "burst_mode";
qcom,mdss-dsi-bllp-eof-power-mode;
qcom,mdss-dsi-bllp-power-mode;
qcom,mdss-dsi-lane-0-state;
qcom,mdss-dsi-lane-1-state;
qcom,mdss-dsi-lane-2-state;
qcom,mdss-dsi-lane-3-state;

qcom,mdss-dsi-dma-trigger = "trigger_sw";
qcom,mdss-dsi-mdp-trigger = "none";
qcom,mdss-dsi-reset-sequence = <0 11>, <1 1>, <0 1>, <1 11>;
qcom,mdss-dsi-lp11-init;
qcom,mdss-dsi-tx-eot-append;
qcom,mdss-dsi-te-pin-select = <1>;
qcom,mdss-dsi-te-dcs-command = <1>;
qcom,mdss-dsi-te-using-te-pin;

//qcom,bklt-dcs-2bytes-enabled;
qcom,mdss-dsi-bl-min-level = <4>;
qcom,mdss-dsi-bl-max-level = <14056>;
qcom,mdss-dsi-bl-pmic-control-type = "bl_ctrl_dcs";

qcom,mdss-dsi-panel-hdr-enabled;
qcom,mdss-dsi-panel-hdr-color-primaries = <14500 15500 32000
	        17000 15500 30000 8000 3000>;
qcom,mdss-dsi-panel-peak-brightness = <4200000>;

qcom,mdss-dsi-panel-blackness-level = <3230>;


qcom,mdss-dsi-hbm-on-command = [
		39 00 00 00 00 00 03 51 3F FC
		39 00 00 00 00 00 02 87 00];

qcom,mdss-dsi-hbm-off-command = [
		39 00 00 00 00 00 02 87 00];

qcom,mdss-dsi-display-timings {
	timing@0{
		qcom,mdss-dsi-cmd-mode;
		qcom,mdss-dsi-panel-framerate = <60>;
		qcom,mdss-dsi-panel-width = <1080>;
		qcom,mdss-dsi-panel-height = <2640>;
		qcom,mdss-dsi-h-front-porch = <32>;
		qcom,mdss-dsi-h-back-porch = <32>;
		qcom,mdss-dsi-h-pulse-width = <16>;
		qcom,mdss-dsi-h-sync-skew = <0>;
		qcom,mdss-dsi-h-sync-pulse = <0>;
		qcom,mdss-dsi-v-back-porch = <4>;
		qcom,mdss-dsi-v-front-porch = <12>;
		qcom,mdss-dsi-v-pulse-width = <4>;
		qcom,mdss-dsi-h-left-border = <0>;
		qcom,mdss-dsi-h-right-border = <0>;
		qcom,mdss-dsi-v-top-border = <0>;
		qcom,mdss-dsi-v-bottom-border = <0>;
		qcom,mdss-dsi-panel-jitter = <0x20 0xa>; /* 90fps +/- 2 */
		qcom,mdss-dsi-on-command = [
                        39 01 00 00 00 00 06 F0 55 AA 52 08 01
                        39 01 00 00 00 00 02 6F 05
                        39 01 00 00 00 00 04 C5 15 15 15
                        39 01 00 00 00 00 06 F0 55 AA 52 08 08
                        39 01 00 00 00 00 02 6F 36
                        39 01 00 00 00 00 15 B8 00 00 00 00 00 00 00 00 00 00 00 00 00 00 00 00 00 00 00 00
                        39 01 00 00 00 00 06 F0 55 AA 52 08 07
                        39 01 00 00 00 00 03 B3 00 00
                        39 01 00 00 00 00 05 FF AA 55 A5 81
                        39 01 00 00 00 00 02 6F 0E
                        39 01 00 00 00 00 02 F5 2B
                        39 01 00 00 00 00 06 F0 55 AA 52 08 00
                        39 01 00 00 00 00 02 6F 02
                        39 01 00 00 00 00 02 B5 55
                        39 01 00 00 00 00 05 FF AA 55 A5 83
                        39 01 00 00 00 00 02 6F 12
                        39 01 00 00 00 00 02 FE 41
                        39 01 00 00 00 00 06 F0 55 AA 52 08 01
                        39 01 00 00 00 00 02 6F 08
                        39 01 00 00 00 00 05 B4 00 00 00 00
                        39 01 00 00 00 00 05 FF AA 55 A5 80
                        39 01 00 00 00 00 02 6F 19
                        39 01 00 00 00 00 02 F2 00
                        39 01 00 00 00 00 05 FF AA 55 A5 81
                        39 01 00 00 00 00 02 6F 02
                        39 01 00 00 00 00 02 F9 04
                        39 01 00 00 00 00 06 F0 55 AA 52 08 00
                        39 01 00 00 00 00 02 6F 03
                        39 01 00 00 00 00 02 B5 05
                        39 01 00 00 00 00 06 F0 55 AA 52 08 01
                        39 01 00 00 00 00 02 6F 05
                        39 01 00 00 00 00 05 C5 15 15 15 DD
                        39 01 00 00 00 00 06 F0 55 AA 52 08 00
                        39 01 00 00 00 00 02 6F 0B
                        39 01 00 00 00 00 02 C2 11
                        39 01 00 00 00 00 02 B0 00
                        39 01 00 00 00 00 06 F0 55 AA 52 08 00
                        39 01 00 00 00 00 02 6F 20
                        39 01 00 00 00 00 09 C6 55 55 55 55 55 55 55 55
                        39 01 00 00 00 00 05 FF AA 55 A5 81
                        39 01 00 00 00 00 02 6F 19
                        39 01 00 00 00 00 02 FB 00
                        39 01 00 00 00 00 05 FF AA 55 A5 80
                        39 01 00 00 00 00 02 6F 1A
                        39 01 00 00 00 00 02 F4 55
                        39 01 00 00 00 00 05 FF AA 55 A5 83
                        39 01 00 00 00 00 02 6F 12
                        39 01 00 00 00 00 02 FE 41
                        39 01 00 00 00 00 05 FF AA 55 A5 80
                        39 01 00 00 00 00 02 6F 18
                        39 01 00 00 00 00 02 F4 30
                        39 01 00 00 00 00 05 FF AA 55 A5 80
                        39 01 00 00 00 00 02 6F 31
                        39 01 00 00 00 00 03 F8 01 2B
                        39 01 00 00 00 00 05 FF AA 55 A5 80
                        39 01 00 00 00 00 02 6F 15
                        39 01 00 00 00 00 03 F8 01 8E
                        39 01 00 00 00 00 05 FF AA 55 A5 80
                        39 01 00 00 00 00 02 6F 0A
                        39 01 00 00 00 00 06 F6 60 60 60 50 60
                        39 01 00 00 00 00 05 FF AA 55 A5 81
                        39 01 00 00 00 00 02 6F 1E
                        39 01 00 00 00 00 02 FB 0F
                        39 01 00 00 00 00 05 FF AA 55 A5 81
                        39 01 00 00 00 00 02 6F 05
                        39 01 00 00 00 00 02 FE 34
                        39 01 00 00 00 00 02 17 10
                        39 01 00 00 00 00 05 2A 00 00 04 37
                        39 01 00 00 00 00 05 2B 00 00 0A 4F
                        39 01 00 00 00 00 02 2F 01
                        39 01 00 00 00 00 02 5F 80
                        39 01 00 00 00 00 02 35 00
                        39 01 00 00 00 00 03 51 00 00
                        39 01 00 00 00 00 02 6F 04
                        39 01 00 00 00 00 03 51 00 00
                        39 01 00 00 00 00 02 53 20
                        39 01 00 00 00 00 03 90 03 03
                        39 01 00 00 00 00 13 91 AB 28 00 0C D2 00 02 25 01 14 00 07 09 75 08 7A 10 F0
                        39 01 00 00 00 00 06 F0 55 AA 52 08 01
                        39 01 00 00 00 00 02 6F 02
                        39 01 00 00 00 00 03 C7 00 00
                        39 01 00 00 00 00 02 26 00
                        39 01 00 00 00 00 02 1F 40
                        05 01 00 00 78 00 01 11
                        05 01 00 00 00 00 01 29];	/* display on */
		qcom,mdss-dsi-off-command = [
			05 01 00 00 00 00 01 28		/* display_off */
			05 01 00 00 78 00 01 10];	/* enter sleep mode */

		qcom,mdss-dsi-on-command-state = "dsi_lp_mode";
		qcom,mdss-dsi-off-command-state = "dsi_lp_mode";
		qcom,mdss-dsi-timing-switch-command-state =
			"dsi_lp_mode";
		qcom,compression-mode = "dsc";
		/* Why QCOM doesn't use this, even it used 2 encoder
		 * as for that dsi_sw43404_amoled_cmd, for ex */
		/* qcom,mdss-dsc-encoders = <2>; */
		qcom,mdss-dsc-version = <0x11>;
		qcom,mdss-dsc-slice-height = <12>;
		qcom,mdss-dsc-slice-width = <540>;
		qcom,mdss-dsc-slice-per-pkt = <2>;
		qcom,mdss-dsc-bit-per-component = <10>;
		qcom,mdss-dsc-bit-per-pixel = <8>;
		qcom,mdss-dsc-block-prediction-enable;
	};

};

};

};
