/dts-v1/;
/plugin/;

#include "trustedvm-crow-sde.dtsi"
#include "trustedvm-crow-sde-display-rumi.dtsi"

/ {
	model = "Qualcomm Technologies, Inc. Crow RUMI - TrustedVM";
	compatible = "qcom,crow-rumi", "qcom,crow", "qcom,rumi";
	qcom,msm-id = <608 0x10000>;
	qcom,board-id = <15 0>;
};
