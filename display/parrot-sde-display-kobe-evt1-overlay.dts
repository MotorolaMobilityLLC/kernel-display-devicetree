/dts-v1/;
/plugin/;

#include "parrot-sde-display-kobe-common.dtsi"

/ {
	model = "kobe";
	compatible = "qcom,parrot-qrd", "qcom,parrot", "qcom,qrd", "moto,kobe";
	qcom,msm-id = <663 0x10000>;
	qcom,board-id = <0x45 0xA100>,<0x45 0xB100>;
};

