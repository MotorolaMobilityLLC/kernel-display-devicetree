
/* Copyright (c) 2019-2020, The Linux Foundation. All rights reserved.
 *
 * This program is free software; you can redistribute it and/or modify
 * it under the terms of the GNU General Public License version 2 and
 * only version 2 as published by the Free Software Foundation.
 *
 * This program is distributed in the hope that it will be useful,
 * but WITHOUT ANY WARRANTY; without even the implied warranty of
 * MERCHANTABILITY or FITNESS FOR A PARTICULAR PURPOSE.  See the
 * GNU General Public License for more details.
 */

&mot_csot_vtdr6126_667_1220p_dsc_vid_120hz_v1 {
qcom,mdss-dsi-panel-local-hbm-alpha-table = <
0
0
0
0
514
514
514
514
514
514
514
514
514
514
514
514
514
514
514
514
514
514
514
518
518
518
518
518
518
518
518
518
518
518
518
522
522
522
522
522
522
522
522
522
522
522
522
522
522
522
522
522
522
526
526
526
526
526
526
526
526
526
526
526
526
526
526
526
526
526
526
526
526
526
526
526
526
526
526
526
526
526
526
526
526
526
526
530
530
530
530
530
530
530
530
530
530
534
534
534
534
534
534
534
534
534
538
538
538
538
538
538
538
538
538
538
538
538
538
538
538
538
538
538
538
538
538
538
538
538
538
538
538
542
542
542
542
542
542
542
542
542
542
542
542
542
542
542
542
542
542
542
542
542
542
542
542
542
542
546
546
550
550
550
550
550
550
550
550
550
550
550
550
550
550
550
550
550
550
550
550
550
550
550
550
550
550
550
550
550
550
550
550
554
554
554
554
554
554
554
554
554
554
554
554
554
554
554
554
554
554
554
554
554
554
554
554
554
554
554
554
558
558
558
558
562
562
562
562
562
562
562
562
562
562
562
562
562
562
562
562
562
562
562
562
562
562
562
562
562
562
562
566
566
566
566
566
566
566
566
566
566
566
566
566
566
566
566
566
566
566
566
566
566
566
566
566
566
566
566
570
570
570
574
574
574
574
574
574
574
574
574
574
574
574
574
574
574
578
578
578
578
578
578
578
578
578
578
578
578
578
578
578
578
578
578
578
578
578
578
578
578
578
578
582
582
582
582
582
582
582
582
582
582
582
582
582
582
582
582
582
582
582
582
586
590
590
590
590
590
590
590
590
590
590
590
590
590
590
590
590
590
590
590
590
590
590
590
590
590
590
590
594
594
594
594
594
594
594
594
594
594
594
594
594
594
594
594
594
594
594
594
594
594
594
598
598
598
598
598
598
598
598
598
598
598
602
602
602
606
606
606
606
606
606
606
606
606
606
606
606
606
606
606
606
606
606
610
610
610
610
610
610
610
610
610
610
610
610
610
610
610
610
610
610
610
610
610
610
610
610
610
610
610
614
614
614
614
614
614
614
614
614
614
614
614
614
614
618
618
618
618
618
622
622
622
622
622
622
622
622
622
622
622
622
622
622
622
622
622
622
622
622
622
622
622
622
622
622
622
626
626
626
626
626
626
626
626
626
626
626
626
626
626
626
626
626
626
626
626
626
626
626
626
626
630
630
630
630
630
634
634
634
634
634
634
634
634
634
634
634
634
634
634
638
638
638
638
638
638
638
638
638
638
638
638
638
638
638
638
638
638
638
638
638
643
643
643
643
643
643
643
643
643
643
643
643
643
643
643
643
643
643
643
643
643
643
643
643
643
643
651
651
651
651
651
651
651
651
651
651
651
651
651
651
651
651
651
651
651
651
651
655
655
655
655
655
655
655
655
655
655
655
655
655
655
655
655
655
655
655
655
655
655
655
655
655
655
655
655
655
655
655
655
655
655
655
659
659
659
659
659
659
663
663
663
663
663
663
663
663
663
663
667
667
667
667
667
667
667
667
667
667
667
667
667
667
667
667
667
667
667
667
667
667
671
671
671
671
671
671
671
671
671
671
671
671
671
671
671
671
671
671
671
671
671
671
671
671
671
671
671
675
675
675
679
679
679
679
679
679
679
679
679
679
679
679
679
679
679
679
683
683
683
683
683
683
683
683
683
683
683
683
683
683
683
683
683
683
683
683
683
683
683
687
687
687
687
687
687
687
687
687
687
687
687
687
687
687
687
687
687
687
687
687
687
691
695
695
695
695
695
695
695
695
695
695
695
695
695
695
695
695
695
695
695
695
699
699
699
699
699
699
699
699
699
699
699
699
699
699
699
699
699
699
699
699
699
699
699
699
699
703
703
703
703
703
703
703
703
703
703
703
703
703
703
703
703
703
707
707
711
711
711
711
711
711
711
711
711
711
711
711
711
711
711
711
711
711
711
711
711
715
715
715
715
715
715
715
715
715
715
715
715
715
715
715
715
715
715
715
715
715
715
715
715
715
715
715
715
715
715
715
719
719
719
719
719
719
719
723
723
723
723
723
723
723
723
723
723
723
723
723
723
727
727
727
727
727
727
727
727
727
727
727
727
727
727
727
727
727
727
727
727
727
727
727
727
727
727
727
727
731
731
731
731
731
731
731
731
731
731
731
731
731
731
731
731
731
731
731
731
735
735
739
739
739
739
739
739
739
739
739
739
739
739
739
739
739
739
739
739
739
739
739
739
739
739
739
739
739
743
743
743
743
743
743
743
743
743
743
743
743
743
743
743
743
743
743
743
743
743
743
743
743
743
747
747
747
747
747
747
747
747
751
751
751
751
751
751
751
751
751
751
751
751
751
751
751
751
751
751
751
755
755
755
755
755
755
755
755
755
755
755
755
755
755
755
755
755
755
755
755
755
759
759
759
759
759
759
759
759
759
759
759
759
759
759
759
759
759
759
759
763
763
763
767
767
767
767
767
767
767
771
771
771
771
771
771
771
771
771
771
771
771
771
771
771
771
771
771
771
771
771
771
771
775
775
775
775
775
775
779
779
779
779
779
779
779
779
779
779
779
779
787
787
787
787
787
787
787
787
787
787
787
791
791
791
791
791
791
791
795
795
795
795
795
799
799
799
799
799
799
799
799
799
799
799
799
803
803
803
803
803
803
803
803
803
807
807
811
811
811
811
811
811
811
811
811
811
811
811
815
815
815
815
815
815
815
815
815
815
815
823
823
823
823
823
823
823
823
823
823
823
823
827
827
827
827
827
827
827
827
827
827
827
835
835
835
835
835
835
835
835
835
835
835
835
839
839
839
839
839
839
839
839
839
839
839
843
843
843
847
847
847
847
847
847
847
847
847
851
851
851
851
851
851
851
851
851
851
851
851
855
855
855
855
855
855
855
855
855
855
855
863
863
863
863
863
863
863
863
863
863
863
863
867
867
867
867
867
867
867
867
867
867
867
871
871
871
871
871
871
875
875
875
875
875
875
879
879
879
879
879
879
879
879
879
879
879
883
883
883
883
883
883
883
883
883
883
883
887
891
891
891
891
891
891
891
891
891
891
891
895
895
895
895
895
895
895
895
895
895
895
895
900
900
904
904
904
904
904
904
904
904
904
904
908
908
908
908
908
908
908
908
908
908
908
912
912
912
912
912
912
912
912
912
912
912
912
916
920
920
920
920
920
920
920
920
920
920
924
924
924
924
924
924
924
924
924
924
924
924
928
928
928
928
928
928
928
928
928
928
928
932
932
932
932
932
932
932
932
932
932
932
936
936
936
936
936
936
936
936
940
940
940
940
944
944
944
944
944
944
944
944
944
944
944
944
948
948
948
948
948
948
948
948
948
948
948
948
952
952
952
952
952
952
952
952
952
952
952
956
956
956
956
956
956
956
956
956
956
956
956
960
960
960
960
960
960
960
960
960
960
964
968
968
968
968
968
968
968
968
968
968
968
968
968
968
968
968
972
972
972
972
972
972
972
972
972
972
976
976
976
976
976
976
976
976
976
980
980
980
980
980
980
980
980
980
980
980
984
984
984
984
984
984
984
984
984
984
984
984
988
988
988
988
988
988
988
988
988
988
988
988
992
992
992
992
992
992
992
992
992
992
992
996
996
996
996
996
996
996
996
996
1000
1000
1000
1000
1000
1000
1000
1000
1000
1000
1000
1000
1000
1004
1004
1004
1004
1004
1004
1004
1004
1004
1008
1008
1008
1008
1008
1012
1012
1012
1012
1012
1012
1012
1012
1012
1012
1016
1016
1016
1016
1016
1016
1016
1016
1016
1016
1016
1016
1020
1020
1020
1020
1020
1020
1020
1020
1020
1020
1020
1024
1024
1024
1024
1024
1024
1024
1024
1024
1024
1024
1024
1028
1028
1028
1028
1028
1028
1028
1032
1032
1032
1032
1032
1036
1036
1036
1036
1036
1036
1036
1036
1036
1036
1036
1040
1040
1040
1040
1040
1040
1040
1040
1040
1040
1040
1040
1044
1044
1044
1044
1044
1044
1044
1044
1044
1044
1044
1048
1048
1048
1052
1052
1052
1052
1052
1052
1052
1052
1052
1056
1056
1056
1056
1056
1056
1056
1056
1060
1060
1060
1060
1060
1064
1064
1064
1064
1064
1068
1068
1068
1072
1072
1072
1072
1072
1072
1072
1076
1076
1076
1076
1076
1080
1080
1080
1080
1080
1084
1084
1084
1084
1084
1088
1088
1088
1088
1088
1092
1092
1092
1092
1092
1096
1096
1096
1096
1096
1096
1096
1100
1100
1100
1100
1100
1100
1100
1104
1104
1104
1104
1108
1108
1108
1108
1108
1108
1112
1112
1112
1112
1112
1116
1116
1116
1116
1116
1120
1120
1120
1120
1120
1120
1124
1124
1124
1124
1124
1124
1124
1128
1128
1128
1128
1128
1128
1128
1132
1132
1132
1132
1132
1132
1132
1132
1132
1132
1136
1136
1136
1136
1136
1140
1140
1140
1140
1140
1140
1140
1140
1140
1140
1144
1144
1144
1144
1144
1148
1148
1148
1148
1148
1148
1153
1153
1153
1153
1153
1153
1153
1153
1157
1157
1157
1157
1157
1161
1161
1161
1161
1161
1165
1165
1165
1165
1165
1165
1165
1169
1169
1169
1169
1169
1169
1169
1169
1173
1173
1173
1173
1173
1177
1177
1177
1177
1177
1177
1181
1181
1181
1181
1181
1181
1181
1181
1181
1185
1185
1185
1185
1185
1185
1185
1185
1185
1189
1189
1189
1189
1189
1193
1193
1193
1193
1193
1193
1193
1193
1197
1197
1197
1197
1197
1197
1197
1197
1201
1201
1201
1201
1201
1205
1205
1205
1205
1205
1205
1205
1205
1205
1209
1209
1209
1209
1209
1209
1213
1213
1213
1213
1217
1217
1217
1217
1217
1217
1221
1221
1221
1221
1221
1221
1221
1221
1221
1225
1225
1225
1225
1225
1225
1225
1225
1225
1225
1229
1229
1229
1229
1229
1233
1233
1233
1233
1233
1233
1233
1233
1233
1233
1237
1237
1237
1237
1237
1237
1237
1237
1237
1241
1241
1241
1241
1241
1241
1245
1245
1245
1245
1245
1245
1245
1245
1245
1245
1245
1245
1245
1249
1249
1249
1249
1249
1249
1249
1253
1253
1253
1253
1253
1253
1253
1253
1253
1253
1257
1257
1257
1257
1257
1257
1257
1257
1257
1261
1261
1261
1261
1261
1261
1261
1261
1261
1265
1265
1265
1265
1265
1265
1265
1265
1265
1265
1265
1269
1269
1269
1269
1269
1269
1273
1273
1273
1273
1277
1277
1277
1277
1277
1277
1277
1277
1277
1277
1281
1281
1281
1281
1281
1281
1285
1285
1285
1285
1285
1285
1285
1285
1289
1289
1289
1289
1289
1289
1289
1289
1289
1289
1293
1293
1293
1293
1293
1293
1297
1297
1297
1297
1297
1297
1297
1297
1297
1301
1301
1301
1301
1301
1301
1301
1301
1301
1301
1301
1305
1305
1305
1305
1305
1309
1309
1309
1309
1309
1309
1309
1313
1313
1313
1313
1313
1313
1313
1313
1313
1313
1317
1317
1317
1317
1317
1317
1317
1321
1321
1321
1321
1321
1325
1325
1325
1325
1325
1325
1325
1325
1325
1325
1325
1329
1329
1329
1329
1329
1329
1329
1329
1333
1333
1333
1333
1333
1333
1333
1337
1337
1337
1337
1337
1337
1337
1337
1337
1337
1337
1341
1341
1341
1341
1341
1341
1341
1341
1341
1341
1341
1341
1341
1341
1345
1345
1345
1345
1345
1345
1345
1345
1345
1349
1349
1349
1349
1349
1349
1349
1349
1353
1353
1353
1353
1353
1353
1353
1353
1353
1353
1357
1357
1357
1357
1357
1357
1357
1357
1357
1361
1361
1361
1361
1361
1361
1361
1361
1361
1361
1361
1361
1365
1365
1365
1365
1365
1365
1365
1365
1365
1365
1369
1369
1369
1369
1369
1373
1373
1373
1373
1373
1373
1373
1373
1373
1377
1377
1377
1377
1377
1377
1377
1377
1377
1377
1377
1381
1381
1381
1381
1381
1381
1385
1385
1385
1385
1385
1385
1385
1385
1385
1385
1385
1385
1385
1385
1389
1389
1389
1389
1389
1389
1389
1389
1389
1393
1393
1393
1393
1393
1393
1393
1393
1393
1397
1397
1397
1397
1397
1397
1397
1397
1397
1397
1397
1401
1401
1401
1401
1401
1401
1401
1401
1401
1405
1405
1405
1405
1405
1405
1405
1405
1405
1405
1405
1405
1410
1410
1410
1410
1410
1410
1410
1410
1410
1414
1414
1414
1414
1414
1414
1414
1414
1414
1414
1418
1418
1418
1418
1418
1418
1418
1418
1418
1422
1422
1422
1422
1422
1422
1422
1422
1422
1422
1422
1426
1426
1426
1426
1426
1426
1426
1426
1426
1426
1430
1430
1430
1430
1430
1430
1430
1430
1430
1430
1430
1430
1434
1434
1434
1434
1434
1434
1434
1434
1434
1434
1434
1438
1438
1438
1438
1438
1438
1438
1438
1438
1438
1438
1438
1442
1442
1442
1442
1442
1442
1442
1442
1442
1442
1446
1446
1446
1446
1446
1446
1446
1450
1450
1450
1450
1450
1450
1450
1450
1450
1450
1450
1450
1450
1450
1454
1454
1454
1454
1454
1454
1454
1454
1454
1458
1458
1458
1458
1458
1458
1458
1462
1462
1462
1462
1462
1462
1462
1466
1466
1466
1466
1466
1466
1466
1466
1470
1470
1470
1470
1470
1474
1474
1474
1474
1474
1474
1478
1478
1478
1478
1478
1478
1478
1482
1482
1482
1482
1482
1482
1482
1482
1482
1486
1486
1486
1486
1486
1486
1486
1490
1490
1490
1490
1490
1490
1490
1490
1494
1494
1494
1494
1494
1494
1494
1494
1494
1498
1498
1498
1498
1498
1498
1502
1502
1502
1502
1502
1502
1502
1502
1506
1506
1506
1506
1506
1506
1510
1510
1510
1510
1510
1510
1510
1510
1510
1514
1514
1514
1514
1514
1514
1514
1518
1518
1518
1518
1518
1522
1522
1522
1522
1522
1522
1522
1526
1526
1526
1526
1526
1526
1526
1530
1530
1530
1530
1530
1530
1534
1534
1534
1534
1534
1534
1534
1538
1538
1538
1538
1538
1538
1538
1542
1542
1542
1542
1542
1542
1542
1542
1546
1546
1546
1546
1546
1546
1546
1546
1550
1550
1550
1550
1550
1554
1554
1554
1554
1554
1554
1554
1558
1558
1558
1558
1558
1558
1558
1558
1562
1562
1562
1562
1566
1566
1566
1566
1566
1566
1566
1566
1566
1570
1570
1570
1570
1570
1570
1570
1570
1570
1574
1574
1574
1574
1574
1574
1578
1578
1578
1578
1578
1578
1578
1582
1582
1582
1582
1582
1582
1586
1586
1586
1586
1586
1586
1586
1590
1590
1590
1590
1594
1594
1594
1594
1594
1594
1594
1594
1598
1598
1598
1598
1598
1602
1602
1602
1602
1602
1602
1602
1606
1606
1606
1606
1606
1606
1606
1610
1610
1610
1610
1610
1610
1610
1614
1614
1614
1614
1614
1614
1614
1618
1618
1618
1618
1618
1622
1622
1622
1622
1622
1622
1622
1622
1626
1626
1626
1626
1626
1626
1626
1626
1630
1630
1630
1630
1630
1630
1630
1634
1634
1634
1634
1634
1634
1634
1634
1638
1638
1638
1638
1638
1638
1638
1638
1642
1642
1642
1642
1642
1642
1642
1646
1646
1646
1646
1646
1646
1646
1646
1650
1650
1650
1650
1650
1650
1650
1650
1650
1650
1650
1654
1654
1654
1654
1654
1654
1654
1658
1658
1658
1658
1658
1658
1662
1662
1662
1662
1662
1662
1662
1667
1667
1667
1667
1667
1667
1667
1671
1671
1671
1671
1671
1671
1671
1671
1675
1675
1675
1675
1679
1679
1679
1679
1679
1679
1679
1679
1679
1683
1683
1683
1683
1683
1683
1683
1687
1687
1687
1687
1687
1687
1687
1687
1687
1691
1691
1691
1691
1691
1691
1691
1691
1695
1695
1695
1695
1695
1695
1695
1695
1695
1699
1699
1699
1699
1699
1699
1699
1703
1703
1703
1703
1703
1703
1703
1707
1707
1707
1707
1707
1707
1711
1711
1711
1711
1711
1715
1715
1715
1715
1715
1715
1719
1719
1719
1719
1719
1719
1719
1723
1723
1723
1723
1723
1723
1723
1723
1723
1723
1723
1727
1727
1727
1727
1727
1727
1727
1731
1731
1731
1731
1731
1735
1735
1735
1735
1735
1735
1735
1735
1735
1735
1739
1739
1739
1739
1739
1739
1739
1739
1739
1743
1743
1743
1743
1743
1743
1743
1743
1747
1747
1747
1747
1747
1751
1751
1751
1751
1751
1751
1751
1751
1751
1755
1755
1755
1755
1755
1755
1755
1755
1759
1759
1759
1759
1759
1759
1759
1759
1759
1763
1763
1763
1763
1763
1763
1767
1767
1767
1767
1767
1767
1767
1767
1767
1767
1767
1771
1771
1771
1771
1771
1771
1771
1771
1771
1771
1775
1775
1775
1775
1775
1775
1775
1779
1779
1779
1779
1779
1779
1779
1779
1783
1783
1783
1783
1783
1783
1783
1783
1787
1787
1787
1787
1787
1791
1791
1791
1791
1791
1791
1795
1795
1795
1795
1795
1795
1799
1799
1799
1799
1799
1799
1799
1799
1803
1803
1803
1803
1803
1803
1807
1807
1807
1807
1807
1807
1807
1807
1807
1807
1807
1811
1811
1811
1811
1811
1811
1811
1811
1815
1815
1815
1815
1815
1815
1815
1815
1819
1819
1819
1819
1819
1819
1819
1819
1823
1823
1823
1823
1823
1823
1823
1823
1827
1827
1827
1827
1827
1827
1827
1827
1831
1831
1831
1831
1831
1831
1831
1831
1831
1831
1835
1835
1835
1835
1835
1835
1835
1835
1839
1839
1839
1839
1839
1839
1839
1839
1839
1843
1843
1843
1843
1843
1843
1843
1843
1843
1843
1847
1847
1847
1847
1847
1847
1851
1851
1851
1851
1851
1851
1851
1851
1851
1851
1855
1855
1855
1855
1855
1855
1855
1855
1859
1859
1859
1859
1859
1859
1859
1859
1859
1863
1863
1863
1863
1863
1863
1867
1867
1867
1867
1867
1867
1867
1871
1871
1871
1871
1871
1871
1871
1871
1871
1871
1871
1875
1875
1875
1875
1875
1875
1875
1875
1879
1879
1879
1879
1879
1879
1879
1883
1883
1883
1883
1887
1887
1887
1887
1887
1887
1887
1891
1891
1891
1891
1891
1891
1891
1891
1891
1895
1895
1895
1895
1895
1895
1895
1895
1895
1899
1899
1899
1899
1899
1899
1899
1899
1899
1899
1903
1903
1903
1903
1903
1903
1903
1903
1903
1907
1907
1907
1907
1907
1907
1907
1907
1907
1911
1911
1911
1911
1911
1911
1911
1911
1911
1915
1915
1915
1915
1915
1919
1919
1919
1919
1919
1919
1919
1924
1924
1924
1924
1924
1924
1924
1928
1928
1928
1928
1928
1928
1928
1928
1932
1932
1932
1932
1932
1932
1932
1932
1932
1932
1932
1936
1936
1936
1936
1936
1936
1936
1936
1936
1936
1940
1940
1940
1940
1940
1940
1940
1940
1940
1940
1944
1944
1944
1944
1944
1944
1944
1948
1948
1948
1948
1948
1948
1948
1948
1948
1948
1952
1952
1952
1952
1952
1952
1952
1956
1956
1956
1956
1956
1956
1956
1956
1956
1960
1960
1960
1960
1960
1960
1960
1960
1964
1964
1964
1964
1964
1964
1964
1964
1964
1964
1964
1964
1968
1968
1968
1968
1968
1968
1968
1968
1968
1972
1972
1972
1972
1972
1972
1972
1972
1972
1972
1972
1976
1976
1976
1976
1976
1976
1976
1980
1980
1980
1980
1984
1984
1984
1984
1984
1984
1984
1984
1984
1988
1988
1988
1988
1988
1988
1988
1992
1992
1992
1992
1992
1992
1996
1996
1996
1996
1996
1996
1996
2000
2000
2000
2000
2004
2004
2004
2004
2004
2004
2008
2008
2008
2008
2008
2008
2008
2008
2012
2012
2012
2012
2012
2012
2012
2012
2016
2016
2016
2016
2016
2016
2016
2016
2020
2020
2020
2020
2020
2020
2020
2020
2024
2024
2024
2024
2024
2024
2028
2028
2028
2028
2028
2028
2028
2028
2028
2032
2032
2032
2032
2032
2032
2032
2036
2036
2036
2036
2036
2036
2036
2040
2040
2040
2040
2040
2040
2044
2044
2044
2044
2044
2044
2044
2048
2048
2048
2048
2048
2048
2048
2052
2052
2052
2052
2056
2056
2056
2056
2056
2056
2056
2056
2060
2060
2060
2060
2060
2060
2060
2064
2064
2064
2064
2064
2064
2064
2064
2068
2068
2068
2068
2068
2068
2068
2068
2068
2068
2068
2072
2072
2072
2072
2072
2072
2076
2076
2076
2076
2076
2076
2080
2080
2080
2080
2080
2080
2080
2080
2084
2084
2084
2084
2084
2084
2084
2084
2088
2088
2088
2088
2092
2092
2092
2092
2092
2092
2092
2092
2092
2092
2096
2096
2096
2096
2096
2096
2096
2096
2100
2100
2100
2100
2100
2100
2100
2100
2104
2104
2104
2104
2104
2104
2104
2104
2104
2108
2108
2108
2108
2108
2108
2108
2108
2112
2112
2112
2112
2112
2112
2112
2112
2112
2112
2116
2116
2116
2116
2116
2116
2116
2116
2120
2120
2120
2120
2120
2120
2120
2120
2120
2124
2124
2124
2124
2124
2128
2128
2128
2128
2128
2128
2128
2132
2132
2132
2132
2132
2132
2132
2136
2136
2136
2136
2136
2136
2136
2136
2140
2140
2140
2140
2140
2140
2140
2140
2144
2144
2144
2144
2144
2144
2144
2144
2148
2148
2148
2148
2148
2148
2148
2148
2148
2148
2152
2152
2152
2152
2152
2152
2152
2152
2156
2156
2156
2156
2156
2156
2156
2156
2156
2156
2156
2160
2160
2160
2160
2160
2160
2160
2164
2164
2164
2164
2164
2164
2164
2164
2168
2168
2168
2168
2168
2168
2168
2168
2172
2172
2172
2172
2172
2172
2172
2172
2177
2177
2177
2177
2177
2177
2177
2177
2185
2185
2185
2185
2189
2189
2189
2189
2189
2189
2189
2189
2189
2193
2193
2193
2193
2193
2193
2193
2193
2193
2193
2197
2197
2197
2197
2197
2197
2197
2197
2201
2201
2201
2201
2201
2201
2201
2201
2205
2205
2205
2205
2205
2205
2205
2205
2205
2209
2209
2209
2209
2209
2209
2209
2209
2213
2213
2213
2213
2213
2213
2217
2217
2217
2217
2217
2217
2217
2217
2221
2221
2221
2221
2221
2221
2221
2221
2221
2221
2225
2225
2225
2225
2225
2225
2225
2225
2229
2229
2229
2229
2229
2229
2229
2229
2229
2229
2233
2233
2233
2233
2233
2233
2233
2233
2233
2233
2237
2237
2237
2237
2237
2237
2237
2237
2237
2241
2241
2241
2241
2241
2241
2241
2245
2245
2245
2245
2245
2245
2245
2245
2245
2245
2245
2249
2249
2249
2249
2249
2249
2249
2249
2249
2253
2253
2253
2253
2253
2253
2253
2253
2257
2257
2257
2257
2257
2257
2257
2257
2257
2261
2261
2261
2261
2261
2261
2261
2261
2261
2265
2265
2265
2265
2265
2265
2265
2265
2269
2269
2269
2269
2269
2269
2269
2269
2269
2269
2269
2273
2273
2273
2273
2273
2273
2273
2273
2273
2277
2277
2277
2277
2277
2277
2277
2277
2277
2277
2281
2281
2281
2281
2281
2281
2281
2281
2281
2281
2281
2285
2285
2285
2285
2285
2285
2285
2285
2289
2289
2289
2289
2289
2289
2289
2289
2289
2289
2289
2293
2293
2293
2293
2293
2293
2293
2293
2293
2293
2297
2297
2297
2301
2301
2301
2301
2301
2301
2305
2305
2305
2305
2305
2305
2305
2309
2309
2309
2309
2309
2309
2309
2309
2309
2313
2313
2313
2313
2313
2317
2317
2317
2317
2317
2317
2317
2317
2317
2317
2321
2321
2321
2321
2321
2321
2321
2325
2325
2325
2325
2325
2325
2325
2325
2329
2329
2329
2329
2329
2329
2329
2329
2333
2333
2333
2333
2333
2333
2337
2337
2337
2337
2337
2337
2341
2341
2341
2341
2341
2341
2341
2345
2345
2345
2345
2345
2345
2345
2349
2349
2349
2349
2349
2349
2349
2349
2353
2353
2353
2353
2353
2353
2353
2357
2357
2357
2357
2357
2357
2357
2357
2357
2361
2361
2361
2361
2361
2361
2361
2361
2365
2365
2365
2365
2369
2377
2381
2381
2381
2381
2381
2385
2385
2385
2385
2385
2385
2385
2385
2385
2385
2385
2385
2385
2385
2389
2389
2389
2389
2389
2389
2389
2389
2389
2389
2389
2389
2389
2389
2393
2393
2393
2393
2393
2393
2393
2393
2397
2397
2397
2397
2397
2397
2397
2397
2401
2401
2405
2405
2405
2405
2405
2405
2405
2405
2405
2405
2405
2409
2409
2409
2409
2409
2409
2409
2409
2409
2409
2409
2409
2409
2409
2409
2409
2409
2413
2413
2413
2413
2413
2413
2413
2413
2413
2413
2417
2417
2417
2417
2417
2417
2417
2417
2417
2417
2417
2421
2421
2421
2421
2425
2425
2425
2425
2425
2425
2425
2425
2425
2425
2429
2429
2429
2429
2429
2429
2429
2429
2429
2429
2434
2434
2434
2434
2434
2434
2434
2438
2438
2438
2438
2438
2438
2438
2438
2438
2438
2438
2442
2442
2442
2442
2442
2442
2442
2442
2446
2446
2446
2450
2450
2450
2450
2450
2450
2450
2450
2450
2450
2450
2450
2454
2454
2454
2454
2454
2454
2454
2454
2454
2454
2458
2458
2458
2458
2458
2458
2458
2458
2458
2458
2462
2462
2462
2462
2462
2462
2462
2462
2462
2462
2466
2466
2466
2466
2466
2466
2466
2474
2474
2474
2474
2474
2474
2474
2474
2478
2478
2478
2478
2478
2478
2478
2478
2478
2478
2478
2478
2478
2482
2482
2482
2482
2482
2482
2482
2482
2482
2482
2486
2486
2486
2486
2486
2486
2486
2486
2486
2486
2490
2490
2490
2490
2490
2490
2490
2490
2490
2494
2498
2498
2498
2498
2498
2498
2498
2498
2498
2498
2498
2502
2502
2502
2502
2502
2502
2502
2502
2502
2502
2506
2506
2506
2506
2506
2506
2506
2506
2506
2506
2506
2510
2510
2510
2510
2510
2510
2510
2510
2510
2510
2510
2514
2514
2514
2514
2514
2514
2514
2518
2518
2518
2518
2518
2518
2518
2518
2522
2522
2522
2522
2522
2522
2522
2522
2522
2522
2526
2526
2526
2526
2526
2526
2526
2530
2530
2530
2530
2530
2530
2534
2534
2534
2534
2534
2534
2534
2534
2534
2538
2538
2538
2538
2538
2538
2538
2538
2538
2542
2542
2546
2546
2546
2546
2546
2546
2546
2546
2546
2546
2546
2546
2546
2550
2550
2550
2550
2550
2550
2550
2554
2554
2554
2554
2554
2554
2554
2554
2558
2558
2558
2558
2558
2558
2558
2558
2558
2558
2562
2562
2562
2562
2562
2562
2570
2570
2570
2570
2570
2570
2574
2574
2574
2574
2574
2574
2574
2574
2574
2578
2578
2578
2578
2578
2578
2578
2578
2578
2578
2578
2578
2582
2582
2582
2582
2582
2582
2582
2586
2586
2586
2586
2586
2586
2586
2586
2586
2586
2586
2586
2586
2590
2590
2590
2590
2590
2590
2590
2594
2594
2594
2594
2598
2598
2598
2598
2598
2598
2598
2598
2598
2602
2602
2602
2602
2602
2602
2602
2602
2602
2602
2602
2606
2606
2606
2606
2606
2606
2606
2606
2606
2606
2606
2606
2610
2610
2610
2610
2610
2610
2610
2610
2614
2614
2614
2614
2614
2614
2614
2614
2614
2614
2618
2618
2618
2622
2622
2622
2622
2622
2622
2622
2622
2622
2626
2626
2626
2626
2626
2626
2626
2626
2626
2630
2630
2630
2630
2630
2630
2630
2630
2630
2630
2634
2634
2634
2634
2634
2634
2634
2634
2634
2638
2638
2638
2638
2638
2638
2638
2638
2638
2638
2642
2642
2642
2642
2642
2642
2646
2646
2646
2646
2646
2646
2646
2646
2646
2646
2646
2646
2650
2650
2650
2650
2650
2650
2650
2650
2650
2654
2654
2654
2654
2654
2654
2654
2654
2654
2654
2654
2658
2658
2658
2658
2658
2658
2658
2658
2658
2658
2658
2658
2658
2662
2662
2662
2666
2666
2666
2666
2666
2666
2666
2666
2666
2670
2670
2670
2670
2670
2670
2674
2674
2674
2674
2674
2674
2674
2674
2678
2678
2678
2678
2678
2678
2678
2682
2682
2682
2682
2682
2682
2682
2686
2686
2686
2686
2686
2686
2686
2686
2686
2691
2695
2695
2695
2695
2695
2695
2695
2695
2695
2699
2699
2699
2699
2699
2699
2699
2699
2699
2703
2703
2703
2703
2703
2703
2703
2703
2703
2703
2703
2703
2703
2703
2707
2707
2707
2707
2707
2707
2707
2707
2707
2707
2707
2711
2711
2711
2711
2711
2711
2715
2715
2715
2719
2719
2719
2719
2719
2719
2719
2719
2719
2719
2719
2719
2719
2723
2723
2723
2723
2723
2723
2723
2723
2723
2723
2723
2723
2727
2727
2727
2727
2727
2727
2727
2727
2727
2727
2727
2727
2731
2731
2731
2731
2731
2731
2731
2731
2735
2735
2735
2735
2735
2739
2739
2739
2739
2739
2739
2739
2739
2743
2743
2743
2743
2743
2743
2743
2743
2743
2743
2743
2747
2747
2747
2747
2747
2747
2747
2747
2747
2747
2747
2747
2747
2747
2747
2751
2751
2751
2751
2755
2755
2755
2755
2755
2755
2759
2759
2759
2759
2759
2759
2763
2763
2763
2763
2763
2763
2763
2763
2767
2767
2767
2767
2767
2767
2767
2767
2767
2771
2771
2771
2771
2771
2771
2775
2775
2775
2775
2775
2775
2775
2775
2775
2779
2779
2779
2779
2779
2779
2779
2779
2779
2779
2783
2783
2783
2783
2783
2783
2783
2783
2787
2787
2791
2791
2791
2791
2791
2791
2791
2795
2795
2795
2795
2795
2795
2795
2799
2799
2799
2799
2799
2799
2799
2799
2799
2799
2799
2799
2799
2799
2799
2799
2803
2803
2803
2803
2803
2803
2803
2803
2803
2803
2803
2803
2807
2807
2807
2807
2807
2807
2807
2811
2811
2811
2811
2811
2815
2815
2815
2815
2815
2815
2815
2815
2815
2815
2815
2819
2819
2819
2819
2819
2819
2819
2819
2823
2823
2823
2823
2823
2823
2823
2823
2823
2823
2827
2827
2827
2827
2827
2827
2827
2827
2831
2831
2831
2831
2831
2831
2831
2831
2831
2839
2839
2839
2839
2839
2839
2839
2843
2843
2843
2843
2843
2843
2843
2847
2847
2847
2847
2847
2847
2851
2851
2851
2851
2851
2851
2851
2851
2851
2855
2855
2855
2855
2855
2855
2855
2855
2859
2859
2859
2859
2859
2859
2859
2859
2859
2859
2859
2859
2859
2859
2863
2863
2863
2867
2867
2867
2867
2867
2867
2867
2867
2867
2867
2867
2871
2871
2871
2871
2871
2871
2871
2871
2871
2875
2875
2875
2875
2875
2875
2875
2875
2875
2875
2875
2879
2879
2879
2879
2879
2879
2879
2879
2879
2883
2883
2883
2883
2883
2883
2883
2887
2891
2891
2891
2891
2891
2891
2891
2891
2891
2891
2891
2895
2895
2895
2895
2895
2895
2899
2899
2899
2899
2899
2899
2899
2899
2899
2903
2903
2903
2903
2903
2903
2903
2903
2903
2903
2903
2907
2907
2907
2907
2907
2907
2907
2907
2911
2911
2911
2911
2911
2915
2915
2915
2915
2919
2919
2919
2919
2919
2919
2919
2919
2919
2919
2919
2923
2923
2923
2923
2923
2923
2923
2923
2923
2927
2927
2927
2927
2927
2927
2927
2927
2927
2927
2931
2931
2931
2931
2931
2931
2931
2931
2931
2935
2935
2935
2935
2935
2935
2939
2943
2943
2943
2943
2943
2943
2943
2943
2943
2943
2948
2948
2948
2948
2948
2948
2948
2948
2948
2948
2948
2948
2948
2948
2948
2948
2948
2952
2952
2952
2952
2952
2956
2956
2956
2960
2960
2960
2960
2960
2960
2964
2964
2964
2964
2964
2964
2964
2968
2968
2968
2972
2972
2972
2972
2972
2972
2972
2976
2976
2976
2976
2976
2976
2976
2976
2980
2980
2980
2980
2980
2980
2980
2980
2980
2984
2984
2984
2984
2988
2988
2988
2988
2988
2988
2988
2988
2992
2992
2992
2992
2992
2992
2992
2992
2992
2996
2996
2996
2996
2996
2996
3000
3000
3004
3004
3004
3004
3004
3004
3004
3004
3008
3008
3008
3008
3008
3008
3008
3008
3012
3012
3012
3012
3012
3012
3012
3012
3016
3016
3016
3016
3016
3016
3016
3016
3016
3016
3016
3020
3020
3020
3020
3020
3020
3020
3020
3020
3020
3020
3024
3024
3028
3028
3032
3032
3032
3032
3032
3032
3032
3036
3036
3036
3036
3036
3036
3040
3040
3040
3040
3040
3040
3040
3040
3040
3044
3044
3044
3044
3044
3044
3044
3044
3044
3044
3044
3044
3044
3048
3048
3048
3048
3048
3048
3048
3048
3052
3052
3052
3052
3052
3052
3060
3060
3060
3060
3060
3060
3060
3060
3060
3060
3060
3064
3064
3064
3064
3064
3064
3064
3064
3064
3064
3064
3068
3068
3068
3068
3068
3068
3068
3068
3068
3068
3068
3068
3072
3072
3072
3072
3072
3072
3072
3076
3076
3076
3076
3076
3076
3076
3076
3080
3080
3084
3084
3084
3084
3084
3088
3088
3088
3088
3088
3088
3088
3088
3092
3092
3092
3092
3092
3092
3092
3092
3092
3092
3092
3096
3096
3096
3096
3096
3096
3096
3096
3100
3100
3100
3100
3100
3100
3100
3100
3104
3104
3104
3104
3104
3104
3104
3104
3104
3104
3108
3108
3108
3108
3112
3112
3112
3112
3112
3112
3112
3112
3112
3116
3116
3116
3116
3116
3116
3116
3116
3116
3120
3120
3120
3120
3120
3120
3120
3124
3124
3124
3124
3124
3124
3124
3124
3124
3128
3128
3128
3128
3128
3128
3128
3128
3132
3132
3132
3132
3132
3136
3136
3136
3136
3136
3136
3136
3136
3136
3140
3140
3140
3140
3140
3140
3140
3144
3144
3144
3144
3144
3144
3144
3148
3148
3148
3148
3148
3148
3148
3148
3152
3152
3152
3152
3152
3152
3152
3152
3152
3156
3156
3156
3156
3156
3156
3156
3156
3160
3160
3164
3164
3164
3164
3164
3164
3168
3168
3168
3168
3168
3168
3168
3168
3172
3172
3172
3172
3172
3172
3172
3172
3176
3176
3176
3176
3180
3184
3184
3184
3184
3184
3184
3184
3184
3188
3188
3188
3188
3188
3188
3188
3188
3188
3192
3192
3192
3192
3192
3192
3192
3196
3196
3196
3196
3201
3201
3201
3201
3201
3201
3201
3201
3201
3205
3205
3205
3205
3205
3205
3205
3205
3205
3209
3209
3209
3209
3209
3209
3209
3213
3213
3213
3213
3213
3213
3213
3213
3217
3217
3217
3217
3217
3217
3217
3217
3217
3221
3221
3221
3221
3225
3225
3225
3225
3225
3225
3229
3229
3229
3229
3229
3229
3229
3229
3229
3233
3233
3233
3233
3233
3233
3233
3233
3237
3237
3237
3237
3237
3237
3237
3241
3241
3241
3241
3241
3241
3241
3241
3241
3241
3241
3245
3245
3245
3245
3245
3245
3245
3245
3245
3249
3249
3253
3253
3253
3253
3253
3253
3253
3253
3253
3253
3257
3257
3257
3257
3257
3257
3257
3261
3261
3261
3261
3261
3261
3261
3261
3261
3265
3265
3265
3265
3265
3265
3265
3265
3269
3269
3269
3269
3269
3269
3269
3269
3273
3273
3273
3273
3273
3277
3277
3277
3281
3281
3281
3281
3281
3281
3281
3285
3285
3285
3285
3285
3285
3285
3285
3289
3289
3289
3289
3289
3289
3289
3289
3289
3289
3289
3293
3293
3293
3293
3293
3293
3293
3293
3293
3293
3293
3297
3297
3297
3297
3297
3297
3297
3297
3297
3297
3301
3301
3301
3305
3305
3305
3305
3305
3305
3305
3305
3305
3305
3309
3309
3309
3309
3309
3309
3309
3309
3309
3313
3313
3313
3313
3313
3313
3313
3313
3313
3317
3317
3317
3317
3317
3317
3317
3317
3317
3317
3321
3321
3321
3321
3321
3325
3325
3325
3325
3325
3325
3325
3325
3329
3329
3333
3333
3333
3333
3333
3333
3333
3333
3337
3337
3337
3337
3337
3337
3337
3337
3337
3341
3341
3341
3341
3341
3341
3341
3341
3341
3341
3345
3345
3345
3345
3349
3349
3349
3349
3349
3349
3349
3349
3353
3353
3353
3353
3353
3353
3353
3357
3357
3361
3361
3361
3361
3361
3365
3365
3365
3365
3365
3365
3365
3365
3365
3365
3365
3365
3369
3369
3369
3369
3369
3369
3373
3373
3373
3373
3373
3373
3373
3373
3373
3373
3373
3377
3377
3377
3377
3377
3377
3377
3377
3377
3381
3381
3381
3381
3381
3381
3381
3381
3385
3385
3389
3389
3389
3389
3389
3389
3389
3389
3389
3389
3389
3389
3389
3389
3389
3393
3393
3397
3397
3397
3401
3401
3401
3401
3401
3401
3401
3401
3401
3401
3405
3405
3405
3405
3405
3405
3405
3405
3405
3405
3409
3409
3409
3409
3409
3409
3409
3409
3409
3417
3417
3417
3417
3417
3421
3421
3421
3421
3421
3421
3421
3421
3421
3425
3425
3425
3425
3425
3425
3425
3429
3429
3429
3429
3429
3429
3429
3429
3429
3433
3433
3433
3433
3433
3433
3433
3433
3433
3433
3433
3437
3437
3437
3437
3437
3437
3437
3441
3441
3441
3441
3445
3445
3445
3445
3445
3445
3445
3445
3445
3445
3445
3449
3449
3449
3449
3449
3449
3449
3449
3449
3449
3449
3453
3453
3453
3453
3453
3453
3453
3458
3458
3458
3458
3458
3458
3458
3458
3458
3462
3462
3462
3462
3462
3462
3462
3462
3462
3462
3462
3466
3466
3470
3470
3470
3470
3470
3470
3470
3470
3470
3470
3474
3474
3474
3474
3474
3474
3474
3474
3474
3474
3474
3478
3478
3478
3478
3478
3482
3482
3482
3482
3482
3482
3482
3482
3482
3482
3486
3486
3486
3486
3486
3486
3486
3486
3486
3486
3486
3486
3490
3494
3494
3494
3494
3494
3494
3494
3494
3494
3494
3498
3498
3498
3498
3498
3498
3498
3498
3502
3502
3502
3502
3502
3502
3502
3506
3506
3506
3506
3506
3506
3506
3506
3506
3510
3510
3510
3510
3510
3510
3510
3510
3514
3514
3514
3514
3514
3514
3514
3518
3518
3522
3522
3522
3522
3522
3522
3522
3526
3526
3526
3526
3530
3530
3530
3530
3530
3530
3530
3534
3534
3534
3534
3534
3534
3534
3534
3538
3538
3538
3538
3538
3538
3538
3538
3538
3538
3542
3542
3542
3542
3542
3542
3542
3542
3542
3542
3542
3546
3546
3546
3550
3550
3550
3550
3550
3554
3554
3554
3554
3554
3554
3554
3554
3554
3558
3558
3558
3558
3558
3558
3558
3558
3558
3558
3562
3562
3562
3562
3562
3562
3562
3562
3562
3562
3562
3562
3566
3566
3566
3566
3566
3566
3566
3566
3570
3570
3570
3570
3570
3570
3574
3574
3574
3574
3574
3574
3574
3578
3578
3578
3578
3578
3578
3582
3582
3582
3582
3582
3582
3582
3582
3582
3582
3582
3586
3586
3586
3586
3586
3586
3586
3586
3586
3590
3590
3590
3590
3590
3590
3590
3590
3594
3594
3594
3594
3594
3594
3598
3598
3598
3598
3602
3602
3602
3602
3602
3602
3606
3606
3606
3606
3606
3606
3606
3614
3614
3614
3614
3614
3614
3614
3614
3618
3618
3618
3618
3618
3622
3622
3622
3622
3622
3622
3622
3622
3622
3622
3626
3626
3626
3626
3626
3626
3626
3626
3626
3626
3626
3630
3630
3630
3634
3634
3634
3634
3634
3638
3638
3638
3638
3638
3638
3638
3642
3642
3642
3642
3642
3642
3642
3642
3646
3646
3646
3646
3646
3646
3650
3650
3650
3650
3650
3650
3650
3650
3654
3654
3654
3654
3654
3654
3658
3658
3658
3658
3658
3658
3658
3658
3658
3658
3662
3666
3666
3666
3666
3666
3666
3666
3670
3670
3670
3670
3670
3670
3670
3670
3670
3674
3674
3674
3674
3674
3674
3674
3674
3674
3674
3674
3674
3678
3678
3678
3678
3678
3678
3678
3682
3682
3682
3682
3682
3682
3682
3682
3682
3686
3686
3686
3686
3686
3686
3686
3690
3690
3690
3690
3694
3694
3694
3694
3694
3694
3694
3698
3698
3698
3698
3698
3698
3698
3698
3702
3702
3702
3702
3702
3702
3702
3702
3702
3706
3706
3706
3706
3706
3706
3706
3710
3710
3710
3710
3710
3710
3710
3715
3715
3715
3715
3715
3715
3715
3715
3723
3723
3723
3723
3723
3723
3723
3723
3723
3723
3727
3727
3727
3727
3727
3727
3727
3727
3727
3731
3731
3731
3731
3731
3731
3731
3731
3735
3735
3735
3735
3735
3739
3739
3739
3739
3739
3739
3739
3739
3739
3743
3743
3743
3743
3743
3743
3747
3747
3747
3747
3751
3751
3755
3755
3755
3755
3755
3755
3755
3755
3755
3755
3759
3759
3759
3759
3763
3763
3763
3763
3763
3763
3767
3767
3767
3767
3767
3767
3767
3767
3767
3767
3767
3771
3771
3771
3771
3771
3771
3771
3771
3771
3775
3775
3775
3775
3775
3775
3775
3775
3779
3779
3783
3783
3783
3783
3783
3783
3783
3787
3787
3787
3787
3791
3791
3791
3791
3791
3791
3791
3791
3791
3791
3791
3795
3795
3795
3795
3795
3795
3799
3799
3799
3799
3799
3799
3799
3799
3799
3799
3799
3799
3799
3803
3803
3803
3803
3803
3803
3807
3807
3811
3811
3811
3811
3815
3815
3815
3815
3815
3815
3815
3815
3815
3815
3819
3819
3819
3819
3819
3819
3819
3819
3819
3823
3823
3823
3823
3823
3823
3823
3823
3823
3827
3827
3827
3827
3827
3827
3827
3827
3827
3827
3831
3831
3831
3831
3831
3831
3831
3831
3831
3839
3839
3839
3839
3839
3839
3847
3847
3847
3847
3847
3851
3851
3851
3851
3851
3851
3851
3851
3851
3851
3855
3855
3855
3855
3855
3855
3855
3859
3859
3859
3859
3859
3859
3859
3859
3863
3863
3863
3863
3863
3863
3863
3863
3863
3867
3867
3867
3867
3867
3871
3871
3871
3871
3871
3871
3875
3875
3875
3879
3879
3879
3879
3879
3879
3879
3879
3879
3883
3883
3883
3883
3883
3887
3887
3887
3887
3887
3887
3891
3891
3891
3891
3891
3891
3891
3891
3891
3891
3895
3895
3895
3895
3895
3895
3895
3895
3895
3895
3899
3899
3903
3903
3903
3907
3907
3907
3907
3907
3907
3907
3911
3911
3911
3911
3911
3911
3911
3915
3915
3915
3915
3915
3915
3915
3919
3919
3919
3919
3919
3919
3919
3919
3919
3923
3923
3923
3923
3923
3923
3923
3927
3927
3927
3927
3927
3927
3927
3927
3931
3931
3935
3935
3935
3935
3935
3939
3939
3939
3939
3939
3939
3943
3943
3943
3943
3943
3943
3947
3947
3947
3947
3947
3951
3951
3951
3951
3951
3951
3951
3951
3951
3951
3951
3951
3955
3955
3955
3955
3955
3955
3955
3955
3955
3955
3959
3959
3959
3959
3959
3959
3959
3967
3967
3967
3967
3967
3967
3967
3967
3972
3972
3972
3972
3972
3976
3976
3976
3976
3976
3976
3976
3980
3980
3980
3980
3980
3984
3984
3984
3984
3984
3984
3984
3984
3984
3988
3988
3988
3988
3988
3988
3988
3988
3988
3992
3992
3992
3992
3992
3992
3992
3992
3996
3996
4000
4000
4000
4000
4000
4000
4000
4004
4004
4004
4004
4004
4004
4008
4008
4008
4008
4008
4008
4008
4008
4012
4012
4012
4012
4016
4016
4016
4016
4016
4016
4016
4020
4020
4020
4020
4020
4020
4020
4020
4020
4020
4020
4020
4024
4024
4024
4024
4028
4028
4028
4028
4028
4028
4028
4032
4032
4032
4032
4032
4032
4032
4032
4032
4036
4036
4036
4036
4040
4040
4040
4040
4040
4040
4040
4040
4044
4044
4044
4044
4044
4044
4044
4044
4048
4048
4048
4048
4048
4048
4048
4048
4052
4052
4052
4052
4052
4052
4052
4056
4056
4056
4056
4056
4056
4060
4060
4060
4060
4060
4060
4060
4060
4060
4064
4064
4064
4064
4064
4064
4064
4068
4068
4068
4068
4068
4068
4068
4068
4068
4072
4072
4072
4072
4072
4072
4072
4072
4072
4072
4076
4076
4076
4076
4076
4076
4080
4080
4080
4096
4096
4096
4096
4096
4096
4096
4096
4096
4096
4096
4096
4096
4096
4096
4096
4096
4096
4096
4096
4096
4096
4096
4096
4096
4096
4096
4096
4096
4096
4096
4096
4096
4096
4096
4096
4096
4096
4096
4096
4096
4096
4096
4096
4096
4096
4096
4096
4096
4096
4096
4096
4096
4096
4096
4096
4096
4096
4096
4096
4096
4096
4096
4096
4096
4096
4096
4096
4096
4096
4096
4096
4096
4096
4096
4096
4096
4096
4096
4096
4096
4096
4096
4096
4096
4096
4096
4096
4096
4096
4096
4096
4096
4096
4096
4096
4096
4096
4096
4096
4096
4096
4096
4096
4096
4096
4096
4096
4096
4096
4096
4096
4096
4096
4096
4096
4096
4096
4096
4096
4096
4096
4096
4096
4096
4096
4096
4096
4096
4096
4096
4096
4096
4096
4096
4096
4096
4096
4096
4096
4096
4096
4096
4096
4096
4096
4096
4096
4096
4096
4096
4096
4096
4096
4096
4096
4096
4096
4096
4096
4096
4096
4096
4096
4096
4096
4096
4096
4096
4096
4096
4096
4096
4096
4096
4096
4096
4096
4096
4096
4096
4096
4096
4096
4096
4096
4096
4096
4096
4096
4096
4096
4096
4096
4096
4096
4096
4096
4096
4096
4096
4096
4096
4096
4096
4096
4096
4096
4096
4096
4096
4096
4096
4096
4096
4096
4096
4096
4096
4096
4096
4096
4096
4096
4096
4096
4096
4096
4096
4096
4096
4096
4096
4096
4096
4096
4096
4096
4096
4096
4096
4096
4096
4096
4096
4096
4096
4096
4096
4096
4096
4096
4096
4096
4096
4096
4096
4096
4096
4096
4096
4096
4096
4096
4096
4096
4096
4096
4096
4096
4096
4096
4096
4096
4096
4096
4096
4096
4096
4096
4096
4096
4096
4096
4096
4096
4096
4096
4096
4096
4096
4096
4096
4096
4096
4096
4096
4096
4096
4096
4096
4096
4096
4096
4096
4096
4096
4096
4096
4096
4096
4096
4096
4096
4096
4096
4096
4096
4096
4096
4096
4096
4096
4096
4096
4096
4096
4096
4096
4096
4096
4096
4096
4096
4096
4096
4096
4096
4096
4096
4096
4096
4096
4096
4096
4096
4096
4096
4096
4096
4096
4096
4096
4096
4096
4096
4096
4096
4096
4096
4096
4096
4096
4096
4096
4096
4096
4096
4096
4096
4096
4096
4096
4096
4096
4096
4096
4096
4096
4096
4096
4096
4096
4096
4096
4096
4096
4096
4096
4096
4096
4096
4096
4096
4096
4096
4096
4096
4096
4096
4096
4096
4096
4096
4096
4096
4096
4096
4096
4096
4096
4096
4096
4096
4096
4096
4096
4096
4096
4096
4096
4096
4096
4096
4096
4096
4096
4096
4096
4096
4096
4096
4096
4096
4096
4096
4096
4096
4096
4096
4096
4096
4096
4096
4096
4096
4096
4096
4096
4096
4096
4096
4096
4096
4096
4096
4096
4096
4096
4096
4096
4096
4096
4096
4096
4096
4096
4096
4096
4096
4096
4096
4096
4096
4096
4096
4096
4096
4096
4096
4096
4096
4096
4096
4096
4096
4096
4096
4096
4096
4096
4096
4096
4096
4096
4096
4096
4096
4096
4096
4096
4096
4096
4096
4096
4096
4096
4096
4096
4096
4096
4096
4096
4096
4096
4096
4096
4096
4096
4096
4096
4096
4096
4096
4096
4096
4096
4096
4096
4096
4096
4096
4096
4096
4096
4096
4096
4096
4096
4096
4096
4096
4096
4096
4096
4096
4096
4096
4096
4096
4096
4096
4096
4096
4096
4096
4096
4096
4096
4096
4096
4096
4096
4096
4096
4096
4096
4096
4096
4096
4096
4096
4096
4096
4096
4096
4096
4096
4096
4096
4096
4096
4096
4096
4096
4096
4096
4096
4096
4096
4096
4096
4096
4096
4096
4096
4096
4096
4096
4096
4096
4096
4096
4096
4096
4096
4096
4096
4096
4096
4096
4096
4096
4096
4096
4096
4096
4096
4096
4096
4096
4096
4096
4096
4096
4096
4096
4096
4096
4096
4096
4096
4096
4096
4096
4096
4096
4096
4096
4096
4096
4096
4096
4096
4096
4096
4096
4096
4096
4096
4096
4096
4096
4096
4096
4096
4096
4096
4096
4096
4096
4096
4096
4096
4096
4096
4096
4096
4096
4096
4096
4096
4096
4096
4096
4096
4096
4096
4096
4096
4096
4096
4096
4096
4096
4096
4096
4096
4096
4096
4096
4096
4096
4096
4096
4096
4096
4096
4096
4096
4096
4096
4096
4096
4096
4096
4096
4096
4096
4096
4096
4096
4096
4096
4096
4096
4096
4096
4096
4096
4096
4096
4096
4096
4096
4096
4096
4096
4096
4096
4096
4096
4096
4096
4096
4096
4096
4096
4096
4096
4096
4096
4096
4096
4096
4096
4096
4096
4096
4096
4096
4096
4096
4096
4096
4096
4096
4096
4096
4096
4096
4096
4096
4096
4096
4096
4096
4096
4096
4096
4096
4096
4096
4096
4096
4096
4096
4096
4096
4096
4096
4096
4096
4096
4096
4096
4096
4096
4096
4096
4096
4096
4096
4096
4096
4096
4096
4096
4096
4096
4096
4096
4096
4096
4096
4096
4096
4096
4096
4096
4096
4096
4096
4096
4096
4096
4096
4096
4096
4096
4096
4096
4096
4096
4096
4096
4096
4096
4096
4096
4096
4096
4096
4096
4096
4096
4096
4096
4096
4096
4096
4096
4096
4096
4096
4096
4096
4096
4096
4096
4096
4096
4096
4096
4096
4096
4096
4096
4096
4096
4096
4096
4096
4096
4096
4096
4096
4096
4096
4096
4096
4096
4096
4096
4096
4096
4096
4096
4096
4096
4096
4096
4096
4096
4096
4096
4096
4096
4096
4096
4096
4096
4096
4096
4096
4096
4096
4096
4096
4096
4096
4096
4096
4096
4096
4096
4096
4096
4096
4096
4096
4096
4096
4096
4096
4096
4096
4096
4096
4096
4096
4096
4096
4096
4096
4096
4096
4096
4096
4096
4096
4096
4096
4096
4096
4096
4096
4096
4096
4096
4096
4096
4096
4096
4096
4096
4096
4096
4096
4096
4096
4096
4096
4096
4096
4096
4096
4096
4096
4096
4096
4096
4096
4096
4096
4096
4096
4096
4096
4096
4096
4096
4096
4096
4096
4096
4096
4096
4096
4096
4096
4096
4096
4096
4096
4096
4096
4096
4096
4096
4096
4096
4096
4096
4096
4096
4096
4096
4096
4096
4096
4096
4096
4096
4096
4096
4096
4096
4096
4096
4096
4096
4096
4096
4096
4096
4096
4096
4096
4096
4096
4096
4096
4096
4096
4096
4096
4096
4096
4096
4096
4096
4096
4096
4096
4096
4096
4096
4096
4096
4096
4096
4096
4096
4096
4096
4096
4096
4096
4096
4096
4096
4096
4096
4096
4096
4096
4096
4096
4096
4096
4096
4096
4096
4096
4096
4096
4096
4096
4096
4096
4096
4096
4096
4096
4096
4096
4096
4096
4096
4096
4096
4096
4096
4096
4096
4096
4096
4096
4096
4096
4096
4096
4096
4096
4096
4096
4096
4096
4096
4096
4096
4096
4096
4096
4096
4096
4096
4096
4096
4096
4096
4096
4096
4096
4096
4096
4096
4096
4096
4096
4096
4096
4096
4096
4096
4096
4096
4096
4096
4096
4096
4096
4096
4096
4096
4096
4096
4096
4096
4096
4096
4096
4096
4096
4096
4096
4096
4096
4096
4096
4096
4096
4096
4096
4096
4096
4096
4096
4096
4096
4096
4096
4096
4096
4096
4096
4096
4096
4096
4096
4096
4096
4096
4096
4096
4096
4096
4096
4096
4096
4096
4096
4096
4096
4096
4096
4096
4096
4096
4096
4096
4096
4096
4096
4096
4096
4096
4096
4096
4096
4096
4096
4096
4096
4096
4096
4096
4096
4096
4096
4096
4096
4096
4096
4096
4096
4096
4096
4096
4096
4096
4096
4096
4096
4096
4096
4096
4096
4096
4096
4096
4096
4096
4096
4096
4096
4096
4096
4096
4096
4096
4096
4096
4096
4096
4096
4096
4096
4096
4096
4096
4096
4096
4096
4096
4096
4096
4096
4096
4096
4096
4096
4096
4096
4096
4096
4096
4096
4096
4096
4096
4096
4096
4096
4096
4096
4096
4096
4096
4096
4096
4096
4096
4096
4096
4096
4096
4096
4096
4096
4096
4096
4096
4096
4096
4096
4096
4096
4096
4096
4096
4096
4096
4096
4096
4096
4096
4096
4096
4096
4096
4096
4096
4096
4096
4096
4096
4096
4096
4096
4096
4096
4096
4096
4096
4096
4096
4096
4096
4096
4096
4096
4096
4096
4096
4096
4096
4096
4096
4096
4096
4096
4096
4096
4096
4096
4096
4096
4096
4096
4096
4096
4096
4096
4096
4096
4096
4096
4096
4096
4096
4096
4096
4096
4096
4096
4096
4096
4096
4096
4096
4096
4096
4096
4096
4096
4096
4096
4096
4096
4096
4096
4096
4096
4096
4096
4096
4096
4096
4096
4096
4096
4096
4096
4096
4096
4096
4096
4096
4096
4096
4096
4096
4096
4096
4096
4096
4096
4096
4096
4096
4096
4096
4096
4096
4096
4096
4096
4096
4096
4096
4096
4096
4096
4096
4096
4096
4096
4096
4096
4096
4096
4096
4096
4096
4096
4096
4096
4096
4096
4096
4096
4096
4096
4096
4096
4096
4096
4096
4096
4096
4096
4096
4096
4096
4096
4096
4096
4096
4096
4096
4096
4096
4096
4096
4096
4096
4096
4096
4096
4096
4096
4096
4096
4096
4096
4096
4096
4096
4096
4096
4096
4096
4096
4096
4096
4096
4096
4096
4096
4096
4096
4096
4096
4096
4096
4096
4096
4096
4096
4096
4096
4096
4096
4096
4096
4096
4096
4096
4096
4096
4096
4096
4096
4096
4096
4096
4096
4096
4096
4096
4096
4096
4096
4096
4096
4096
4096
4096
4096
4096
4096
4096
4096
4096
4096
4096
4096
4096
4096
4096
4096
4096
4096
4096
4096
4096
4096
4096
4096
4096
4096
4096
4096
4096
4096
4096
4096
4096
4096
4096
4096
4096
4096
4096
4096
4096
4096
4096
4096
4096
4096
4096
4096
4096
4096
4096
4096
4096
4096
4096
4096
4096
4096
4096
4096
4096
4096
4096
4096
4096
4096
4096
4096
4096
4096
4096
4096
4096
4096
4096
4096
4096
4096
4096
4096
4096
4096
4096
4096
4096
4096
4096
4096
4096
4096
4096
4096
4096
4096
4096
4096
4096
4096
4096
4096
4096
4096
4096
4096
4096
4096
4096
4096
4096
4096
4096
4096
4096
4096
4096
4096
4096
4096
4096
4096
4096
4096
4096
4096
4096
4096
4096
4096
4096
4096
4096
4096
4096
4096
4096
4096
4096
4096
4096
4096
4096
4096
4096
4096
4096
4096
4096
4096
4096
4096
4096
4096
4096
4096
4096
4096
4096
4096
4096
4096
4096
4096
4096
4096
4096
4096
4096
4096
4096
4096
4096
4096
4096
4096
4096
4096
4096
4096
4096
4096
4096
4096
4096
4096
4096
4096
4096
4096
4096
4096
4096
4096
4096
4096
4096
4096
4096
4096
4096
4096
4096
4096
4096
4096
4096
4096
4096
4096
4096
4096
4096
4096
4096
4096
4096
4096
4096
4096
4096
4096
4096
4096
4096
4096
4096
4096
4096
4096
4096
4096
4096
4096
4096
4096
4096
4096
4096
4096
4096
4096
4096
4096
4096
4096
4096
4096
4096
4096
4096
4096
4096
4096
4096
4096
4096
4096
4096
4096
4096
4096
4096
4096
4096
4096
4096
4096
4096
4096
4096
4096
4096
4096
4096
4096
4096
4096
4096
4096
4096
4096
4096
4096
4096
4096
4096
4096
4096
4096
4096
4096
4096
4096
4096
4096
4096
4096
4096
4096
4096
4096
4096
4096
4096
4096
4096
4096
4096
4096
4096
4096
4096
4096
4096
4096
4096
4096
4096
4096
4096
4096
4096
4096
4096
4096
4096
4096
4096
4096
4096
4096
4096
4096
4096
4096
4096
4096
4096
4096
4096
4096
4096
4096
4096
4096
4096
4096
4096
4096
4096
4096
4096
4096
4096
4096
4096
4096
4096
4096
4096
4096
4096
4096
4096
4096
4096
4096
4096
4096
4096
4096
4096
4096
4096
4096
4096
4096
4096
4096
4096
4096
4096
4096
4096
4096
4096
4096
4096
4096
4096
4096
4096
4096
4096
4096
4096
4096
4096
4096
4096
4096
4096
4096
4096
4096
4096
4096
4096
4096
4096
4096
4096
4096
4096
4096
4096
4096
4096
4096
4096
4096
4096
4096
4096
4096
4096
4096
4096
4096
4096
4096
4096
4096
4096
4096
4096
4096
4096
4096
4096
4096
4096
4096
4096
4096
4096
4096
4096
4096
4096
4096
4096
4096
4096
4096
4096
4096
4096
4096
4096
4096
4096
4096
4096
4096
4096
4096
4096
4096
4096
4096
4096
4096
4096
4096
4096
4096
4096
4096
4096
4096
4096
4096
4096
4096
4096
4096
4096
4096
4096
4096
4096
4096
4096
4096
4096
4096
4096
4096
4096
4096
4096
4096
4096
4096
4096
4096
4096
4096
4096
4096
4096
4096
4096
4096
4096
4096
4096
4096
4096
4096
4096
4096
4096
4096
4096
4096
4096
4096
4096
4096
4096
4096
4096
4096
4096
4096
4096
4096
4096
4096
4096
4096
4096
4096
4096
4096
4096
4096
4096
4096
4096
4096
4096
4096
4096
4096
4096
4096
4096
4096
4096
4096
4096
4096
4096
4096
4096
4096
4096
4096
4096
4096
4096
4096
4096
4096
4096
4096
4096
4096
4096
4096
4096
4096
4096
4096
4096
4096
4096
4096
4096
4096
4096
4096
4096
4096
4096
4096
4096
4096
4096
4096
4096
4096
4096
4096
4096
4096
4096
4096
4096
4096
4096
4096
4096
4096
4096
4096
4096
4096
4096
4096
4096
4096
4096
4096
4096
4096
4096
4096
4096
4096
4096
4096
4096
4096
4096
4096
4096
4096
4096
4096
4096
4096
4096
4096
4096
4096
4096
4096
4096
4096
4096
4096
4096
4096
4096
4096
4096
4096
4096
4096
4096
4096
4096
4096
4096
4096
4096
4096
4096
4096
4096
4096
4096
4096
4096
4096
4096
4096
4096
4096
4096
4096
4096
4096
4096
4096
4096
4096
4096
4096
4096
4096
4096
4096
4096
4096
4096
4096
4096
4096
4096
4096
4096
4096
4096
4096
4096
4096
4096
4096
4096
4096
4096
4096
4096
4096
4096
4096
4096
4096
4096
4096
4096
4096
4096
4096
4096
4096
4096
4096
4096
4096
4096
4096
4096
4096
4096
4096
4096
4096
4096
4096
4096
4096
4096
4096
4096
4096
4096
4096
4096
4096
4096
4096
4096
4096
4096
4096
4096
4096
4096
4096
4096
4096
4096
4096
4096
4096
4096
4096
4096
4096
4096
4096
4096
4096
4096
4096
4096
4096
4096
4096
4096
4096
4096
4096
4096
4096
4096
4096
4096
4096
4096
4096
4096
4096
4096
4096
4096
4096
4096
4096
4096
4096
4096
4096
4096
4096
4096
4096
4096
4096
4096
4096
4096
4096
4096
4096
4096
4096
4096
4096
4096
4096
4096
4096
4096
4096
4096
4096
4096
4096
4096
4096
4096
4096
4096
4096
4096
4096
4096
4096
4096
4096
4096
4096
4096
4096
4096
4096
4096
4096
4096
4096
4096
4096
4096
4096
4096
4096
4096
4096
4096
4096
4096
4096
4096
4096
4096
4096
4096
4096
4096
4096
4096
4096
4096
4096
4096
4096
4096
4096
4096
4096
4096
4096
4096
4096
4096
4096
4096
4096
4096
4096
4096
4096
4096
4096
4096
4096
4096
4096
4096
4096
4096
4096
4096
4096
4096
4096
4096
4096
4096
4096
4096
4096
4096
4096
4096
4096
4096
4096
4096
4096
4096
4096
4096
4096
4096
4096
4096
4096
4096
4096
4096
4096
4096
4096
4096
4096
4096
4096
4096
4096
4096
4096
4096
4096
4096
4096
4096
4096
4096
4096
4096
4096
4096
4096
4096
4096
4096
4096
4096
4096
4096
4096
4096
4096
4096
4096
4096
4096
4096
4096
4096
4096
4096
4096
4096
4096
4096
4096
4096
4096
4096
4096
4096
4096
4096
4096
4096
4096
4096
4096
4096
4096
4096
4096
4096
4096
4096
4096
4096
4096
4096
4096
4096
4096
4096
4096
4096
4096
4096
4096
4096
4096
4096
4096
4096
4096
4096
4096
4096
4096
4096
4096
4096
4096
4096
4096
4096
4096
4096
4096
4096
4096
4096
4096
4096
4096
4096
4096
4096
4096
4096
4096
4096
4096
4096
4096
4096
4096
4096
4096
4096
4096
4096
4096
4096
4096
4096
4096
4096
4096
4096
4096
4096
4096
4096
4096
4096
4096
4096
4096
4096
4096
4096
4096
4096
4096
4096
4096
4096
4096
4096
4096
4096
4096
4096
4096
4096
4096
4096
4096
4096
4096
4096
4096
4096
4096
4096
4096
4096
4096
4096
4096
4096
4096
4096
4096
4096
4096
4096
4096
4096
4096
4096
4096
4096
4096
4096
4096
4096
4096
4096
4096
4096
4096
4096
4096
4096
4096
4096
4096
4096
4096
4096
4096
4096
4096
4096
4096
4096
4096
4096
4096
4096
4096
4096
4096
4096
4096
4096
4096
4096
4096
4096
4096
4096
4096
4096
4096
4096
4096
4096
4096
4096
4096
4096
4096
4096
4096
4096
4096
4096
4096
4096
4096
4096
4096
4096
4096
4096
4096
4096
4096
4096
4096
4096
4096
4096
4096
4096
4096
4096
4096
4096
4096
4096
4096
4096
4096
4096
4096
4096
4096
4096
4096
4096
4096
4096
4096
4096
4096
4096
4096
4096
4096
4096
4096
4096
4096
4096
4096
4096
4096
4096
4096
4096
4096
4096
4096
4096
4096
4096
4096
4096
4096
4096
4096
4096
4096
4096
4096
4096
4096
4096
4096
4096
4096
4096
4096
4096
4096
4096
4096
4096
4096
4096
4096
4096
4096
4096
4096
4096
4096
4096
4096
4096
4096
4096
4096
4096
4096
4096
4096
4096
4096
4096
4096
4096
4096
4096
4096
4096
4096
4096
4096
4096
4096
4096
4096
4096
4096
4096
4096
4096
4096
4096
4096
4096
4096
4096
4096
4096
4096
4096
4096
4096
4096
4096
4096
4096
4096
4096
4096
4096
4096
4096
4096
4096
4096
4096
4096
4096
4096
4096
4096
4096
4096
4096
4096
4096
4096
4096
4096
4096
4096
4096
4096
4096
4096
4096
4096
4096
4096
4096
4096
4096
4096
4096
4096
4096
4096
4096
4096
4096
4096
4096
4096
4096
4096
4096
4096
4096
4096
4096
4096
4096
4096
4096
4096
4096
4096
4096
4096
4096
4096
4096
4096
4096
4096
4096
4096
4096
4096
4096
4096
4096
4096
4096
4096
4096
4096
4096
4096
4096
4096
4096
4096
4096
4096
4096
4096
4096
4096
4096
4096
4096
4096
4096
4096
4096
4096
4096
4096
4096
4096
4096
4096
4096
4096
4096
4096
4096
4096
4096
4096
4096
4096
4096
4096
4096
4096
4096
4096
4096
4096
4096
4096
4096
4096
4096
4096
4096
4096
4096
4096
4096
4096
4096
4096
4096
4096
4096
4096
4096
4096
4096
4096
4096
4096
4096
4096
4096
4096
4096
4096
4096
4096
4096
4096
4096
4096
4096
4096
4096
4096
4096
4096
4096
4096
4096
4096
4096
4096
4096
4096
4096
4096
4096
4096
4096
4096
4096
4096
4096
4096
4096
4096
4096
4096
4096
4096
4096
4096
4096
4096
4096
4096
4096
4096
4096
4096
4096
4096
4096
4096
4096
4096
4096
4096
4096
4096
4096
4096
4096
4096
4096
4096
4096
4096
4096
4096
4096
4096
4096
4096
4096
4096
4096
4096
4096
4096
4096
4096
4096
4096
4096
4096
4096
4096
4096
4096
4096
4096
4096
4096
4096
4096
4096
4096
4096
4096
4096
4096
4096
4096
4096
4096
4096
4096
4096
4096
4096
4096
4096
4096
4096
4096
4096
4096
4096
4096
4096
4096
4096
4096
4096
4096
4096
4096
4096
4096
4096
4096
4096
4096
4096
4096
4096
4096
4096
4096
4096
4096
4096
4096
4096
4096
4096
4096
4096
4096
4096
4096
4096
4096
4096
4096
4096
4096
4096
4096
4096
4096
4096
4096
4096
4096
4096
4096
4096
4096
4096
4096
4096
4096
4096
4096
4096
4096
4096
4096
4096
4096
4096
4096
4096
4096
4096
4096
4096
4096
4096
4096
4096
4096
4096
4096
4096
4096
4096
4096
4096
4096
4096
4096
4096
4096
4096
4096
4096
4096
4096
4096
4096
4096
4096
4096
4096
4096
4096
4096
4096
4096
4096
4096
4096
4096
4096
4096
4096
4096
4096
4096
4096
4096
4096
4096
4096
4096
4096
4096
4096
4096
4096
4096
4096
4096
4096
4096
4096
4096
4096
4096
4096
4096
4096
4096
4096
4096
4096
4096
4096
4096
4096
4096
4096
4096
4096
4096
4096
4096
4096
4096
4096
4096
4096
4096
4096
4096
4096
4096
4096
4096
4096
4096
4096
4096
4096
4096
4096
4096
4096
4096
4096
4096
4096
4096
4096
4096
4096
4096
4096
4096
4096
4096
4096
4096
4096
4096
4096
4096
4096
4096
4096
4096
4096
4096
4096
4096
4096
4096
4096
4096
4096
4096
4096
4096
4096
4096
4096
4096
4096
4096
4096
4096
4096
4096
4096
4096
4096
4096
4096
4096
4096
4096
4096
4096
4096
4096
4096
4096
4096
4096
4096
4096
4096
4096
4096
4096
4096
4096
4096
4096
4096
4096
4096
4096
4096
4096
4096
4096
4096
4096
4096
4096
4096
4096
4096
4096
4096
4096
4096
4096
4096
4096
4096
4096
4096
4096
4096
4096
4096
4096
4096
4096
4096
4096
4096
4096
4096
4096
4096
4096
4096
4096
4096
4096
4096
4096
4096
4096
4096
4096
4096
4096
4096
4096
4096
4096
4096
4096
4096
4096
4096
4096
4096
4096
4096
4096
4096
4096
4096
4096
4096
4096
4096
4096
4096
4096
4096
4096
4096
4096
4096
4096
4096
4096
4096
4096
4096
4096
4096
4096
4096
4096
4096
4096
4096
4096
4096
4096
4096
4096
4096
4096
4096
4096
4096
4096
4096
4096
4096
4096
4096
4096
4096
4096
4096
4096
4096
4096
4096
4096
4096
4096
4096
4096
4096
4096
4096
4096
4096
4096
4096
4096
4096
4096
4096
4096
4096
4096
4096
4096
4096
4096
4096
4096
4096
4096
4096
4096
4096
4096
4096
4096
4096
4096
4096
4096
4096
4096
4096
4096
4096
4096
4096
4096
4096
4096
4096
4096
4096
4096
4096
4096
4096
4096
4096
4096
4096
4096
4096
4096
4096
4096
4096
4096
4096
4096
4096
4096
4096
4096
4096
4096
4096
4096
4096
4096
4096
4096
4096
4096
4096
4096
4096
4096
4096
4096
4096
4096
4096
4096
4096
4096
4096
4096
4096
4096
4096
4096
4096
4096
4096
4096
4096
4096
4096
4096
4096
4096
4096
4096
4096
4096
4096
4096
4096
4096
4096
4096
4096
4096
4096
4096
4096
4096
4096
4096
4096
4096
4096
4096
4096
4096
4096
4096
4096
4096
4096
4096
4096
4096
4096
4096
4096
4096
4096
4096
4096
4096
4096
4096
4096
4096
4096
4096
4096
4096
4096
4096
4096
4096
4096
4096
4096
4096
4096
4096
4096
4096
4096
4096
4096
4096
4096
4096
4096
4096
4096
4096
4096
4096
4096
4096
4096
4096
4096
4096
4096
4096
4096
4096
4096
4096
4096
4096
4096
4096
4096
4096
4096
4096
4096
4096
4096
4096
4096
4096
4096
4096
4096
4096
4096
4096
4096
4096
4096
4096
4096
4096
4096
4096
4096
4096
4096
4096
4096
4096
4096
4096
4096
4096
4096
4096
4096
4096
4096
4096
4096
4096
4096
4096
4096
4096
4096
4096
4096
4096
4096
4096
4096
4096
4096
4096
4096
4096
4096
4096
4096
4096
4096
4096
4096
4096
4096
4096
4096
4096
4096
4096
4096
4096
4096
4096
4096
4096
4096
4096
4096
4096
4096
4096
4096
4096
4096
4096
4096
4096
4096
4096
4096
4096
4096
4096
4096
4096
4096
4096
4096
4096
4096
4096
4096
4096
4096
4096
4096
4096
4096
4096
4096
4096
4096
4096
4096
4096
4096
4096
4096
4096
4096
4096
4096
4096
4096
4096
4096
4096
4096
4096
4096
4096
4096
4096
4096
4096
4096
4096
4096
4096
4096
4096
4096
4096
4096
4096
4096
4096
4096
4096
4096
4096
4096
4096
4096
4096
4096
4096
4096
4096
4096
4096
4096
4096
4096
4096
4096
4096
4096
4096
4096
4096
4096
4096
4096
4096
4096
4096
4096
4096
4096
4096
4096
4096
4096
4096
4096
4096
4096
4096
4096
4096
4096
4096
4096
4096
4096
4096
4096
4096
4096
4096
4096
4096
4096
4096
4096
4096
4096
4096
4096
4096
4096
4096
4096
4096
4096
4096
4096
4096
4096
4096
4096
4096
4096
4096
4096
4096
4096
4096
4096
4096
4096
4096
4096
4096
4096
4096
4096
4096
4096
4096
4096
4096
4096
4096
4096
4096
4096
4096
4096
4096
4096
4096
4096
4096
4096
4096
4096
4096
4096
4096
4096
4096
4096
4096
4096
4096
4096
4096
4096
4096
4096
4096
4096
4096
4096
4096
4096
4096
4096
4096
4096
4096
4096
4096
4096
4096
4096
4096
4096
4096
4096
4096
4096
4096
4096
4096
4096
4096
4096
4096
4096
4096
4096
4096
4096
4096
4096
4096
4096
4096
4096
4096
4096
4096
4096
4096
4096
4096
4096
4096
4096
4096
4096
4096
4096
4096
4096
4096
4096
4096
4096
4096
4096
4096
4096
4096
4096
4096
4096
4096
4096
4096
4096
4096
4096
4096
4096
4096
4096
4096
4096
4096
4096
4096
4096
4096
4096
4096
4096
4096
4096
4096
4096
4096
4096
4096
4096
4096
4096
4096
4096
4096
4096
4096
4096
4096
4096
4096
4096
4096
4096
4096
4096
4096
4096
4096
4096
4096
4096
4096
4096
4096
4096
4096
4096
4096
4096
4096
4096
4096
4096
4096
4096
4096
4096
4096
4096
4096
4096
4096
4096
4096
4096
4096
4096
4096
4096
4096
4096
4096
4096
4096
4096
4096
4096
4096
4096
4096
4096
4096
4096
4096
4096
4096
4096
4096
4096
4096
4096
4096
4096
4096
4096
4096
4096
4096
4096
4096
4096
4096
4096
4096
4096
4096
4096
4096
4096
4096
4096
4096
4096
4096
4096
4096
4096
4096
4096
4096
4096
4096
4096
4096
4096
4096
4096
4096
4096
4096
4096
4096
4096
4096
4096
4096
4096
4096
4096
4096
4096
4096
4096
4096
4096
4096
4096
4096
4096
4096
4096
4096
4096
4096
4096
4096
4096
4096
4096
4096
4096
4096
4096
4096
4096
4096
4096
4096
4096
4096
4096
4096
4096
4096
4096
4096
4096
4096
4096
4096
4096
4096
4096
4096
4096
4096
4096
4096
4096
4096
4096
4096
4096
4096
4096
4096
4096
4096
4096
4096
4096
4096
4096
4096
4096
4096
4096
4096
4096
4096
4096
4096
4096
4096
4096
4096
4096
4096
4096
4096
4096
4096
4096
4096
4096
4096
4096
4096
4096
4096
4096
4096
4096
4096
4096
4096
4096
4096
4096
4096
4096
4096
4096
4096
4096
4096
4096
4096
4096
4096
4096
4096
4096
4096
4096
4096
4096
4096
4096
4096
4096
4096
4096
4096
4096
4096
4096
4096
4096
4096
4096
4096
4096
4096
4096
4096
4096
4096
4096
4096
4096
4096
4096
4096
4096
4096
4096
4096
4096
4096
4096
4096
4096
4096
4096
4096
4096
4096
4096
4096
4096
4096
4096
4096
4096
4096
4096
4096
4096
4096
4096
4096
4096
4096
4096
4096
4096
4096
4096
4096
4096
4096
4096
4096
4096
4096
4096
4096
4096
4096
4096
4096
4096
4096
4096
4096
4096
4096
4096
4096
4096
4096
4096
4096
4096
4096
4096
4096
4096
4096
4096
4096
4096
4096
4096
4096
4096
4096
4096
4096
4096
4096
4096
4096
4096
4096
4096
4096
4096
4096
4096
4096
4096
4096
4096
4096
4096
4096
4096
4096
4096
4096
4096
4096
4096
4096
4096
4096
4096
4096
4096
4096
4096
4096
4096
4096
4096
4096
4096
4096
4096
4096
4096
4096
4096
4096
4096
4096
4096
4096
4096
4096
4096
4096
4096
4096
4096
4096
4096
4096
4096
4096
4096
4096
4096
4096
4096
4096
4096
4096
4096
4096
4096
4096
4096
4096
4096
4096
4096
4096
4096
4096
4096
4096
4096
4096
4096
4096
4096
4096
4096
4096
4096
4096
4096
4096
4096
4096
4096
4096
4096
4096
4096
4096
4096
4096
4096
4096
4096
4096
4096
4096
4096
4096
4096
4096
4096
4096
4096
4096
4096
4096
4096
4096
4096
4096
4096
4096
4096
4096
4096
4096
4096
4096
4096
4096
4096
4096
4096
4096
4096
4096
4096
4096
4096
4096
4096
4096
4096
4096
4096
4096
4096
4096
4096
4096
4096
4096
4096
4096
4096
4096
4096
4096
4096
4096
4096
4096
4096
4096
4096
4096
4096
4096
4096
4096
4096
4096
4096
4096
4096
4096
4096
4096
4096
4096
4096
4096
4096
4096
4096
4096
4096
4096
4096
4096
4096
4096
4096
4096
4096
4096
4096
4096
4096
4096
4096
4096
4096
4096
4096
4096
4096
4096
4096
4096
4096
4096
4096
4096
4096
4096
4096
4096
4096
4096
4096
4096
4096
4096
4096
4096
4096
4096
4096
4096
4096
4096
4096
4096
4096
4096
4096
4096
4096
4096
4096
4096
4096
4096
4096
4096
4096
4096
4096
4096
4096
4096
4096
4096
4096
4096
4096
4096
4096
4096
4096
4096
4096
4096
4096
4096
4096
4096
4096
4096
4096
4096
4096
4096
4096
4096
4096
4096
4096
4096
4096
4096
4096
4096
4096
4096
4096
4096
4096
4096
4096
4096
4096
4096
4096
4096
4096
4096
4096
4096
4096
4096
4096
4096
4096
4096
4096
4096
4096
4096
4096
4096
4096
4096
4096
4096
4096
4096
4096
4096
4096
4096
4096
4096
4096
4096
4096
4096
4096
4096
4096
4096
4096
4096
4096
4096
4096
4096
4096
4096
4096
4096
4096
4096
4096
4096
4096
4096
4096
4096
4096
4096
4096
4096
4096
4096
4096
4096
4096
4096
4096
4096
4096
4096
4096
4096
4096
4096
4096
4096
4096
4096
4096
4096
4096
4096
4096
4096
4096
4096
4096
4096
4096
4096
4096
4096
4096
4096
4096
4096
4096
4096
4096
4096
4096
4096
4096
4096
4096
4096
4096
4096
4096
4096
4096
4096
4096
4096
4096
4096
4096
4096
4096
4096
4096
4096
4096
4096
4096
4096
4096
4096
4096
4096
4096
4096
4096
4096
4096
4096
4096
4096
4096
4096
4096
4096
4096
4096
4096
4096
4096
4096
4096
4096
4096
4096
4096
4096
4096
4096
4096
4096
4096
4096
4096
4096
4096
4096
4096
4096
4096
4096
4096
4096
4096
4096
4096
4096
4096
4096
4096
4096
4096
4096
4096
4096
4096
4096
4096
4096
4096
4096
4096
4096
4096
4096
4096
4096
4096
4096
4096
4096
4096
4096
4096
4096
4096
4096
4096
4096
4096
4096
4096
4096
4096
4096
4096
4096
4096
4096
4096
4096
4096
4096
4096
4096
4096
4096
4096
4096
4096
4096
4096
4096
4096
4096
4096
4096
4096
4096
4096
4096
4096
4096
4096
4096
4096
4096
4096
4096
4096
4096
4096
4096
4096
4096
4096
4096
4096
4096
4096
4096
4096
4096
4096
4096
4096
4096
4096
4096
4096
4096
4096
4096
4096
4096
4096
4096
4096
4096
4096
4096
4096
4096
4096
4096
4096
4096
4096
4096
4096
4096
4096
4096
4096
4096
4096
4096
4096
4096
4096
4096
4096
4096
4096
4096
4096
4096
4096
4096
4096
4096
4096
4096
4096
4096
4096
4096
4096
4096
4096
4096
4096
4096
4096
4096
4096
4096
4096
4096
4096
4096
4096
4096
4096
4096
4096
4096
4096
4096
4096
4096
4096
4096
4096
4096
4096
4096
4096
4096
4096
4096
4096
4096
4096
4096
4096
4096
4096
4096
4096
4096
4096
4096
4096
4096
4096
4096
4096
4096
4096
4096
4096
4096
4096
4096
4096
4096
4096
4096
4096
4096
4096
4096
4096
4096
4096
4096
4096
4096
4096
4096
4096
4096
4096
4096
4096
4096
4096
4096
4096
4096
4096
4096
4096
4096
4096
4096
4096
4096
4096
4096
4096
4096
4096
4096
4096
4096
4096
4096
4096
4096
4096
4096
4096
4096
4096
4096
4096
4096
4096
4096
4096
4096
4096
4096
4096
4096
4096
4096
4096
4096
4096
4096
4096
4096
4096
4096
4096
4096
4096
4096
4096
4096
4096
4096
4096
4096
4096
4096
4096
4096
4096
4096
4096
4096
4096
4096
4096
4096
4096
4096
4096
4096
4096
4096
4096
4096
4096
4096
4096
4096
4096
4096
4096
4096
4096
4096
4096
4096
4096
4096
4096
4096
4096
4096
4096
4096
4096
4096
4096
4096
4096
4096
4096
4096
4096
4096
4096
4096
4096
4096
4096
4096
4096
4096
4096
4096
4096
4096
4096
4096
4096
4096
4096
4096
4096
4096
4096
4096
4096
4096
4096
4096
4096
4096
4096
4096
4096
4096
4096
4096
4096
4096
4096
4096
4096
4096
4096
4096
4096
4096
4096
4096
4096
4096
4096
4096
4096
4096
4096
4096
4096
4096
4096
4096
4096
4096
4096
4096
4096
4096
4096
4096
4096
4096
4096
4096
4096
4096
4096
4096
4096
4096
4096
4096
4096
4096
4096
4096
4096
4096
4096
4096
4096
4096
4096
4096
4096
4096
4096
4096
4096
4096
4096
4096
4096
4096
4096
4096
4096
4096
4096
4096
4096
4096
4096
4096
4096
4096
4096
4096
4096
4096
4096
4096
4096
4096
4096
4096
4096
4096
4096
4096
4096
4096
4096
4096
4096
4096
4096
4096
4096
4096
4096
4096
4096
4096
4096
4096
4096
4096
4096
4096
4096
4096
4096
4096
4096
4096
4096
4096
4096
4096
4096
4096
4096
4096
4096
4096
4096
4096
4096
4096
4096
4096
4096
4096
4096
4096
4096
4096
4096
4096
4096
4096
4096
4096
4096
4096
4096
4096
4096
4096
4096
4096
4096
4096
4096
4096
4096
4096
4096
4096
4096
4096
4096
4096
4096
4096
4096
4096
4096
4096
4096
4096
4096
4096
4096
4096
4096
4096
4096
4096
4096
4096
4096
4096
4096
4096
4096
4096
4096
4096
4096
4096
4096
4096
4096
4096
4096
4096
4096
4096
4096
4096
4096
4096
4096
4096
4096
4096
4096
4096
4096
4096
4096
4096
4096
4096
4096
4096
4096
4096
4096
4096
4096
4096
4096
4096
4096
4096
4096
4096
4096
4096
4096
4096
4096
4096
4096
4096
4096
4096
4096
4096
4096
4096
4096
4096
4096
4096
4096
4096
4096
4096
4096
4096
4096
4096
4096
4096
4096
4096
4096
4096
4096
4096
4096
4096
4096
4096
4096
4096
4096
4096
4096
4096
4096
4096
4096
4096
4096
4096
4096
4096
4096
4096
4096
4096
4096
4096
4096
4096
4096
4096
4096
4096
4096
4096
4096
4096
4096
4096
4096
4096
4096
4096
4096
4096
4096
4096
4096
4096
4096
4096
4096
4096
4096
4096
4096
4096
4096
4096
4096
4096
4096
4096
4096
4096
4096
4096
4096
4096
4096
4096
4096
4096
4096
4096
4096
4096
4096
4096
4096
4096
4096
4096
4096
4096
4096
4096
4096
4096
4096
4096
4096
4096
4096
4096
4096
4096
4096
4096
4096
4096
4096
4096
4096
4096
4096
4096
4096
4096
4096
4096
4096
4096
4096
4096
4096
4096
4096
4096
4096
4096
4096
4096
4096
4096
4096
4096
4096
4096
4096
4096
4096
4096
4096
4096
4096
4096
4096
4096
4096
4096
4096
4096
4096
4096
4096
4096
4096
4096
4096
4096
4096
4096
4096
4096
4096
4096
4096
4096
4096
4096
4096
4096
4096
4096
4096
4096
4096
4096
4096
4096
4096
4096
4096
4096
4096
4096
4096
4096
4096
4096
4096
4096
4096
4096
4096
4096
4096
4096
4096
4096
4096
4096
4096
4096
4096
4096
4096
4096
4096
4096
4096
4096
4096
4096
4096
4096
4096
4096
4096
4096
4096
4096
4096
4096
4096
4096
4096
4096
4096
4096
4096
4096
4096
4096
4096
4096
4096
4096
4096
4096
4096
4096
4096
4096
4096
4096
4096
4096
4096
4096
4096
4096
4096
4096
4096
4096
4096
4096
4096
4096
4096
4096
4096
4096
4096
4096
4096
4096
4096
4096
4096
4096
4096
4096
4096
4096
4096
4096
4096
4096
4096
4096
4096
4096
4096
4096
4096
4096
4096
4096
4096
4096
4096
4096
4096
4096
4096
4096
4096
4096
4096
4096
4096
4096
4096
4096
4096
4096
4096
4096
4096
4096
4096
4096
4096
4096
4096
4096
4096
4096
4096
4096
4096
4096
4096
4096
4096
4096
4096
4096
4096
4096
4096
4096
4096
4096
4096
4096
4096
4096
4096
4096
4096
4096
4096
4096
4096
4096
4096
4096
4096
4096
4096
4096
4096
4096
4096
4096
4096
4096
4096
4096
4096
4096
4096
4096
4096
4096
4096
4096
4096
4096
4096
4096
4096
4096
4096
4096
4096
4096
4096
4096
4096
4096
4096
4096
4096
4096
4096
4096
4096
4096
4096
4096
4096
4096
4096
4096
4096
4096
4096
4096
4096
4096
4096
4096
4096
4096
4096
4096
4096
4096
4096
4096
4096
4096
4096
4096
4096
4096
4096
4096
4096
4096
4096
4096
4096
4096
4096
4096
4096
4096
4096
4096
4096
4096
4096
4096
4096
4096
4096
4096
4096
4096
4096
4096
4096
4096
4096
4096
4096
4096
4096
4096
4096
4096
4096
4096
4096
4096
4096
4096
4096
4096
4096
4096
4096
4096
4096
4096
4096
4096
4096
4096
4096
4096
4096
4096
4096
4096
4096
4096
4096
4096
4096
4096
4096
4096
4096
4096
4096
4096
4096
4096
4096
4096
4096
4096
4096
4096
4096
4096
4096
4096
4096
4096
4096
4096
4096
4096
4096
4096
4096
4096
4096
4096
4096
4096
4096
4096
4096
4096
4096
4096
4096
4096
4096
4096
4096
4096
4096
4096
4096
4096
4096
4096
4096
4096
4096
4096
4096
4096
4096
4096
4096
4096
4096
4096
4096
4096
4096
4096
4096
4096
4096
4096
4096
4096
4096
4096
4096
4096
4096
4096
4096
4096
4096
4096
4096
4096
4096
4096
4096
4096
4096
4096
4096
4096
4096
4096
4096
4096
4096
4096
4096
4096
4096
4096
4096
4096
4096
4096
4096
4096
4096
4096
4096
4096
4096
4096
4096
4096
4096
4096
4096
4096
4096
4096
4096
4096
4096
4096
4096
4096
4096
4096
4096
4096
4096
4096
4096
4096
4096
4096
4096
4096
4096
4096
4096
4096
4096
4096
4096
4096
4096
4096
4096
4096
4096
4096
4096
4096
4096
4096
4096
4096
4096
4096
4096
4096
4096
4096
4096
4096
4096
4096
4096
4096
4096
4096
4096
4096
4096
4096
4096
4096
4096
4096
4096
4096
4096
4096
4096
4096
4096
4096
4096
4096
4096
4096
4096
4096
4096
4096
4096
4096
4096
4096
4096
4096
4096
4096
4096
4096
4096
4096
4096
4096
4096
4096
4096
4096
4096
4096
4096
4096
4096
4096
4096
4096
4096
4096
4096
4096
4096
4096
4096
4096
4096
4096
4096
4096
4096
4096
4096
4096
4096
4096
4096
4096
4096
4096
4096
4096
4096
4096
4096
4096
4096
4096
4096
4096
4096
4096
4096
4096
4096
4096
4096
4096
4096
4096
4096
4096
4096
4096
4096
4096
4096
4096
4096
4096
4096
4096
4096
4096
4096
4096
4096
4096
4096
4096
4096
4096
4096
4096
4096
4096
4096
4096
4096
4096
4096
4096
4096
4096
4096
4096
4096
4096
4096
4096
4096
4096
4096
4096
4096
4096
4096
4096
4096
4096
4096
4096
4096
4096
4096
4096
4096
4096
4096
4096
4096
4096
4096
4096
4096
4096
4096
4096
4096
4096
4096
4096
4096
4096
4096
4096
4096
4096
4096
4096
4096
4096
4096
4096
4096
4096
4096
4096
4096
4096
4096
4096
4096
4096
4096
4096
4096
4096
4096
4096
4096
4096
4096
4096
4096
4096
4096
4096
4096
4096
4096
4096
4096
4096
4096
4096
4096
4096
4096
4096
4096
4096
4096
4096
4096
4096
4096
4096
4096
4096
4096
4096
4096
4096
4096
4096
4096
4096
4096
4096
4096
4096
4096
4096
4096
4096
4096
4096
4096
4096
4096
4096
4096
4096
4096
4096
4096
4096
4096
4096
4096
4096
4096
4096
4096
4096
4096
4096
4096
4096
4096
4096
4096
4096
4096
4096
4096
4096
4096
4096
4096
4096
4096
4096
4096
4096
4096
4096
4096
4096
4096
4096
4096
4096
4096
4096
4096
4096
4096
4096
4096
4096
4096
4096
4096
4096
4096
4096
4096
4096
4096
4096
4096
4096
4096
4096
4096
4096
4096
4096
4096
4096
4096
4096
4096
4096
4096
4096
4096
4096
4096
4096
4096
4096
4096
4096
4096
4096
4096
4096
4096
4096
4096
4096
4096
4096
4096
4096
4096
4096
4096
4096
4096
4096
4096
4096
4096
4096
4096
4096
4096
4096
4096
4096
4096
4096
4096
4096
4096
4096
4096
4096
4096
4096
4096
4096
4096
4096
4096
4096
4096
4096
4096
4096
4096
4096
4096
4096
4096
4096
4096
4096
4096
4096
4096
4096
4096
4096
4096
4096
4096
4096
4096
4096
4096
4096
4096
4096
4096
4096
4096
4096
4096
4096
4096
4096
4096
4096
4096
4096
4096
4096
4096
4096
4096
4096
4096
4096
4096
4096
4096
4096
4096
4096
4096
4096
4096
4096
4096
4096
4096
4096
4096
4096
4096
4096
4096
4096
4096
4096
4096
4096
4096
4096
4096
4096
4096
4096
4096
4096
4096
4096
4096
4096
4096
4096
4096
4096
4096
3180
3188
3188
3188
3188
3188
3188
3188
3188
3192
3192
3192
3192
3192
3192
3192
3192
3192
3192
3196
3196
3196
3196
3196
3196
3196
3196
3196
3196
3196
3196
3201
3201
3201
3201
3201
3201
3201
3201
3205
3205
3205
3205
3205
3205
3205
3205
3205
3205
3205
3209
3209
3209
3209
3209
3213
3213
3213
3213
3213
3213
3213
3213
3213
3213
3217
3217
3217
3217
3217
3217
3217
3217
3221
3221
3221
3221
3221
3221
3221
3221
3221
3221
3225
3225
3225
3225
3225
3225
3225
3225
3225
3225
3225
3229
3229
3229
3229
3229
3229
3229
3229
3229
3229
3229
3233
3233
3233
3233
3233
3233
3237
3237
3237
3237
3237
3237
3237
3237
3237
3237
3237
3245
3245
3249
3249
3249
3249
3249
3249
3249
3249
3249
3249
3249
3253
3253
3253
3253
3253
3253
3253
3253
3253
3253
3253
3257
3257
3257
3257
3257
3257
3257
3257
3257
3257
3257
3257
3261
3261
3261
3261
3261
3265
3265
3265
3265
3265
3265
3265
3265
3265
3269
3269
3269
3269
3269
3269
3269
3269
3269
3269
3273
3273
3273
3273
3273
3273
3273
3273
3273
3273
3273
3273
3277
3277
3277
3277
3277
3277
3277
3277
3281
3281
3281
3281
3281
3281
3281
3281
3281
3285
3285
3285
3285
3285
3285
3285
3289
3289
3289
3289
3289
3289
3289
3289
3289
3289
3293
3293
3293
3293
3293
3293
3293
3293
3297
3297
3297
3297
3297
3297
3297
3297
3305
3309
3309
3309
3309
3309
3309
3309
3309
3309
3313
3313
3313
3313
3313
3313
3313
3313
3313
3313
3313
3313
3317
3317
3317
3317
3321
3321
3321
3321
3321
3321
3321
3321
3325
3325
3325
3325
3325
3325
3325
3325
3325
3329
3329
3329
3329
3329
3329
3329
3329
3329
3329
3329
3333
3333
3333
3333
3333
3333
3333
3333
3337
3337
3337
3337
3337
3337
3337
3337
3337
3337
3337
3341
3341
3341
3341
3341
3341
3341
3345
3345
3345
3345
3345
3345
3345
3349
3349
3349
3349
3349
3349
3349
3349
3349
3349
3353
3353
3353
3353
3353
3353
3353
3353
3353
3353
3357
3357
3357
3357
3357
3357
3357
3357
3357
3357
3361
3361
3361
3361
3369
3369
3369
3369
3369
3369
3369
3369
3369
3373
3373
3373
3373
3377
3377
3377
3377
3377
3377
3377
3377
3377
3377
3377
3377
3377
3381
3381
3381
3381
3381
3381
3381
3381
3381
3381
3381
3385
3385
3385
3385
3385
3385
3385
3385
3385
3385
3385
3389
3389
3389
3389
3389
3389
3389
3389
3389
3389
3389
3393
3393
3393
3393
3393
3393
3393
3393
3397
3397
3397
3397
3397
3397
3397
3397
3401
3401
3401
3401
3401
3401
3401
3401
3401
3401
3405
3405
3405
3405
3405
3405
3405
3405
3405
3405
3405
3405
3405
3409
3409
3409
3409
3409
3409
3409
3409
3413
3413
3413
3413
3413
3413
3413
3413
3413
3413
3413
3413
3413
3413
3417
3417
3425
3425
3425
3425
3425
3425
3429
3429
3429
3429
3429
3429
3429
3429
3429
3429
3429
3433
3433
3433
3433
3433
3433
3433
3433
3433
3433
3433
3437
3437
3437
3437
3437
3437
3437
3437
3437
3437
3437
3441
3441
3441
3441
3441
3441
3441
3441
3441
3441
3445
3445
3445
3445
3449
3449
3449
3449
3449
3449
3449
3449
3449
3449
3449
3449
3453
3453
3453
3453
3453
3453
3453
3453
3453
3458
3458
3458
3458
3458
3458
3458
3458
3458
3462
3462
3462
3462
3462
3462
3462
3462
3462
3462
3466
3466
3466
3466
3466
3466
3466
3466
3470
3470
3470
3470
3470
3470
3474
3474
3474
3474
3474
3474
3474
3474
3478
3478
3478
3478
3478
3478
3486
3486
3486
3486
3486
3486
3486
3486
3490
3490
3490
3490
3490
3490
3490
3490
3490
3490
3490
3490
3494
3494
3494
3494
3494
3494
3494
3494
3494
3494
3498
3498
3498
3498
3498
3498
3498
3498
3498
3502
3502
3502
3502
3502
3502
3502
3502
3502
3506
3506
3506
3506
3506
3506
3506
3506
3506
3506
3506
3506
3510
3510
3510
3510
3510
3510
3510
3510
3510
3514
3514
3514
3514
3514
3514
3514
3514
3514
3514
3518
3518
3518
3518
3518
3518
3518
3518
3518
3518
3518
3518
3522
3522
3522
3522
3522
3526
3526
3526
3526
3526
3526
3526
3526
3526
3526
3526
3526
3530
3530
3530
3530
3530
3530
3530
3530
3530
3530
3530
3534
3534
3534
3538
3538
3542
3542
3542
3542
3542
3542
3542
3542
3542
3546
3546
3546
3546
3546
3546
3546
3546
3546
3546
3550
3550
3550
3550
3550
3554
3554
3554
3554
3554
3554
3554
3554
3554
3554
3558
3558
3558
3558
3558
3558
3558
3558
3558
3562
3562
3562
3562
3562
3562
3562
3562
3562
3562
3562
3566
3566
3566
3566
3566
3566
3566
3566
3566
3566
3570
3570
3570
3570
3570
3570
3570
3570
3570
3574
3574
3574
3574
3574
3578
3578
3578
3578
3578
3578
3578
3578
3578
3578
3582
3582
3582
3582
3582
3582
3582
3582
3582
3582
3582
3586
3586
3586
3586
3586
3586
3586
3586
3586
3586
3586
3590
3590
3590
3590
3590
3590
3590
3590
3590
3598
3598
3598
3598
3598
3602
3602
3602
3602
3602
3602
3602
3602
3606
3606
3606
3606
3606
3606
3606
3606
3610
3610
3610
3610
3610
3610
3610
3610
3610
3610
3614
3614
3614
3614
3614
3614
3614
3614
3614
3614
3614
3614
3618
3618
3618
3618
3618
3618
3618
3618
3618
3618
3618
3622
3622
3622
3622
3622
3622
3622
3622
3622
3626
3626
3626
3626
3626
3626
3626
3630
3630
3630
3630
3630
3630
3630
3630
3630
3630
3634
3634
3634
3634
3634
3634
3634
3634
3634
3634
3638
3638
3638
3638
3638
3638
3638
3638
3638
3638
3638
3638
3642
3642
3642
3642
3642
3642
3642
3642
3642
3642
3642
3646
3646
3646
3646
3646
3646
3646
3646
3650
3658
3658
3658
3658
3658
3658
3658
3658
3658
3662
3662
3662
3662
3662
3662
3662
3662
3662
3662
3666
3666
3666
3666
3666
3666
3666
3666
3666
3666
3666
3670
3670
3670
3670
3670
3670
3670
3674
3674
3674
3674
3674
3674
3674
3674
3674
3674
3674
3678
3678
3678
3678
3678
3678
3682
3682
3682
3682
3682
3682
3682
3682
3682
3682
3682
3686
3686
3686
3686
3686
3686
3686
3686
3690
3690
3690
3690
3690
3690
3690
3690
3690
3690
3690
3694
3694
3694
3694
3694
3694
3694
3694
3694
3694
3694
3694
3698
3698
3698
3698
3698
3698
3698
3698
3698
3698
3698
3702
3702
3702
3702
3702
3706
3706
3706
3706
3706
3706
3706
3706
3706
3715
3715
3715
3715
3715
3715
3715
3715
3715
3719
3719
3719
3719
3719
3719
3719
3719
3719
3719
3719
3723
3723
3723
3723
3723
3723
3723
3723
3723
3723
3723
3723
3723
3727
3727
3727
3727
3727
3727
3727
3731
3731
3731
3731
3731
3731
3735
3735
3735
3735
3735
3735
3735
3735
3735
3735
3739
3739
3739
3739
3739
3739
3739
3739
3739
3739
3743
3743
3743
3743
3743
3743
3743
3743
3743
3743
3743
3743
3747
3747
3747
3747
3747
3747
3747
3747
3747
3751
3751
3751
3751
3751
3751
3751
3755
3755
3755
3755
3755
3755
3759
3759
3759
3759
3759
3759
3759
3759
3759
3759
3763
3763
3763
3763
3763
3763
3763
3763
3763
3767
3767
3767
3775
3775
3775
3775
3775
3775
3775
3775
3775
3775
3779
3779
3779
3779
3779
3779
3779
3779
3779
3779
3779
3783
3783
3783
3783
3783
3787
3787
3787
3787
3787
3787
3787
3787
3791
3791
3791
3791
3791
3791
3791
3791
3791
3791
3791
3791
3791
3795
3795
3795
3795
3795
3795
3795
3795
3795
3795
3795
3799
3799
3799
3799
3799
3799
3799
3799
3799
3799
3799
3803
3803
3803
3803
3803
3803
3803
3803
3803
3803
3803
3807
3807
3807
3807
3811
3811
3811
3811
3811
3811
3811
3811
3811
3811
3815
3815
3815
3815
3815
3815
3815
3815
3815
3815
3815
3819
3819
3819
3819
3819
3819
3819
3819
3819
3819
3823
3823
3823
3823
3823
3823
3831
3831
3831
3831
3831
3831
3831
3835
3835
3835
3835
3835
3835
3839
3839
3839
3839
3839
3839
3839
3839
3839
3843
3843
3843
3843
3843
3843
3843
3843
3843
3843
3843
3847
3847
3847
3847
3847
3847
3847
3847
3847
3847
3851
3851
3851
3851
3851
3851
3851
3851
3851
3851
3851
3855
3855
3855
3855
3855
3855
3855
3855
3855
3855
3855
3859
3859
3859
3859
3859
3859
3863
3863
3863
3863
3863
3863
3863
3863
3863
3863
3863
3863
3863
3867
3867
3867
3867
3867
3867
3867
3867
3867
3867
3867
3867
3867
3867
3867
3867
3871
3871
3871
3871
3871
3871
3871
3871
3871
3871
3871
3871
3875
3875
3875
3875
3875
3875
3875
3875
3875
3879
3887
3887
3887
3887
3887
3887
3887
3887
3887
3887
3887
3887
3891
3891
3891
3891
3891
3891
3891
3891
3891
3891
3891
3895
3895
3895
3895
3895
3895
3895
3895
3895
3895
3895
3895
3895
3899
3899
3899
3899
3899
3899
3899
3899
3899
3899
3899
3899
3899
3903
3903
3903
3903
3903
3907
3907
3907
3907
3907
3907
3907
3907
3907
3907
3907
3907
3907
3911
3911
3911
3911
3911
3911
3911
3911
3911
3911
3911
3911
3911
3915
3915
3915
3915
3915
3915
3915
3915
3915
3915
3915
3919
3919
3919
3919
3919
3919
3919
3919
3919
3919
3923
3923
3923
3923
3923
3923
3923
3923
3927
3927
3927
3927
3927
3927
3927
3927
3927
3927
3931
3931
3939
3939
3939
3939
3939
3939
3939
3939
3939
3939
3939
3939
3943
3943
3943
3943
3943
3943
3943
3943
3943
3943
3943
3943
3947
3947
3947
3947
3947
3947
3947
3947
3947
3947
3947
3951
3951
3951
3951
3951
3955
3955
3955
3955
3955
3955
3955
3955
3955
3955
3955
3955
3959
3959
3959
3959
3959
3959
3959
3959
3959
3959
3959
3959
3963
3963
3963
3963
3963
3963
3963
3963
3963
3963
3963
3967
3967
3967
3967
3967
3967
3967
3967
3967
3967
3967
3967
3967
3967
3972
3972
3972
3972
3972
3972
3976
3976
3976
3976
3976
3976
3976
3976
3976
3976
3976
3976
3980
3980
3980
3980
3980
3980
3980
3980
3980
3980
3980
3980
3980
3980
3980
3992
3992
3992
3992
3992
3992
3992
3992
3992
3992
3992
3992
3996
3996
3996
3996
3996
3996
3996
3996
3996
3996
3996
4000
4000
4000
4000
4004
4004
4004
4004
4004
4004
4004
4004
4004
4004
4004
4004
4004
4004
4008
4008
4008
4008
4008
4008
4008
4012
4012
4012
4012
4012
4012
4012
4012
4012
4012
4012
4016
4016
4016
4016
4016
4016
4016
4016
4016
4016
4016
4016
4016
4020
4020
4020
4020
4020
4020
4020
4020
4024
4024
4024
4024
4024
4024
4024
4024
4024
4024
4028
4028
4028
4028
4028
4028
4028
4028
4028
4028
4028
4032
4032
4032
4032
4032
4032
4032
4032
4032
4032
4032
4036
4036
4036
4036
4036
4036
4036
4036
4036
4044
4044
4044
4044
4044
4044
4048
4048
4048
4048
4048
4048
4048
4052
4052
4052
4052
4052
4052
4052
4052
4056
4056
4056
4056
4056
4056
4056
4056
4056
4056
4056
4056
4056
4056
4060
4060
4060
4060
4060
4060
4060
4060
4060
4060
4060
4064
4064
4064
4064
4064
4064
4064
4064
4064
4064
4064
4068
4068
4068
4068
4068
4068
4068
4068
4068
4068
4072
4072
4072
4072
4072
4072
4072
4076
4076
4076
4076
4076
4076
4076
4076
4076
4076
4076
4080
4080
4080
4080
4080
4080
4080
4080
4080
4084
4084
4084
4084
4084
4084
4084
4084
4084
4084
4084
4084
4084
4088
4088
4088
4088
4088
4088
4088
4088
4088
4088
4092
4092
4092
4092
4096>;
};
