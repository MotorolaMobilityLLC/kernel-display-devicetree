// SPDX-License-Identifier: BSD-3-Clause
/*
 * Copyright (c) 2024 Qualcomm Innovation Center, Inc. All rights reserved.
 */

#include "dsi-panel-sim-cmd.dtsi"
#include "dsi-panel-sim-video.dtsi"

&mdss_mdp {
	qcom,sde-emulated-env;
	connectors = <&smmu_sde_unsec &sde_wb0 &sde_wb1>;
	/delete-property/ qcom,sde-has-idle-pc;
	qcom,sde-hw-version = <0xd0000000>;
};

&reserved_memory {
	/delete-node/ splash_memory;
};
