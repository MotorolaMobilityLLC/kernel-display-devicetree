/* Copyright (c) 2019-2021, The Linux Foundation. All rights reserved.
 *
 * This program is free software; you can redistribute it and/or modify
 * it under the terms of the GNU General Public License version 2 and
 * only version 2 as published by the Free Software Foundation.
 *
 * This program is distributed in the hope that it will be useful,
 * but WITHOUT ANY WARRANTY; without even the implied warranty of
 * MERCHANTABILITY or FITNESS FOR A PARTICULAR PURPOSE.  See the
 * GNU General Public License for more details.
 */
&mdss_mdp {
	mot_csot_vtdr6126_c_667_1220x2712_dsc_vid_144hz: qcom,mdss_dsi_mot_csot_vtdr6126_c_667_1220x2712_dsc_vid {
		qcom,mdss-dsi-panel-name = "mipi_mot_vid_csot_1220p_dsc_667";
		qcom,mdss-dsi-panel-supplier = "csot";
		qcom,mdss-dsi-panel-type = "dsi_video_mode";
		qcom,mdss-dsi-panel-physical-type = "oled";
		qcom,dsi-ctrl-num = <0>;
		qcom,dsi-phy-num = <0>;
		qcom,mdss-dsi-virtual-channel-id = <0>;
		qcom,mdss-dsi-stream = <0>;
		qcom,mdss-pan-physical-width-dimension = <69>;
		qcom,mdss-pan-physical-height-dimension = <154>;
		qcom,mdss-dsi-bpp = <24>;
		qcom,mdss-dsi-underflow-color = <0xff>;
		qcom,mdss-dsi-border-color = <0>;

		qcom,mdss-dsi-traffic-mode = "non_burst_sync_event";
		qcom,mdss-dsi-bllp-eof-power-mode;
		qcom,mdss-dsi-bllp-power-mode;
		qcom,mdss-dsi-lp11-init;
		qcom,mdss-dsi-lane-0-state;
		qcom,mdss-dsi-lane-1-state;
		qcom,mdss-dsi-lane-2-state;
		qcom,mdss-dsi-lane-3-state;
		qcom,mdss-dsi-dma-trigger = "trigger_sw";
		qcom,mdss-dsi-mdp-trigger = "none";
		qcom,mdss-dsi-reset-sequence = <1 2>, <0 5>, <1 20>;//

		qcom,mdss-dsi-wr-mem-start = <0x2c>;
		qcom,mdss-dsi-wr-mem-continue = <0x3c>;

		qcom,mdss-dsi-dc-off-command = [
				39 01 00 00 00 00 02 5E 00];
		qcom,mdss-dsi-dc-off-command-state = "dsi_hs_mode";
		qcom,mdss-dsi-dc-on-command = [
				39 01 00 00 00 00 02 5E 01];
		qcom,mdss-dsi-dc-on-command-state = "dsi_hs_mode";

		qcom,mdss-dsi-hbm-on-command = [
				39 00 00 40 00 00 03 51 3E 80
				39 00 00 00 00 00 02 62 00];
		qcom,mdss-dsi-hbm-off-command = [
				39 00 00 40 00 00 02 62 00];

		qcom,mdss-dsi-hbm-fod;
		qcom,mdss-dsi-hbm-fod-on-command = [
				39 00 00 40 00 00 05 63 10 00 14 AC
				39 01 00 00 00 00 02 62 03];

		qcom,mdss-dsi-panel-lhbm-wait-fps-valid;
		qcom,mdss-dsi-panel-local-hbm-wait-fps-count = <30>;
		qcom,mdss-dsi-panel-local-hbm-wait-fps-interval = <1>;
		qcom,mdss-dsi-panel-lhbm-not-allowed-fps-list = <60 90 144>;

		qcom,mdss-dsi-panel-local-hbm-enabled;
		qcom,mdss-dsi-panel-local-hbm-DC-HYBIRD-THRESHOLD-BL = <5291>;
		qcom,mdss-dsi-panel-local-hbm-alpha-register = <0x63>;
		qcom,mdss-dsi-panel-local-hbm-alpha-size = <16001>;
		qcom,mdss-dsi-panel-bl-num = <1>;

		qcom,mdss-dsi-display-timings {
			timing@0 {
				cell-index = <0>;
				qcom,mdss-dsi-panel-framerate = <144>;
				qcom,mdss-dsi-panel-width = <1220>;
				qcom,mdss-dsi-panel-height = <2712>;
				qcom,mdss-dsi-h-front-porch = <20>;
				qcom,mdss-dsi-h-back-porch = <20>;
				qcom,mdss-dsi-h-pulse-width = <2>;
				qcom,mdss-dsi-h-sync-skew = <0>;
				qcom,mdss-dsi-h-sync-pulse = <0>;
				qcom,mdss-dsi-v-back-porch = <18>;
				qcom,mdss-dsi-v-front-porch = <48>;
				qcom,mdss-dsi-v-pulse-width = <2>;
				qcom,mdss-dsi-h-left-border = <0>;
				qcom,mdss-dsi-h-right-border = <0>;
				qcom,mdss-dsi-v-top-border = <0>;
				qcom,mdss-dsi-v-bottom-border = <0>;
				qcom,mdss-dsi-on-command = [
					39 00 00 00 00 00 03 F0 AA 10
					39 00 00 00 00 00 18 D0 C4 04 60 14 17 00 35 4B 19 4F 00 00 4B 30 50 00 00 00 04 44 19 19 19
					39 00 00 00 00 00 02 03 01
					39 00 00 00 00 00 02 35 00
					39 00 00 00 00 00 02 53 20
					39 00 00 00 00 00 02 59 09
					39 00 00 00 00 00 03 51 00 00
					39 00 00 00 00 00 02 5D 00
					39 00 00 00 00 00 02 5E 00
					39 00 00 00 00 00 02 6F 01
					39 00 00 00 00 00 02 6C 00
					39 00 00 00 00 00 1A 70 11 00 00 AB 30 80 0A 98 04 C4 00 0C 02 62 02 62 02 00 01 1A 00 20 02 5B 00
					39 00 00 00 00 00 02 65 19
					39 00 00 00 00 00 1A 70 08 00 01 00 BB 07 7B 18 00 10 F0 07 10 20 00 06 0F 0F 33 0E 1C 2A 38 46 54
					39 00 00 00 00 00 02 65 32
					39 00 00 00 00 00 1A 70 62 69 70 77 79 7B 7D 7E 02 02 22 00 2A 40 2A BE 3A FC 3A FA 3A F8 3B 38 3B
					39 00 00 00 00 00 02 65 4B
					39 00 00 00 00 00 14 70 78 3B B6 4B B6 4B F4 4B F4 6C 34 84 74 00 00 00 00 00 00
					39 00 00 00 00 00 03 FF 5A 80
					39 00 00 00 00 00 02 65 26
					39 00 00 00 00 00 02 F7 01
					39 00 00 00 00 00 03 FF 5A 81
					39 00 00 00 00 00 02 65 02
					39 00 00 00 00 00 02 F4 27
					39 00 00 00 00 00 02 65 19
					39 00 00 00 00 00 02 F8 01
					39 00 00 00 00 00 02 65 03
					39 00 00 00 00 00 04 FB F3 F3 F3
					39 00 00 00 00 00 03 FF 5A 82
					39 00 00 00 00 00 02 65 05
					39 00 00 00 00 00 02 F9 81
					39 00 00 00 00 00 03 FF 5A 00
					39 00 00 00 00 00 03 F0 AA 00
					05 00 00 00 78 00 01 11
					05 00 00 00 00 00 01 29
				];

				qcom,mdss-dsi-off-command = [
					05 01 00 00 11 00 01 28
					05 01 00 00 78 00 01 10];
				qcom,mdss-dsi-on-command-state = "dsi_lp_mode";
				qcom,mdss-dsi-off-command-state = "dsi_lp_mode";
				qcom,mdss-dsi-timing-switch-command-state =
					"dsi_lp_mode";
				qcom,compression-mode = "dsc";
				qcom,mdss-dsc-slice-height = <12>;
				qcom,mdss-dsc-slice-width = <610>;
				qcom,mdss-dsc-slice-per-pkt = <2>;
				qcom,mdss-dsc-bit-per-component = <8>;
				qcom,mdss-dsc-bit-per-pixel = <8>;
				qcom,mdss-dsc-block-prediction-enable;
				qcom,mdss-dsi-dfps-60-command = [
						39 00 00 00 00 00 02 6C 03];
				qcom,mdss-dsi-dfps-60-command-state = "dsi_hs_mode";

				qcom,mdss-dsi-dfps-90-command = [
						39 00 00 00 00 00 02 6c 02];
				qcom,mdss-dsi-dfps-90-command-state = "dsi_hs_mode";

				qcom,mdss-dsi-dfps-120-command = [
						39 00 00 00 00 00 02 6c 01];
				qcom,mdss-dsi-dfps-120-command-state = "dsi_hs_mode";

				qcom,mdss-dsi-dfps-144-command = [
						39 00 00 00 00 00 02 6C 00];
				qcom,mdss-dsi-dfps-144-command-state = "dsi_hs_mode";
			};
		};
	};
};
