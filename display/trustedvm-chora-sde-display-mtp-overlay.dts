// SPDX-License-Identifier: BSD-3-Clause
/*
 * Copyright (c) Qualcomm Technologies, Inc. and/or its subsidiaries.
 */

/dts-v1/;
/plugin/;

#include "trustedvm-chora-sde.dtsi"
#include "trustedvm-chora-sde-display-mtp.dtsi"

/ {
	model = "Qualcomm Technologies, Inc. Chora SVM MTP";
	compatible = "qcom,chora-mtp", "qcom,chora", "qcom,mtp";
	qcom,msm-id = <724 0x10000>, <744 0x10000>;
	qcom,board-id = <0x10008 0x0>;
};
