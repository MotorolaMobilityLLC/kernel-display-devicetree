&mdss_mdp {
	mot_boe_269_800x600_cmd: qcom,mdss_dsi_mot_boe_269_800x600_cmd {
		qcom,mdss-dsi-panel-name =
			"mipi_mot_cmd_boe_800x600_269";
		qcom,mdss-dsi-panel-type = "dsi_cmd_mode";
		qcom,mdss-dsi-panel-physical-type = "oled";
		qcom,mdss-dsi-virtual-channel-id = <0>;
		qcom,mdss-dsi-stream = <0>;
		qcom,mdss-pan-physical-width-dimension = <55>;
		qcom,mdss-pan-physical-height-dimension = <41>;
		qcom,mdss-dsi-bpp = <24>;
		qcom,mdss-dsi-color-order = "rgb_swap_rgb";
		qcom,mdss-dsi-underflow-color = <0xff>;
		qcom,mdss-dsi-border-color = <0>;

		qcom,dsi-sec-ctrl-num = <1>;
		qcom,dsi-sec-phy-num = <1>;

		qcom,mdss-dsi-traffic-mode = "burst_mode";
		qcom,mdss-dsi-bllp-eof-power-mode;
		qcom,mdss-dsi-bllp-power-mode;
		qcom,mdss-dsi-lane-0-state;
		qcom,mdss-dsi-lane-1-state;
		qcom,mdss-dsi-dma-trigger = "trigger_sw";
		qcom,mdss-dsi-mdp-trigger = "none";
		qcom,mdss-dsi-reset-sequence = <0 2>, <1 35>;
		qcom,mdss-dsi-lp11-init;

		qcom,mdss-dsi-te-pin-select = <1>;

		qcom,mdss-dsi-te-dcs-command = <1>;
		qcom,mdss-dsi-te-check-enable;
		qcom,mdss-dsi-te-using-te-pin;
		qcom,mdss-dsi-bl-min-level = <3>;
		qcom,mdss-dsi-bl-max-level = <255>;
		qcom,mdss-dsi-sec-bl-pmic-control-type = "bl_ctrl_dcs";
		/* MOT panel params */
		qcom,mdss-dsi-hbm-on-command = [15 01 00 00 00 00 02 53 e0];
		qcom,mdss-dsi-hbm-off-command = [15 01 00 00 00 00 02 53 20];

qcom,mdss-dsi-display-timings {
	timing@0{
		qcom,mdss-dsi-panel-width = <800>;
		qcom,mdss-dsi-panel-height = <600>;
		qcom,mdss-dsi-h-front-porch = <44>;
		qcom,mdss-dsi-h-back-porch = <32>;
		qcom,mdss-dsi-h-pulse-width = <12>;
		qcom,mdss-dsi-h-sync-skew = <0>;
		qcom,mdss-dsi-h-sync-pulse = <0>;
		qcom,mdss-dsi-v-back-porch = <4>;
		qcom,mdss-dsi-v-front-porch = <8>;
		qcom,mdss-dsi-v-pulse-width = <4>;
		qcom,mdss-dsi-panel-framerate = <60>;
		qcom,mdss-dsi-h-left-border = <0>;
		qcom,mdss-dsi-h-right-border = <0>;
		qcom,mdss-dsi-v-top-border = <0>;
		qcom,mdss-dsi-v-bottom-border = <0>;
		qcom,mdss-dsi-panel-jitter = <0x20 0xa>;
		qcom,mdss-dsi-on-command = [
			15 00 00 00 00 00 02 FE 40
			15 00 00 00 00 00 02 A6 02
			15 00 00 00 00 00 02 A3 23
			15 00 00 00 00 00 02 A4 2E
			15 00 00 00 00 00 02 FE 00
			15 00 00 00 00 00 02 FA 07
			15 00 00 00 00 00 02 C2 08
			15 00 00 00 00 00 02 35 00
			15 00 00 00 00 00 02 51 00
			05 01 00 00 78 00 01 11
			05 01 00 00 00 00 01 29];	/* display on */
		qcom,mdss-dsi-off-command = [
			05 01 00 00 23 00 01 28		/* display_off */
			05 01 00 00 78 00 01 10];	/* enter sleep mode */

		qcom,mdss-dsi-on-command-state = "dsi_lp_mode";
		qcom,mdss-dsi-off-command-state = "dsi_lp_mode";
		qcom,mdss-dsi-force-tx-mode = "dsi_hs_mode";
	};
};
	};
};
