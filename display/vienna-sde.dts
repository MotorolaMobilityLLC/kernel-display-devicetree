// SPDX-License-Identifier: BSD-3-Clause
/*
 * Copyright (c) 2025 Qualcomm Innovation Center, Inc. All rights reserved.
 */
/dts-v1/;
/plugin/;

#include "vienna-sde.dtsi"

/{
	qcom,msm-id = <669 0x10000>, <670 0x10000>;
	qcom,board-id = <0 0>;
};
