// SPDX-License-Identifier: BSD-3-Clause
/*
 * Copyright (c) Qualcomm Technologies, Inc. and/or its subsidiaries.
 */

&mdss_mdp {
	dsi_sim_sl_vid_vhm: qcom,mdss_dsi_sim_sl_video_vhm {
		qcom,mdss-dsi-panel-name = "Simulator VHM video mode splitlink dsi panel";
		qcom,mdss-dsi-panel-type = "dsi_video_mode";

		qcom,dsi-ctrl-num = <0>;
		qcom,dsi-phy-num = <0>;

		qcom,mdss-dsi-virtual-channel-id = <0>;
		qcom,mdss-dsi-stream = <0>;
		qcom,mdss-dsi-bpp = <24>;
		qcom,mdss-dsi-color-order = "rgb_swap_rgb";
		qcom,mdss-dsi-underflow-color = <0xff>;
		qcom,mdss-dsi-border-color = <0>;
		qcom,mdss-dsi-panel-hdr-enabled;
		qcom,mdss-dsi-panel-hdr-color-primaries = <14500 15500 32000
			17000 15500 30000 8000 3000>;
		qcom,mdss-dsi-panel-peak-brightness = <4200000>;
		qcom,mdss-dsi-panel-blackness-level = <3230>;
		qcom,mdss-dsi-traffic-mode = "burst_mode";
		qcom,mdss-dsi-lane-map = "lane_map_0123";
		qcom,mdss-dsi-bllp-eof-power-mode;
		qcom,mdss-dsi-bllp-power-mode;
		qcom,mdss-dsi-lane-0-state;
		qcom,mdss-dsi-lane-1-state;
		qcom,mdss-dsi-lane-2-state;
		qcom,mdss-dsi-lane-3-state;
		qcom,mdss-dsi-t-clk-post = <0x04>;
		qcom,mdss-dsi-t-clk-pre = <0x1b>;
		qcom,mdss-dsi-dma-trigger = "trigger_sw";
		qcom,mdss-dsi-mdp-trigger = "none";
		qcom,mdss-dsi-reset-sequence = <1 0>, <0 0>, <1 0>;
		qcom,panel-ack-disabled;
		qcom,split-link-enabled;
		qcom,sublinks-count = <2>;
		qcom,lanes-per-sublink = <2>;

		qcom_mdss_dsi_display_timings_270: qcom,mdss-dsi-display-timings {
			timing_0_271: timing@0 {
				qcom,mdss-dsi-panel-framerate = <120>;
				qcom,mdss-dsi-panel-width = <1256>;
				qcom,mdss-dsi-panel-height = <2256>;
				qcom,mdss-dsi-h-front-porch = <21>;
				qcom,mdss-dsi-h-back-porch = <20>;
				qcom,mdss-dsi-h-pulse-width = <4>;
				qcom,mdss-dsi-h-sync-skew = <0>;
				qcom,mdss-dsi-v-back-porch = <36>;
				qcom,mdss-dsi-v-front-porch = <206>;
				qcom,mdss-dsi-v-pulse-width = <4>;
				qcom,mdss-dsi-h-left-border = <0>;
				qcom,mdss-dsi-h-right-border = <0>;
				qcom,mdss-dsi-v-top-border = <0>;
				qcom,mdss-dsi-v-bottom-border = <0>;
				qcom,mdss-dsi-on-command =
					[32 01 00 00 00 00 02 00 00];

				qcom,mdss-dsi-esync-post-on-commands =
					[32 01 00 00 00 00 02 00 00];

				qcom,mdss-dsi-sticky_still_en-command =
					[05 01 00 00 00 00 01 00];

				qcom,mdss-dsi-sticky_still_disable-command =
					[05 01 00 00 00 00 01 00];

				qcom,mdss-dsi-sticky_on_fly-command =
					[05 01 00 00 00 00 01 00];

				qcom,mdss-dsi-qsync-freq-step-sequence-interval =
					<0 120000 2>, <0 10000 1>;
				qcom,mdss-dsi-qsync-freq-step-sequence  =
					<60000 1>, <10000 1>,
					<10000 2>;

				qcom,mdss-dsi-freq-step-pattern1-command =
					[39 01 00 00 00 00 02 00 00];

				qcom,mdss-dsi-freq-step-pattern2-command =
					[39 01 00 00 00 00 02 00 00];

				qcom,mdss-dsi-off-command =
					[22 01 00 00 00 00 02 00 00];
				qcom,mdss-dsi-on-command-state = "dsi_lp_mode";
				qcom,mdss-dsi-off-command-state = "dsi_lp_mode";
				qcom,mdss-ppb-overlap = <4>;

				qcom,compression-mode = "dsc";
				qcom,mdss-dsc-slice-height = <16>;
				qcom,mdss-dsc-slice-width = <628>;
				qcom,mdss-dsc-slice-per-pkt = <1>;
				qcom,mdss-dsc-bit-per-component = <8>;
				qcom,mdss-dsc-bit-per-pixel = <8>;
				qcom,mdss-dsc-block-prediction-enable;
			};
		};
	};
};
