
/* Copyright (c) 2019-2020, The Linux Foundation. All rights reserved.
 *
 * This program is free software; you can redistribute it and/or modify
 * it under the terms of the GNU General Public License version 2 and
 * only version 2 as published by the Free Software Foundation.
 *
 * This program is distributed in the hope that it will be useful,
 * but WITHOUT ANY WARRANTY; without even the implied warranty of
 * MERCHANTABILITY or FITNESS FOR A PARTICULAR PURPOSE.  See the
 * GNU General Public License for more details.
 */

&mdss_mdp {
mot_tm_nt37705_667_curve_1080x2400_dsc_cmd_v0: qcom,mdss_dsi_mot_tm_nt37705_667_curve_1080x2400_dsc_cmd_v0 {
qcom,mdss-dsi-panel-local-hbm-alpha-table = <
243
243
243
244
244
244
245
245
245
246
246
246
247
247
247
247
248
248
248
249
249
249
250
250
250
251
251
251
252
252
252
253
252
253
253
254
254
254
255
255
255
256
256
256
257
257
257
258
258
258
259
259
259
259
260
260
260
261
261
261
262
262
263
263
263
264
264
264
265
265
265
266
266
266
266
266
268
267
268
268
268
269
269
269
270
270
270
271
271
272
272
272
273
273
273
274
274
274
275
275
275
276
276
276
277
277
278
278
278
279
279
279
279
279
280
280
280
281
281
281
282
282
283
283
283
284
284
284
285
285
285
286
286
287
287
287
288
288
288
289
289
290
290
290
291
291
291
292
292
292
293
293
293
294
294
294
295
295
295
296
296
296
297
297
297
298
298
298
299
299
300
300
300
301
301
301
302
302
303
303
303
304
304
304
305
305
306
306
306
307
307
307
308
308
309
309
309
310
310
310
311
311
311
312
312
313
313
313
314
314
314
315
315
315
316
316
317
317
317
318
318
318
319
319
320
320
320
321
321
322
322
322
323
323
323
324
324
325
325
325
326
327
326
327
328
328
328
329
329
329
329
330
331
331
332
332
332
333
333
334
334
334
334
335
335
336
336
337
337
338
338
338
339
339
339
340
340
341
341
341
342
342
342
343
343
344
345
344
345
346
345
346
346
347
348
348
348
349
349
350
350
350
351
351
352
352
352
353
353
353
354
354
355
355
356
356
356
357
357
358
358
358
359
360
359
360
361
361
362
362
362
363
363
364
364
364
365
365
365
367
366
367
368
367
369
369
369
370
370
371
372
372
373
374
374
375
376
376
377
378
378
379
380
381
381
382
382
382
383
384
385
386
386
387
388
388
389
390
390
391
392
393
393
394
395
395
396
397
397
397
399
399
400
400
401
402
402
403
404
405
405
406
407
408
408
409
410
410
410
411
412
413
413
414
415
416
416
418
418
419
419
420
421
421
422
423
423
424
425
425
426
426
427
428
429
429
430
431
432
433
433
434
435
435
437
437
438
439
439
440
440
441
442
442
443
444
444
445
446
447
448
448
449
450
451
452
452
453
454
454
454
455
456
457
458
458
460
460
461
462
462
463
464
464
466
466
467
468
468
469
470
470
475
474
474
475
478
478
479
478
479
482
482
483
482
483
487
487
487
487
487
491
491
491
491
495
495
495
495
495
498
499
498
498
499
502
503
503
502
503
507
506
507
507
510
510
510
510
510
514
514
514
514
515
518
518
518
518
518
522
522
522
521
526
526
525
526
525
529
529
529
529
529
533
533
533
533
533
536
537
537
536
540
540
540
541
540
543
544
543
544
544
547
548
547
547
547
551
551
551
551
554
554
554
555
554
557
558
558
558
558
560
561
561
561
561
565
565
564
564
568
568
568
568
568
571
571
571
572
571
574
575
575
575
575
578
578
578
578
582
581
581
581
581
585
584
584
585
584
588
588
588
588
588
591
592
591
591
594
594
594
594
594
598
597
597
597
597
600
600
600
601
603
604
604
603
607
606
606
610
609
610
610
613
613
613
616
616
615
619
619
619
619
622
622
622
625
625
625
624
628
628
628
631
630
631
634
633
634
634
636
637
636
640
639
639
640
642
642
643
645
645
646
648
649
648
648
652
650
651
654
654
654
654
656
657
656
659
660
659
662
662
662
663
665
665
665
668
668
668
667
671
670
670
674
673
673
674
676
676
676
678
679
678
681
681
681
681
684
683
684
686
686
687
686
689
689
689
692
692
692
695
694
695
695
697
698
697
699
700
699
700
702
702
703
704
705
705
707
708
708
707
710
710
710
713
712
713
713
715
716
715
717
718
717
720
720
720
720
722
722
723
725
725
725
725
728
727
727
730
730
730
733
732
732
732
734
735
735
737
738
737
737
740
739
741
742
742
742
742
745
744
744
747
747
747
749
749
750
751
751
754
753
754
756
756
759
759
758
761
761
761
764
763
766
765
765
768
767
770
771
770
773
773
774
775
775
777
778
777
779
779
781
782
781
783
784
785
786
786
788
788
790
790
791
792
793
793
794
795
797
797
798
799
799
802
801
802
804
803
806
805
806
808
807
808
810
810
813
812
812
815
814
816
817
816
819
819
821
822
820
823
823
823
826
825
827
828
827
830
830
831
832
832
833
834
836
835
836
838
838
838
840
842
843
842
843
845
844
847
846
847
848
848
852
851
851
853
853
854
855
855
858
857
857
860
859
862
861
861
863
863
865
866
865
868
867
867
870
869
872
872
871
874
873
875
876
875
877
878
879
880
880
881
882
881
883
884
885
885
886
887
888
889
889
889
891
891
894
893
893
895
894
895
897
896
899
898
898
901
900
902
903
902
905
904
906
907
906
908
908
908
910
910
911
912
912
914
914
915
915
916
917
918
919
919
919
920
921
921
922
925
926
926
928
927
930
931
931
932
933
932
936
935
936
937
938
941
941
942
943
944
943
946
946
947
948
949
949
952
950
953
954
955
955
956
956
959
958
959
960
961
961
964
963
965
966
967
969
968
970
971
972
972
974
974
976
976
976
978
978
979
981
980
983
982
983
984
986
985
988
988
990
990
991
992
993
993
995
996
997
998
998
1000
999
1001
1001
1003
1003
1004
1004
1007
1006
1008
1008
1009
1009
1011
1010
1013
1012
1014
1014
1015
1016
1018
1017
1020
1019
1020
1023
1022
1024
1024
1025
1026
1028
1026
1029
1028
1030
1031
1031
1032
1034
1032
1035
1035
1036
1037
1038
1038
1041
1039
1042
1041
1042
1044
1045
1044
1046
1049
1050
1051
1050
1053
1052
1054
1054
1055
1056
1057
1056
1059
1058
1059
1060
1061
1062
1063
1063
1065
1064
1066
1067
1067
1068
1070
1069
1072
1071
1072
1075
1073
1075
1076
1076
1077
1079
1078
1081
1079
1081
1081
1082
1083
1084
1083
1087
1085
1086
1087
1088
1088
1090
1089
1092
1091
1093
1094
1094
1094
1096
1097
1098
1099
1098
1101
1100
1102
1102
1104
1104
1105
1104
1107
1106
1107
1109
1109
1110
1111
1110
1113
1112
1114
1115
1115
1115
1117
1116
1119
1118
1119
1121
1121
1122
1122
1123
1124
1125
1125
1127
1126
1128
1128
1129
1130
1130
1130
1133
1132
1133
1134
1135
1136
1137
1136
1138
1137
1139
1140
1140
1141
1143
1143
1144
1144
1144
1147
1146
1148
1148
1148
1149
1150
1150
1153
1152
1154
1155
1156
1158
1157
1159
1161
1160
1162
1164
1163
1165
1166
1165
1167
1169
1168
1170
1171
1171
1173
1173
1175
1176
1176
1177
1178
1179
1179
1180
1182
1183
1183
1186
1186
1186
1188
1188
1189
1190
1191
1192
1192
1193
1195
1194
1195
1197
1197
1200
1200
1201
1204
1203
1205
1206
1205
1207
1209
1208
1210
1211
1210
1213
1213
1213
1215
1215
1217
1219
1219
1220
1221
1221
1223
1223
1225
1227
1225
1228
1228
1228
1230
1230
1231
1233
1233
1234
1236
1236
1236
1237
1238
1240
1240
1241
1242
1242
1245
1245
1246
1249
1248
1248
1251
1250
1252
1253
1252
1254
1255
1255
1257
1257
1257
1259
1260
1260
1262
1262
1264
1264
1264
1267
1266
1267
1269
1268
1270
1271
1270
1273
1273
1273
1276
1276
1277
1278
1278
1279
1280
1281
1282
1282
1283
1284
1286
1289
1289
1289
1291
1290
1291
1293
1292
1294
1296
1294
1297
1298
1298
1299
1299
1300
1301
1301
1302
1303
1304
1306
1305
1306
1308
1307
1308
1311
1310
1311
1313
1312
1314
1315
1315
1317
1316
1317
1319
1319
1321
1321
1321
1322
1323
1324
1325
1327
1329
1329
1328
1331
1330
1331
1333
1334
1334
1336
1336
1336
1339
1339
1339
1340
1340
1342
1343
1343
1345
1345
1346
1346
1346
1349
1348
1349
1351
1349
1352
1353
1352
1354
1354
1354
1356
1356
1356
1357
1358
1359
1360
1361
1362
1361
1363
1365
1365
1368
1368
1367
1370
1371
1370
1372
1372
1372
1374
1374
1376
1376
1376
1378
1378
1380
1380
1380
1383
1381
1382
1385
1384
1384
1387
1385
1387
1389
1388
1391
1390
1390
1392
1392
1392
1394
1394
1395
1396
1397
1398
1398
1399
1401
1400
1403
1405
1404
1406
1407
1406
1409
1408
1408
1411
1410
1411
1412
1413
1413
1414
1415
1416
1415
1416
1419
1418
1419
1420
1420
1422
1422
1421
1425
1424
1424
1427
1426
1427
1429
1428
1430
1431
1431
1432
1432
1432
1435
1434
1435
1435
1435
1438
1438
1436
1437
1436
1438
1439
1439
1441
1441
1441
1444
1444
1444
1447
1445
1446
1448
1447
1450
1450
1451
1451
1452
1453
1453
1453
1456
1455
1457
1458
1458
1460
1460
1459
1462
1462
1462
1466
1465
1464
1467
1466
1468
1470
1469
1470
1471
1472
1473
1474
1475
1475
1476
1478
1478
1478
1481
1480
1481
1483
1482
1484
1485
1484
1488
1486
1486
1490
1489
1489
1492
1490
1492
1493
1494
1496
1496
1496
1497
1498
1500
1499
1499
1502
1501
1503
1505
1503
1504
1507
1506
1507
1508
1508
1510
1511
1510
1513
1512
1513
1516
1514
1514
1517
1516
1518
1519
1520
1521
1520
1522
1524
1522
1525
1526
1525
1528
1527
1527
1530
1530
1530
1534
1532
1533
1535
1534
1536
1537
1537
1539
1539
1540
1541
1542
1543
1543
1544
1546
1545
1547
1548
1546
1549
1550
1549
1550
1552
1551
1553
1554
1554
1555
1555
1557
1556
1558
1560
1559
1561
1563
1561
1564
1565
1564
1567
1567
1567
1570
1569
1570
1572
1571
1572
1575
1574
1575
1576
1576
1578
1579
1578
1581
1579
1580
1582
1581
1584
1585
1583
1587
1586
1586
1589
1588
1589
1591
1591
1592
1592
1593
1594
1596
1596
1597
1597
1599
1599
1601
1602
1601
1602
1604
1604
1606
1607
1605
1609
1608
1609
1612
1611
1611
1614
1613
1614
1616
1616
1618
1619
1618
1620
1621
1622
1622
1623
1625
1625
1626
1627
1626
1628
1629
1629
1632
1631
1632
1635
1634
1636
1637
1636
1640
1639
1639
1642
1641
1642
1644
1643
1645
1646
1645
1648
1648
1648
1650
1650
1652
1651
1653
1655
1654
1655
1657
1655
1657
1658
1657
1661
1660
1659
1664
1663
1662
1666
1665
1665
1666
1667
1669
1668
1670
1672
1671
1673
1674
1673
1676
1676
1675
1680
1679
1678
1682
1680
1682
1685
1683
1685
1686
1686
1688
1688
1689
1690
1691
1692
1692
1693
1696
1694
1696
1698
1696
1698
1700
1699
1700
1702
1701
1703
1703
1704
1705
1707
1707
1708
1709
1710
1709
1711
1714
1713
1714
1716
1715
1719
1718
1718
1721
1720
1720
1724
1723
1724
1725
1725
1727
1729
1728
1729
1728
1730
1732
1731
1734
1735
1734
1737
1736
1736
1740
1738
1738
1741
1739
1741
1742
1742
1744
1744
1745
1746
1747
1748
1748
1749
1752
1750
1752
1754
1753
1756
1756
1755
1759
1759
1758
1762
1761
1761
1765
1763
1765
1766
1765
1768
1768
1768
1770
1771
1772
1772
1773
1776
1775
1776
1778
1777
1779
1781
1780
1783
1782
1781
1785
1784
1785
1789
1788
1789
1790
1789
1792
1792
1793
1794
1794
1796
1797
1797
1800
1798
1799
1802
1800
1803
1804
1803
1806
1805
1804
1810
1809
1809
1812
1811
1812
1814
1813
1814
1816
1816
1818
1817
1819
1820
1821
1822
1820
1823
1824
1822
1826
1826
1825
1829
1828
1829
1832
1831
1832
1834
1833
1835
1837
1836
1839
1839
1839
1841
1841
1843
1844
1844
1846
1845
1847
1849
1848
1850
1852
1850
1851
1853
1852
1854
1856
1855
1858
1858
1858
1859
1860
1861
1862
1863
1864
1864
1866
1869
1867
1868
1870
1868
1871
1872
1871
1875
1875
1874
1878
1877
1876
1881
1879
1880
1883
1881
1882
1882
1884
1886
1885
1886
1889
1886
1890
1891
1890
1893
1893
1893
1897
1895
1895
1900
1898
1899
1902
1901
1903
1903
1904
1904
1905
1906
1906
1908
1910
1908
1911
1912
1911
1914
1913
1913
1917
1915
1916
1919
1917
1919
1920
1920
1922
1923
1924
1925
1926
1928
1928
1930
1931
1930
1934
1932
1932
1937
1935
1936
1939
1938
1939
1940
1940
1942
1943
1944
1944
1945
1947
1946
1948
1950
1948
1952
1952
1952
1955
1954
1955
1957
1956
1958
1958
1959
1961
1962
1963
1963
1964
1967
1965
1969
1968
1967
1972
1970
1971
1974
1972
1975
1977
1976
1978
1978
1979
1981
1981
1983
1983
1984
1987
1985
1988
1990
1988
1991
1991
1990
1993
1992
1992
1995
1994
1995
1998
1996
1998
2000
2000
2001
2002
2004
2002
2005
2006
2005
2009
2009
2008
2009
2009
2011
2012
2012
2015
2014
2017
2018
2016
2019
2020
2019
2024
2022
2022
2026
2024
2026
2029
2028
2030
2030
2030
2032
2032
2034
2034
2036
2038
2036
2038
2039
2038
2042
2042
2041
2045
2044
2045
2046
2047
2049
2047
2050
2052
2049
2054
2053
2052
2058
2056
2056
2060
2058
2060
2061
2060
2062
2063
2064
2065
2066
2069
2067
2070
2071
2069
2073
2073
2072
2077
2075
2075
2075
2077
2079
2077
2079
2081
2079
2083
2083
2081
2084
2084
2085
2086
2087
2088
2088
2089
2092
2090
2091
2093
2092
2095
2095
2096
2097
2098
2100
2100
2099
2103
2101
2101
2105
2104
2106
2109
2107
2109
2108
2110
2111
2110
2113
2113
2112
2117
2115
2116
2118
2118
2119
2120
2120
2121
2122
2123
2126
2125
2123
2128
2126
2127
2131
2130
2130
2134
2132
2134
2134
2135
2137
2136
2137
2138
2138
2138
2142
2141
2142
2145
2143
2146
2145
2146
2148
2146
2149
2151
2150
2151
2153
2151
2155
2155
2155
2157
2155
2158
2159
2158
2161
2161
2161
2162
2164
2163
2165
2166
2167
2168
2166
2170
2171
2169
2172
2172
2171
2175
2175
2174
2176
2176
2177
2178
2178
2181
2181
2180
2185
2183
2183
2184
2185
2187
2187
2189
2190
2189
2191
2193
2191
2192
2196
2194
2195
2198
2196
2199
2200
2199
2202
2203
2202
2204
2203
2205
2206
2205
2209
2208
2208
2214
2210
2211
2212
2212
2214
2215
2216
2217
2217
2218
2220
2219
2218
2224
2222
2222
2226
2224
2225
2228
2226
2228
2228
2229
2232
2230
2233
2235
2233
2235
2237
2236
2238
2240
2238
2241
2242
2241
2244
2245
2244
2245
2244
2249
2247
2248
2251
2250
2250
2252
2253
2253
2253
2255
2257
2255
2257
2260
2258
2259
2262
2261
2263
2262
2263
2266
2266
2266
2269
2268
2268
2272
2269
2271
2274
2273
2273
2274
2275
2277
2277
2278
2280
2279
2280
2283
2280
2282
2284
2284
2286
2285
2287
2289
2286
2290
2291
2289
2291
2293
2292
2295
2295
2295
2299
2296
2298
2300
2298
2301
2302
2301
2305
2304
2303
2306
2307
2308
2308
2310
2311
2310
2313
2315
2313
2313
2317
2314
2318
2320
2319
2322
2321
2321
2324
2322
2325
2326
2324
2327
2328
2327
2332
2331
2330
2335
2334
2334
2335
2335
2338
2337
2339
2341
2339
2341
2344
2342
2342
2345
2344
2346
2347
2347
2349
2349
2349
2352
2350
2354
2354
2352
2357
2355
2355
2357
2358
2359
2360
2360
2362
2362
2361
2365
2365
2364
2369
2367
2368
2369
2369
2371
2372
2372
2374
2373
2375
2377
2376
2376
2380
2380
2380
2382
2382
2384
2381
2384
2386
2385
2389
2388
2387
2390
2391
2389
2393
2394
2395
2394
2394
2397
2395
2396
2401
2398
2400
2400
2402
2404
2403
2405
2407
2404
2405
2408
2407
2409
2411
2410
2412
2411
2413
2415
2413
2416
2416
2415
2419
2418
2418
2420
2422
2425
2423
2425
2426
2425
2427
2428
2428
2430
2431
2430
2432
2434
2434
2435
2437
2439
2437
2436
2441
2439
2439
2443
2441
2442
2444
2444
2447
2445
2447
2448
2447
2451
2450
2450
2455
2453
2453
2455
2455
2457
2457
2458
2460
2459
2460
2464
2462
2464
2466
2464
2465
2469
2467
2469
2471
2470
2472
2471
2474
2475
2474
2478
2476
2477
2479
2479
2480
2481
2481
2483
2483
2482
2487
2485
2484
2490
2488
2489
2490
2490
2492
2493
2493
2496
2495
2495
2498
2496
2498
2500
2499
2501
2499
2503
2505
2502
2507
2507
2505
2508
2508
2509
2512
2512
2511
2513
2511
2516
2515
2515
2518
2517
2519
2519
2520
2522
2521
2523
2526
2524
2526
2528
2526
2527
2530
2529
2532
2533
2531
2534
2533
2535
2536
2535
2539
2538
2537
2541
2540
2541
2543
2543
2544
2543
2545
2548
2546
2549
2550
2550
2553
2552
2552
2555
2555
2555
2557
2557
2559
2559
2560
2562
2561
2560
2565
2563
2564
2568
2567
2567
2570
2569
2571
2569
2571
2574
2572
2575
2576
2575
2580
2580
2578
2581
2582
2582
2582
2584
2585
2585
2586
2588
2587
2587
2590
2589
2590
2593
2592
2593
2593
2595
2597
2596
2598
2599
2599
2601
2602
2601
2604
2604
2605
2606
2605
2608
2609
2608
2613
2610
2610
2613
2613
2614
2616
2616
2618
2618
2617
2621
2620
2621
2623
2623
2626
2623
2626
2627
2625
2629
2629
2627
2631
2631
2632
2633
2633
2634
2633
2632
2638
2636
2637
2639
2639
2641
2639
2642
2644
2643
2646
2646
2645
2649
2648
2648
2651
2651
2652
2652
2653
2657
2655
2657
2659
2658
2659
2663
2660
2660
2665
2663
2665
2667
2666
2669
2669
2669
2672
2670
2673
2672
2671
2676
2675
2675
2679
2678
2679
2679
2681
2682
2682
2684
2686
2684
2688
2688
2687
2689
2690
2689
2692
2693
2694
2694
2695
2697
2696
2697
2701
2698
2698
2704
2702
2702
2705
2705
2706
2707
2708
2709
2707
2710
2712
2711
2713
2713
2713
2715
2716
2716
2719
2716
2719
2721
2720
2722
2722
2721
2723
2726
2725
2727
2726
2728
2729
2728
2732
2731
2729
2735
2733
2733
2735
2736
2738
2736
2737
2742
2739
2740
2744
2742
2743
2746
2745
2747
2745
2748
2750
2748
2752
2753
2751
2753
2754
2754
2757
2757
2756
2758
2758
2762
2760
2760
2765
2763
2763
2768
2766
2767
2768
2769
2772
2770
2772
2775
2772
2776
2776
2775
2778
2779
2778
2780
2781
2781
2784
2784
2785
2786
2785
2790
2789
2788
2792
2790
2792
2795
2793
2793
2796
2796
2798
2797
2799
2801
2800
2803
2803
2802
2806
2805
2805
2807
2808
2809
2810
2810
2812
2811
2813
2816
2814
2815
2817
2816
2818
2818
2818
2821
2818
2820
2823
2821
2826
2826
2824
2826
2827
2827
2829
2831
2832
2832
2831
2835
2833
2834
2838
2837
2838
2839
2839
2842
2841
2843
2845
2843
2846
2848
2845
2848
2849
2849
2851
2852
2853
2854
2853
2857
2856
2855
2860
2858
2858
2860
2860
2863
2862
2864
2866
2864
2863
2868
2867
2867
2871
2869
2872
2872
2873
2875
2874
2875
2878
2876
2878
2880
2879
2881
2883
2882
2885
2886
2885
2887
2885
2889
2889
2888
2893
2892
2891
2896
2894
2896
2895
2897
2899
2898
2900
2903
2901
2904
2906
2903
2904
2906
2906
2909
2909
2909
2911
2911
2914
2912
2912
2916
2914
2916
2918
2917
2919
2920
2920
2923
2920
2923
2925
2923
2927
2928
2926
2930
2929
2928
2934
2933
2931
2934
2935
2935
2936
2937
2940
2938
2938
2944
2940
2941
2944
2942
2946
2944
2946
2948
2947
2950
2951
2949
2952
2954
2953
2956
2956
2957
2959
2957
2960
2960
2959
2963
2962
2962
2964
2965
2966
2967
2967
2969
2968
2968
2973
2971
2972
2976
2974
2975
2976
2977
2977
2977
2979
2982
2980
2980
2985
2982
2985
2987
2985
2986
2988
2989
2991
2990
2991
2994
2993
2994
2997
2998
2999
3002
3003
3006
3007
3007
3012
3012
3012
3017
3018
3020
3023
3022
3025
3027
3027
3032
3030
3033
3038
3037
3042
3040
3043
3048
3046
3050
3050
3051
3056
3056
3058
3060
3060
3062
3066
3064
3069
3071
3071
3075
3074
3077
3081
3079
3083
3085
3085
3090
3090
3092
3095
3095
3097
3100
3106
3110
3111
3111
3113
3116
3117
3120
3120
3124
3127
3127
3129
3131
3131
3136
3137
3136
3140
3140
3143
3143
3146
3150
3150
3150
3154
3155
3159
3160
3161
3162
3166
3165
3168
3171
3170
3175
3172
3176
3180
3179
3183
3186
3185
3190
3189
3191
3195
3194
3198
3198
3200
3203
3204
3205
3211
3210
3217
3218
3221
3221
3226
3225
3227
3231
3230
3235
3235
3236
3241
3238
3242
3243
3245
3250
3249
3251
3254
3255
3257
3258
3259
3262
3263
3263
3268
3269
3270
3273
3274
3278
3279
3279
3283
3286
3285
3290
3291
3292
3294
3295
3298
3302
3300
3305
3303
3306
3310
3308
3312
3312
3313
3317
3317
3320
3329
3329
3330
3333
3333
3338
3338
3339
3343
3341
3346
3346
3347
3354
3351
3355
3359
3356
3361
3362
3363
3367
3365
3369
3371
3371
3376
3376
3377
3382
3381
3383
3385
3386
3391
3390
3393
3395
3397
3398
3402
3403
3403
3408
3406
3411
3411
3411
3416
3414
3418
3418
3419
3424
3423
3426
3429
3429
3436
3440
3441
3443
3445
3447
3451
3451
3452
3456
3456
3457
3460
3463
3464
3465
3465
3471
3470
3473
3474
3474
3478
3479
3481
3485
3484
3490
3489
3489
3494
3492
3498
3497
3498
3504
3502
3503
3507
3508
3508
3512
3512
3515
3517
3516
3522
3521
3522
3527
3525
3531
3531
3532
3537
3534
3538
3542
3547
3551
3552
3551
3559
3556
3558
3563
3562
3565
3566
3567
3572
3570
3572
3576
3576
3580
3582
3583
3586
3587
3587
3590
3592
3592
3597
3596
3599
3599
3602
3608
3606
3609
3611
3611
3615
3616
3616
3619
3619
3622
3624
3625
3627
3629
3630
3633
3634
3636
3639
3640
3641
3645
3646
3648
3650
3652
3660
3662
3662
3665
3665
3668
3672
3670
3676
3674
3677
3678
3679
3683
3683
3685
3689
3687
3689
3694
3693
3696
3699
3698
3702
3703
3703
3709
3708
3712
3715
3714
3718
3719
3718
3723
3722
3725
3727
3727
3732
3730
3734
3738
3735
3741
3743
3740
3747
3744
3748
3750
3750
3755
3754
3756
3759
3759
3767
3770
3770
3773
3776
3775
3780
3779
3781
3787
3785
3788
3789
3790
3796
3793
3796
3799
3798
3802
3804
3805
3808
3808
3810
3813
3814
3817
3818
3819
3822
3824
3823
3825
3830
3831
3833
3835
3834
3841
3839
3841
3845
3843
3849
3848
3849
3853
3852
3855
3857
3858
3860
3863
3864
3866
3868
3867
3879
3877
3880
3885
3882
3887
3889
3889
3894
3892
3894
3899
3899
3902
3904
3904
3907
3909
3909
3914
3913
3914
3919
3918
3920
3924
3924
3925
3928
3927
3930
3933
3932
3939
3936
3938
3943
3942
3944
3947
3948
3949
3952
3953
3956
3957
3957
3961
3959
3965
3966
3965
3971
3972
3972
3976
3975
3979
3987
3986
3993
3993
3992
3997
3995
3999
4004
4001
4005
4006
4007
4012
4010
4013
4015
4016
4020
4020
4022
4023
4025
4025
4031
4030
4030
4034
4034
4036
4037
4039
4043
4043
4044
4046
4049
4050
4053
4054
4054
4059
4058
4060
4063
4062
4066
4068
4068
4074
4073
4075
4078
4077
4081
4084
4083
4088
4095>;
};
};
