// SPDX-License-Identifier: BSD-3-Clause
/*
 * Copyright (c) Qualcomm Technologies, Inc. and/or its subsidiaries.
 */

&non_devices_common {
	required-subnodes-display = <
						&clock_cpucc
						&config
						&config_299
						&config_301
						&config_303
						&config_305
						&config_307
						&config_309
						&config_311
						&config_313
						&config_315
						&config_317
						&config_319
						&dgm_0
						&dgm_1
						&dsi_dual_3840x2400_120hz_sim_vid
						&dsi_dual_rdp370f_rgb_vid
						&dsi_dual_sim_cmd
						&dsi_dual_sim_dsc_375_cmd
						&dsi_dual_sim_vid
						&dsi_ext_bridge_1080p
						&dsi_nt37801_amoled_cmd
						&dsi_nt37801_amoled_cmd_cphy
						&dsi_nt37801_amoled_cmd_cphy_spr
						&dsi_nt37801_amoled_cmd_ddicspr
						&dsi_nt37801_amoled_cmd_spr
						&dsi_nt37801_amoled_dsc_10b_cmd
						&dsi_nt37801_amoled_dsc_10b_video
						&dsi_nt37801_amoled_fhd_plus_cmd
						&dsi_nt37801_amoled_qsync_cmd
						&dsi_nt37801_amoled_qsync_cmd_cphy
						&dsi_nt37801_amoled_qsync_video
						&dsi_nt37801_amoled_qsync_video_cphy
						&dsi_nt37801_amoled_vid_spr
						&dsi_nt37801_amoled_video
						&dsi_nt37801_amoled_video_cphy
						&dsi_nt37801_amoled_video_cphy_spr
						&dsi_nt37801_amoled_video_ddicspr
						&dsi_nt37802_amoled_video_psr_vhm
						&dsi_panel_pwr_supply
						&dsi_panel_pwr_supply_avdd
						&dsi_panel_pwr_supply_raontech
						&dsi_panel_pwr_supply_sim
						&dsi_panel_pwr_supply_vtdr
						&dsi_pll_codes_data
						&dsi_rdp370f_rgb_vid
						&dsi_sharp_4k_dsc_cmd
						&dsi_sharp_4k_dsc_video
						&dsi_sharp_qhd_plus_dsc_cmd
						&dsi_sharp_qhd_plus_dsc_video
						&dsi_sim_cmd
						&dsi_sim_dsc_10b_cmd
						&dsi_sim_dsc_375_cmd
						&dsi_sim_panel_au
						&dsi_sim_sec_hd_cmd
						&dsi_sim_vid
						&dsi_ss_video_psr_vid_vhm
						&dsi_vtdr6130_amoled_120hz_cmd
						&dsi_vtdr6130_amoled_120hz_video
						&dsi_vtdr6130_amoled_cmd
						&dsi_vtdr6130_amoled_nodsc_60hz_cmd
						&dsi_vtdr6130_amoled_qsync_144hz_cmd
						&dsi_vtdr6130_amoled_qsync_144hz_video
						&dsi_vtdr6130_amoled_video
						&mdss_dsi0
						&mdss_dsi1
						&mdss_dsi_phy0
						&mdss_dsi_phy1
						&mdss_mdp
						&mux
						&mux_298
						&mux_300
						&mux_302
						&mux_304
						&mux_306
						&mux_308
						&mux_310
						&mux_312
						&mux_314
						&mux_316
						&mux_318
						&pmx_sde
						&pmx_sde_esync
						&pmx_sde_te
						&qcom_ctrl_supply_entries
						&qcom_ctrl_supply_entries_1
						&qcom_ctrl_supply_entry_0
						&qcom_ctrl_supply_entry_0_2
						&qcom_mdss_dsi_display_timings
						&qcom_mdss_dsi_display_timings_111
						&qcom_mdss_dsi_display_timings_12
						&qcom_mdss_dsi_display_timings_122
						&qcom_mdss_dsi_display_timings_124
						&qcom_mdss_dsi_display_timings_14
						&qcom_mdss_dsi_display_timings_143
						&qcom_mdss_dsi_display_timings_145
						&qcom_mdss_dsi_display_timings_151
						&qcom_mdss_dsi_display_timings_155
						&qcom_mdss_dsi_display_timings_157
						&qcom_mdss_dsi_display_timings_159
						&qcom_mdss_dsi_display_timings_16
						&qcom_mdss_dsi_display_timings_161
						&qcom_mdss_dsi_display_timings_163
						&qcom_mdss_dsi_display_timings_165
						&qcom_mdss_dsi_display_timings_167
						&qcom_mdss_dsi_display_timings_169
						&qcom_mdss_dsi_display_timings_171
						&qcom_mdss_dsi_display_timings_173
						&qcom_mdss_dsi_display_timings_175
						&qcom_mdss_dsi_display_timings_18
						&qcom_mdss_dsi_display_timings_181
						&qcom_mdss_dsi_display_timings_183
						&qcom_mdss_dsi_display_timings_185
						&qcom_mdss_dsi_display_timings_189
						&qcom_mdss_dsi_display_timings_191
						&qcom_mdss_dsi_display_timings_193
						&qcom_mdss_dsi_display_timings_195
						&qcom_mdss_dsi_display_timings_197
						&qcom_mdss_dsi_display_timings_20
						&qcom_mdss_dsi_display_timings_217
						&qcom_mdss_dsi_display_timings_22
						&qcom_mdss_dsi_display_timings_230
						&qcom_mdss_dsi_display_timings_233
						&qcom_mdss_dsi_display_timings_244
						&qcom_mdss_dsi_display_timings_26
						&qcom_mdss_dsi_display_timings_263
						&qcom_mdss_dsi_display_timings_265
						&qcom_mdss_dsi_display_timings_267
						&qcom_mdss_dsi_display_timings_269
						&qcom_mdss_dsi_display_timings_271
						&qcom_mdss_dsi_display_timings_273
						&qcom_mdss_dsi_display_timings_277
						&qcom_mdss_dsi_display_timings_279
						&qcom_mdss_dsi_display_timings_28
						&qcom_mdss_dsi_display_timings_281
						&qcom_mdss_dsi_display_timings_286
						&qcom_mdss_dsi_display_timings_288
						&qcom_mdss_dsi_display_timings_290
						&qcom_mdss_dsi_display_timings_292
						&qcom_mdss_dsi_display_timings_294
						&qcom_mdss_dsi_display_timings_296
						&qcom_mdss_dsi_display_timings_30
						&qcom_mdss_dsi_display_timings_32
						&qcom_mdss_dsi_display_timings_34
						&qcom_mdss_dsi_display_timings_36
						&qcom_mdss_dsi_display_timings_41
						&qcom_mdss_dsi_display_timings_43
						&qcom_mdss_dsi_display_timings_47
						&qcom_mdss_dsi_display_timings_49
						&qcom_mdss_dsi_display_timings_51
						&qcom_mdss_dsi_display_timings_53
						&qcom_mdss_dsi_display_timings_55
						&qcom_mdss_dsi_display_timings_57
						&qcom_mdss_dsi_display_timings_61
						&qcom_mdss_dsi_display_timings_63
						&qcom_mdss_dsi_display_timings_65
						&qcom_mdss_dsi_display_timings_67
						&qcom_mdss_dsi_display_timings_69
						&qcom_mdss_dsi_display_timings_71
						&qcom_mdss_dsi_display_timings_77
						&qcom_mdss_dsi_display_timings_79
						&qcom_mdss_dsi_display_timings_81
						&qcom_mdss_dsi_display_timings_83
						&qcom_mdss_dsi_display_timings_85
						&qcom_mdss_dsi_display_timings_87
						&qcom_mdss_dsi_display_timings_93
						&qcom_mdss_dsi_display_timings_95
						&qcom_mdss_dsi_display_timings_98
						&qcom_mdss_dsi_display_timings_320
						&qcom_mdss_dsi_display_timings_322
						&qcom_mdss_dsi_display_timings_324
						&qcom_mdss_dsi_display_timings_326
						&qcom_mdss_dsi_display_timings_328
						&qcom_mdss_dsi_display_timings_330
						&qcom_panel_supply_entry_0
						&qcom_panel_supply_entry_0_11
						&qcom_panel_supply_entry_0_5
						&qcom_panel_supply_entry_0_6
						&qcom_panel_supply_entry_0_9
						&qcom_panel_supply_entry_1
						&qcom_panel_supply_entry_1_10
						&qcom_panel_supply_entry_1_7
						&qcom_panel_supply_entry_2
						&qcom_panel_supply_entry_2_8
						&qcom_panel_supply_entry_3
						&qcom_phy_supply_entries
						&qcom_phy_supply_entries_3
						&qcom_phy_supply_entry_0
						&qcom_phy_supply_entry_0_4
						&qcom_sde_dspp_blocks
						&qcom_sde_sspp_dma_blocks
						&qcom_sde_sspp_vig_blocks
						&sde_dsi
						&sde_dsi1
						&sde_dsi1_active
						&sde_dsi1_suspend
						&sde_dsi_active
						&sde_dsi_suspend
						&sde_esync0_active
						&sde_esync0_suspend
						&sde_esync1_active
						&sde_esync1_suspend
						&sde_te1_active
						&sde_te1_suspend
						&sde_te_active
						&sde_te_suspend
						&smmu_sde_unsec
						&timing_0
						&timing_0_112
						&timing_0_123
						&timing_0_125
						&timing_0_13
						&timing_0_144
						&timing_0_146
						&timing_0_15
						&timing_0_152
						&timing_0_156
						&timing_0_158
						&timing_0_160
						&timing_0_162
						&timing_0_164
						&timing_0_166
						&timing_0_168
						&timing_0_17
						&timing_0_170
						&timing_0_172
						&timing_0_174
						&timing_0_176
						&timing_0_182
						&timing_0_184
						&timing_0_186
						&timing_0_19
						&timing_0_190
						&timing_0_192
						&timing_0_194
						&timing_0_196
						&timing_0_198
						&timing_0_21
						&timing_0_218
						&timing_0_23
						&timing_0_231
						&timing_0_234
						&timing_0_245
						&timing_0_264
						&timing_0_266
						&timing_0_268
						&timing_0_27
						&timing_0_270
						&timing_0_272
						&timing_0_274
						&timing_0_278
						&timing_0_280
						&timing_0_282
						&timing_0_287
						&timing_0_289
						&timing_0_29
						&timing_0_291
						&timing_0_293
						&timing_0_295
						&timing_0_297
						&timing_0_31
						&timing_0_33
						&timing_0_35
						&timing_0_37
						&timing_0_42
						&timing_0_44
						&timing_0_48
						&timing_0_50
						&timing_0_52
						&timing_0_54
						&timing_0_56
						&timing_0_58
						&timing_0_62
						&timing_0_64
						&timing_0_66
						&timing_0_68
						&timing_0_70
						&timing_0_72
						&timing_0_78
						&timing_0_80
						&timing_0_82
						&timing_0_84
						&timing_0_86
						&timing_0_88
						&timing_0_94
						&timing_0_96
						&timing_0_99
						&timing_0_321
						&timing_0_323
						&timing_0_325
						&timing_0_327
						&timing_0_329
						&timing_0_331
						&timing_1
						&timing_10
						&timing_10_109
						&timing_10_135
						&timing_10_208
						&timing_10_228
						&timing_10_255
						&timing_11
						&timing_11_110
						&timing_11_136
						&timing_11_209
						&timing_11_229
						&timing_11_256
						&timing_12
						&timing_12_137
						&timing_12_210
						&timing_12_257
						&timing_13
						&timing_13_138
						&timing_13_211
						&timing_13_258
						&timing_14
						&timing_14_139
						&timing_14_212
						&timing_14_259
						&timing_15
						&timing_15_140
						&timing_15_213
						&timing_15_260
						&timing_16
						&timing_16_141
						&timing_16_214
						&timing_16_261
						&timing_17
						&timing_17_142
						&timing_17_215
						&timing_17_262
						&timing_18
						&timing_18_216
						&timing_18_119
						&timing_18_241
						&timing_19_120
						&timing_19_242
						&timing_19_217
						&timing_20_121
						&timing_20_243
						&timing_20_299
						&timing_1_100
						&timing_1_113
						&timing_1_126
						&timing_1_147
						&timing_1_153
						&timing_1_177
						&timing_1_187
						&timing_1_199
						&timing_1_219
						&timing_1_232
						&timing_1_235
						&timing_1_24
						&timing_1_246
						&timing_1_275
						&timing_1_283
						&timing_1_38
						&timing_1_45
						&timing_1_59
						&timing_1_73
						&timing_1_89
						&timing_1_97
						&timing_2
						&timing_2_101
						&timing_2_114
						&timing_2_127
						&timing_2_148
						&timing_2_154
						&timing_2_178
						&timing_2_188
						&timing_2_200
						&timing_2_220
						&timing_2_236
						&timing_2_247
						&timing_2_25
						&timing_2_276
						&timing_2_284
						&timing_2_39
						&timing_2_46
						&timing_2_60
						&timing_2_74
						&timing_2_90
						&timing_3
						&timing_3_102
						&timing_3_115
						&timing_3_128
						&timing_3_149
						&timing_3_179
						&timing_3_201
						&timing_3_221
						&timing_3_237
						&timing_3_248
						&timing_3_285
						&timing_3_40
						&timing_3_75
						&timing_3_91
						&timing_4
						&timing_4_103
						&timing_4_116
						&timing_4_129
						&timing_4_150
						&timing_4_180
						&timing_4_202
						&timing_4_222
						&timing_4_238
						&timing_4_249
						&timing_4_76
						&timing_4_92
						&timing_5
						&timing_5_104
						&timing_5_117
						&timing_5_130
						&timing_5_203
						&timing_5_223
						&timing_5_239
						&timing_5_250
						&timing_6
						&timing_6_105
						&timing_6_118
						&timing_6_131
						&timing_6_204
						&timing_6_224
						&timing_6_240
						&timing_6_251
						&timing_7
						&timing_7_106
						&timing_7_132
						&timing_7_205
						&timing_7_225
						&timing_7_252
						&timing_8
						&timing_8_107
						&timing_8_133
						&timing_8_206
						&timing_8_226
						&timing_8_253
						&timing_9
						&timing_9_108
						&timing_9_134
						&timing_9_207
						&timing_9_227
						&timing_9_254
						&vcm_0
						&vcm_1
	>;
};
