&mdss_mdp {
	dsi_icnl9916c_tm_hd_video: qcom,mdss_dsi_icnl9916c_tm_hd_video {
		qcom,mdss-dsi-panel-name =
			"mipi_mot_vid_tm_icnl9916c_hd_720_1600";
		qcom,mdss-dsi-panel-type = "dsi_video_mode";
		qcom,dsi-ctrl-num = <0>;
		qcom,dsi-phy-num = <0>;
		//qcom,mdss-dsi-panel-mode-switch;
		qcom,mdss-dsi-virtual-channel-id = <0>;
		qcom,mdss-dsi-stream = <0>;
		qcom,mdss-dsi-bpp = <24>;
		qcom,mdss-dsi-color-order = "rgb_swap_rgb";
		qcom,mdss-dsi-underflow-color = <0xff>;
		qcom,mdss-dsi-border-color = <0>;
		qcom,mdss-dsi-traffic-mode = "non_burst_sync_event";
		qcom,mdss-dsi-lane-map = "lane_map_0123";
		qcom,mdss-dsi-bllp-eof-power-mode;
		qcom,mdss-dsi-bllp-power-mode;
		qcom,mdss-dsi-tx-eot-append;
		qcom,mdss-dsi-lane-0-state;
		qcom,mdss-dsi-lane-1-state;
		qcom,mdss-dsi-lane-2-state;
		qcom,mdss-dsi-lane-3-state;
		qcom,mdss-dsi-dma-trigger = "trigger_sw";
		qcom,mdss-dsi-mdp-trigger = "none";
		qcom,mdss-dsi-lp11-init;
		qcom,bklt-dcs-2bytes-enabled;
		qcom,mdss-dsi-bl-pmic-control-type = "bl_ctrl_dcs";
		qcom,mdss-dsi-reset-sequence = <0 2>, <1 10>;
		qcom,mdss-pan-physical-width-dimension = <70>;
		qcom,mdss-pan-physical-height-dimension = <156>;
		//qcom,mdss-dsi-te-pin-select = <1>;
		//qcom,mdss-dsi-te-dcs-command = <1>;
		//qcom,mdss-dsi-te-check-enable;
		//qcom,mdss-dsi-te-using-te-pin;
		qcom,mdss-dsi-cabc-mv-command = [
				15 00 00 00 02 00 02 55 03
				39 00 00 00 00 00 04 F0 99 16 0C
				39 00 00 00 00 00 20 E1 0F 1F 2F 3F 4F 5F 6F 7F 90 A0 B0 C0 D0 E0 E8 E7 E7 E7 E7 E9 EB EC ED F0 F0 F3 F6 F9 FD FF FF
				39 00 00 00 00 00 21 E2 2F FF 2F FF 2F FF 2F FF 31 47 32 8F 33 D6 35 1E 36 66 37 EF 39 78 3B 01 3C 8A 3E 14 3F FF 3F FF
				39 00 00 00 00 00 04 F0 00 00 00
				];
		qcom,mdss-dsi-cabc-mv-command-state =  "dsi_hs_mode";
		qcom,mdss-dsi-cabc-ui-command = [
				15 00 00 00 02 00 02 55 03
				39 00 00 00 00 00 04 F0 99 16 0C
				39 00 00 00 00 00 20 E1 0F 1F 2F 3F 4F 5F 6F 7F 90 A0 B0 C0 D0 E0 E8 EC ED EF F1 F3 F5 F7 F9 FB FF FC FD FE FF FF FF
				39 00 00 00 00 00 21 E2 36 24 37 4B 38 72 39 99 3A 1C 3A 9F 3B 22 3B A5 3C 28 3F 50 3D B1 3E 76 3F 3A 3F FF 3F FF 3F FF
				39 00 00 00 00 00 04 F0 00 00 00
				];
		qcom,mdss-dsi-cabc-ui-command-state =  "dsi_hs_mode";
		qcom,mdss-dsi-cabc-dis-command = [15 01 00 00 02 00 02 55 00];
		qcom,mdss-dsi-cabc-dis-command-state =  "dsi_hs_mode";
		qcom,mdss-dsi-display-timings {
			timing@0 {
				qcom,mdss-dsi-video-mode;
				qcom,mdss-dsi-panel-width = <720>;
				qcom,mdss-dsi-panel-height = <1600>;
				qcom,mdss-dsi-h-front-porch = <48>;
				qcom,mdss-dsi-h-back-porch = <48>;
				qcom,mdss-dsi-h-pulse-width = <4>;
				qcom,mdss-dsi-h-sync-skew = <0>;
				qcom,mdss-dsi-v-back-porch = <32>;
				qcom,mdss-dsi-v-front-porch = <1268>;
				qcom,mdss-dsi-v-pulse-width = <4>;
				qcom,mdss-dsi-panel-framerate = <60>;
				qcom,mdss-dsi-on-command = [
					39 01 00 00 00 00 04 F0 99 16 0C
					39 01 00 00 00 00 15 C1 11 20 2C 2C 04 30 30 04 40 06 22 70 35 21 07 11 84 4C 00 93
					39 01 00 00 00 00 05 C8 46 00 88 98
					39 01 00 00 00 00 05 BD A1 0A 52 A6
					39 01 00 00 00 00 03 35 00 00
					39 01 00 00 00 00 03 53 2C 00
					39 01 00 00 02 00 03 55 03 00
					39 01 00 00 00 00 18 E0 0C 00 B0 0C 00 0A 8C 29 04 81 1F 00 00 00 00 24 12 08 11 48 47 00 00
					39 01 00 00 00 00 20 E1 0F 1F 2F 3F 4F 5F 6F 7F 90 A0 B0 C0 D0 E0 E8 EC ED EF F1 F3 F5 F7 F9 FB FF FC FD FE FF FF FF
					39 01 00 00 00 00 21 E2 36 24 37 4B 38 72 39 99 3A 1C 3A 9F 3B 22 3B A5 3C 28 3F 50 3D B1 3E 76 3F 3A 3F FF 3F FF 3F FF
					39 01 00 00 64 00 03 11 00 00
					39 01 00 00 14 00 03 29 00 00
					39 01 00 00 00 00 03 6D 02 00
					39 01 00 00 00 00 05 BD A1 0A 52 AE
					39 01 00 00 00 00 04 F0 00 00 00
				];
				qcom,mdss-dsi-off-command = [
					39 01 00 00 00 00 03 6D 25 00
					39 01 00 00 0A 00 03 28 00 00
					39 01 00 00 64 00 03 10 00 00
				];
				qcom,mdss-dsi-on-command-state = "dsi_lp_mode";
				qcom,mdss-dsi-off-command-state = "dsi_lp_mode";
			};
		};
	};
};
