// SPDX-License-Identifier: BSD-3-Clause
/*
 * Copyright (c) Qualcomm Technologies, Inc. and/or its subsidiaries.
 */

/dts-v1/;
/plugin/;

#include "trustedvm-canoe-sde.dtsi"
#include "trustedvm-canoe-sde-display-mtp.dtsi"

/ {
	model = "Qualcomm Technologies, Inc. Alor Interposer MTP - TrustedVM";
	compatible = "qcom,canoe-mtp", "qcom,canoe", "qcom,mtp";
	qcom,msm-id = <704 0x10000>, <0x10002C0 0x10000>,
			<704 0x20000>, <0x10002C0 0x20000>;
	qcom,board-id = <8 0>;
};
