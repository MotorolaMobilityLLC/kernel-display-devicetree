/dts-v1/;
/plugin/;

#include "cape-sde-display-felix-common-base.dtsi"

/ {
	model = "felix";
	compatible = "qcom,cape-mtp", "qcom,cape", "qcom,mtp", "moto,felix";
	qcom,msm-id = <530 0x10000>, <531 0x10000>, <540 0x10000>;
	qcom,board-id = <0x49 0xA100>, <0x49 0xA1A0>, <0x49 0xA1B0>, <0x49 0xA1C0>;
};
