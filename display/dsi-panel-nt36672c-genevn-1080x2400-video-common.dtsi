&mdss_mdp {
	mot_csot_nt36672c_genevn_1080x2400_dsc_vid: qcom,mdss_dsi_mot_csot_nt36672c_genevn_1080x2400_dsc_vid {
		qcom,mdss-dsi-panel-name = "mipi_moto_vid_csot_1080p_dsc_655";
		qcom,mdss-dsi-panel-type = "dsi_video_mode";
		qcom,mdss-dsi-panel-physical-type = "lcd";
		qcom,mdss-dsi-virtual-channel-id = <0>;
		qcom,mdss-dsi-stream = <0>;
		qcom,dsi-ctrl-num = <0>;
		qcom,dsi-phy-num = <0>;
		qcom,mdss-pan-physical-width-dimension = <68>;
		qcom,mdss-pan-physical-height-dimension = <152>;
		qcom,mdss-dsi-bpp = <24>;
		qcom,mdss-dsi-underflow-color = <0xff>;
		qcom,mdss-dsi-border-color = <0>;
		qcom,mdss-dsi-h-sync-pulse = <0>;

		//qcom,mdss-dsi-panel-mode-switch;

		//qcom,dsi-sec-ctrl-num = <1>;
		//qcom,dsi-sec-phy-num = <1>;

		qcom,mdss-dsi-traffic-mode = "non_burst_sync_event";
		//qcom,mdss-dsi-lane-map = "lane_map_0123";
		qcom,mdss-dsi-bllp-eof-power-mode;
		qcom,mdss-dsi-bllp-power-mode;
		qcom,mdss-dsi-lane-0-state;
		qcom,mdss-dsi-lane-1-state;
		qcom,mdss-dsi-lane-2-state;
		qcom,mdss-dsi-lane-3-state;
		qcom,mdss-dsi-dma-trigger = "trigger_sw";
		qcom,mdss-dsi-mdp-trigger = "none";
		qcom,mdss-dsi-reset-sequence = <1 10>, <0 10>, <1 10>;
		qcom,mdss-dsi-bl-pmic-control-type = "bl_ctrl_dcs";

		qcom,mdss-dsi-display-timings {
			timing@0 {
				cell-index = <0>;
				qcom,mdss-dsi-panel-framerate = <120>;
				qcom,mdss-dsi-panel-width = <1080>;
				qcom,mdss-dsi-panel-height = <2400>;
				qcom,mdss-dsi-h-front-porch = <156>;
				qcom,mdss-dsi-h-back-porch = <80>;
				qcom,mdss-dsi-h-pulse-width = <4>;
				qcom,mdss-dsi-h-sync-skew = <0>;
				qcom,mdss-dsi-v-back-porch = <18>;
				qcom,mdss-dsi-v-front-porch = <54>;
				qcom,mdss-dsi-v-pulse-width = <2>;
				qcom,mdss-dsi-h-left-border = <0>;
				qcom,mdss-dsi-h-right-border = <0>;
				qcom,mdss-dsi-v-top-border = <0>;
				qcom,mdss-dsi-v-bottom-border = <0>;

				qcom,mdss-dsi-on-command = [
 					39 01 00 00 00 00 02 FF 10
 					39 01 00 00 00 00 02 FB 01
 					39 01 00 00 00 00 02 B0 00

 					39 01 00 00 00 00 02 FF E0
 					39 01 00 00 00 00 02 FB 01
 					39 01 00 00 00 00 02 35 82

 					39 01 00 00 00 00 02 FF F0
 					39 01 00 00 00 00 02 FB 01
 					39 01 00 00 00 00 02 1C 01
 					39 01 00 00 00 00 02 33 01
 					39 01 00 00 00 00 02 5A 00

 					39 01 00 00 00 00 02 FF D0
 					39 01 00 00 00 00 02 FB 01
 					39 01 00 00 00 00 02 53 22

 					39 01 00 00 00 00 02 54 02
 					39 01 00 00 00 00 02 FF C0
 					39 01 00 00 00 00 02 FB 01
 					39 01 00 00 00 00 02 9C 11
 					39 01 00 00 00 00 02 9D 11

 					39 01 00 00 00 00 02 FF 2B
 					39 01 00 00 00 00 02 FB 01
 					39 01 00 00 00 00 02 B7 28
 					39 01 00 00 00 00 02 B8 03
 					39 01 00 00 00 00 02 C0 02

 					39 01 00 00 00 00 02 FF 10
 					39 01 00 00 00 00 02 FB 01
 					39 01 00 00 00 00 03 51 03 0F
 					39 01 00 00 00 00 02 53 2C
 					39 01 00 00 00 00 02 55 01
					39 01 00 00 00 00 03 68 00 01

 					39 01 00 00 00 00 02 FF 10
 					39 01 00 00 00 00 02 FB 01
 					39 01 00 00 00 00 02 35 00

 					39 01 00 00 00 00 02 FF 10

 					05 01 00 00 78 00 02 11 00
 					05 01 00 00 14 00 02 29 00
				];

				qcom,mdss-dsi-off-command = [
					05 01 00 00 14 00 02 28 00
					05 01 00 00 78 00 02 10 00];
				qcom,mdss-dsi-on-command-state = "dsi_lp_mode";
				qcom,mdss-dsi-off-command-state = "dsi_lp_mode";

				qcom,compression-mode = "dsc";
				qcom,mdss-dsc-slice-height = <20>;
				qcom,mdss-dsc-slice-width = <540>;
				qcom,mdss-dsc-slice-per-pkt = <2>;
				qcom,mdss-dsc-bit-per-component = <8>;
				qcom,mdss-dsc-bit-per-pixel = <8>;
				qcom,mdss-dsc-block-prediction-enable;
			};
		};
	};
};

