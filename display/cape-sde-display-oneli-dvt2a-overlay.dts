/dts-v1/;
/plugin/;

#include "cape-sde-display-oneli-common.dtsi"

/ {
	model = "oneli";
	compatible = "qcom,cape-mtp", "qcom,cape", "qcom,mtp", "moto,oneli";
	qcom,msm-id = <530 0x10000>, <531 0x10000>, <540 0x10000>;
	qcom,board-id = <0x45 0xB2A0>, <0x45 0xC000>;
};

&sde_dsi {
	vci-supply = <&L11C>;
};
