/dts-v1/;
/plugin/;

#include "sm8150-sde.dtsi"
#include "sm8150-sde-pll.dtsi"

/ {
	qcom,msm-id = <339 0x10000>, <339 0x20000>,
			<362 0x10000>, <362 0x20000>,
			<367 0x10000>, <367 0x20000>;
	qcom,board-id = <0 0>;
};
