// SPDX-License-Identifier: BSD-3-Clause
 /*
  * Copyright (c) 2024 Qualcomm Innovation Center, Inc. All rights reserved.
  */

#include "canoe-sde-display-cdp.dtsi"

&sde_dsi {
	qcom,dsi-default-panel = <&dsi_nt37801_amoled_fhd_plus_cmd>;
};
