/* Copyright (c) 2019-2025, The Linux Foundation. All rights reserved.
 *
 * This program is free software; you can redistribute it and/or modify
 * it under the terms of the GNU General Public License version 2 and
 * only version 2 as published by the Free Software Foundation.
 *
 * This program is distributed in the hope that it will be useful,
 * but WITHOUT ANY WARRANTY; without even the implied warranty of
 * MERCHANTABILITY or FITNESS FOR A PARTICULAR PURPOSE.  See the
 * GNU General Public License for more details.
 */
&mdss_mdp {
	mot_tm_vtdr6126a_678_1272x2772_dsc_vid: qcom,mdss_dsi_mot_tm_vtdr6126a_678_1272x2772_dsc_vid {
		qcom,mdss-dsi-panel-name = "mipi_mot_vid_tm_1272p_dsc_678_144hz";
		qcom,mdss-dsi-panel-supplier = "tm";
		qcom,mdss-dsi-panel-type = "dsi_video_mode";
		qcom,mdss-dsi-panel-physical-type = "oled";
		qcom,dsi-ctrl-num = <0>;
		qcom,dsi-phy-num = <0>;
		qcom,mdss-dsi-virtual-channel-id = <0>;
		qcom,mdss-dsi-stream = <0>;
		qcom,mdss-pan-physical-width-dimension = <72>;
		qcom,mdss-pan-physical-height-dimension = <157>;
		qcom,mdss-dsi-bpp = <30>;
		qcom,mdss-dsi-underflow-color = <0xff>;
		qcom,mdss-dsi-border-color = <0>;

		qcom,mdss-dsi-traffic-mode = "non_burst_sync_event";
		qcom,mdss-dsi-bllp-eof-power-mode;
		qcom,mdss-dsi-bllp-power-mode;
		qcom,mdss-dsi-lp11-init;
		qcom,mdss-dsi-lane-0-state;
		qcom,mdss-dsi-lane-1-state;
		qcom,mdss-dsi-lane-2-state;
		qcom,mdss-dsi-lane-3-state;
		qcom,mdss-dsi-dma-trigger = "trigger_sw";
		qcom,mdss-dsi-mdp-trigger = "none";
		qcom,mdss-dsi-reset-sequence = <1 2>, <0 5>, <1 25>;
		qcom,mdss-dsi-force-clock-lane-hs;

		qcom,mdss-dsi-dc-off-command = [
			39 00 00 00 00 00 02 5E 00];
		qcom,mdss-dsi-dc-off-command-state = "dsi_hs_mode";
		qcom,mdss-dsi-dc-on-command = [
			39 00 00 00 00 00 02 5E 01];
		qcom,mdss-dsi-dc-on-command-state = "dsi_hs_mode";

		qcom,mdss-dsi-hbm-on-command = [
			39 00 00 40 00 00 02 A4 01
			39 00 00 40 00 00 03 F0 AA 19
			39 00 00 40 00 00 02 C0 00
			39 00 00 40 00 00 03 51 3F FC
			39 00 00 40 00 00 03 F0 AA 00
			39 00 00 40 00 00 02 A4 00
			39 00 00 00 00 00 02 A6 01];
		qcom,mdss-dsi-hbm-on-command-state = "dsi_hs_mode";
		qcom,mdss-dsi-hbm-off-command = [
			39 00 00 00 00 00 02 62 00];
		qcom,mdss-dsi-hbm-off-command-state = "dsi_hs_mode";

		qcom,mdss-dsi-hbm-fod;
		qcom,mdss-dsi-hbm-fod-on-command = [
			39 00 00 40 00 00 05 63 10 00 1A 3C
			39 01 00 00 00 00 02 62 03];
		qcom,mdss-dsi-hbm-fod-on-command-state = "dsi_hs_mode";

		qcom,mdss-dsi-panel-lhbm-wait-fps-valid;
		qcom,mdss-dsi-panel-local-hbm-wait-fps-count = <30>;
		qcom,mdss-dsi-panel-local-hbm-wait-fps-interval = <1>;
		qcom,mdss-dsi-panel-lhbm-not-allowed-fps-list = <60 90 144>;

		qcom,mdss-dsi-panel-local-hbm-enabled;
		qcom,mdss-dsi-panel-local-hbm-DC-HYBIRD-THRESHOLD-BL = <3519>;
		qcom,mdss-dsi-panel-local-hbm-alpha-register = <0x63>;
		qcom,mdss-dsi-panel-local-hbm-alpha-size = <16001>;
		qcom,mdss-dsi-panel-bl-num = <1>;

		qcom,mdss-dsi-display-timings {
			timing@0 {
				cell-index = <0>;
				qcom,mdss-dsi-video-mode;
				qcom,mdss-dsi-cmd-mode;
				qcom,mdss-dsi-panel-framerate = <60>;
				qcom,mdss-dsi-panel-width = <1272>;
				qcom,mdss-dsi-panel-height = <2772>;
				qcom,mdss-dsi-h-front-porch = <124>;
				qcom,mdss-dsi-h-back-porch = <16>;
				qcom,mdss-dsi-h-pulse-width = <16>;
				qcom,mdss-dsi-h-sync-skew = <0>;
				qcom,mdss-dsi-h-sync-pulse = <0>;
				qcom,mdss-dsi-v-back-porch = <22>;
				qcom,mdss-dsi-v-front-porch = <2964>;
				qcom,mdss-dsi-v-pulse-width = <2>;
				qcom,mdss-dsi-h-left-border = <0>;
				qcom,mdss-dsi-h-right-border = <0>;
				qcom,mdss-dsi-v-top-border = <0>;
				qcom,mdss-dsi-v-bottom-border = <0>;
				qcom,vid-on-commands = [
					39 00 00 00 00 00 02 03 01
					39 00 00 00 00 00 05 2A 00 00 04 F8
					39 00 00 00 00 00 05 2B 00 00 05 40
					39 00 00 00 00 00 02 35 00
					39 00 00 00 00 00 03 51 00 00
					39 00 00 00 00 00 02 53 20
					39 00 00 00 00 00 02 59 09
					39 00 00 00 00 00 02 5E 00
					39 00 00 00 00 00 02 6B 01
					39 00 00 00 00 00 02 6C 03
					39 00 00 00 00 00 02 6D 00
					39 00 00 00 00 00 02 6F 01
					39 00 00 00 00 00 02 72 00

					39 00 00 00 00 00 5F 70 12 00 00 AB 30 80 0A D4 04 F8 00 0C 02 7C 02 7C 02 00 02 3E 00 20 01 37 00 08 00 0C 08 BB 07 32 18 00 10 F0 07 10 20 00 06 0F 0F 33 0E 1C 2A 38 46 54 62 69 70 77 79 7B 7D 7E 02 02 22 00 2A 40 2A BE 3A FC 3A FA 3A F8 3B 38 3B 78 3B B6 4B B6 4B F4 4B F4 6C 34 84 74 00 00 00 00 00 00

					39 00 00 00 00 00 03 F0 AA 10
					39 00 00 00 00 00 03 B9 01 10

					39 00 00 00 00 00 02 65 09
					39 00 00 00 00 00 02 CF 5B
					39 00 00 00 00 00 02 65 0B
					39 00 00 00 00 00 03 CF FD 79

					39 00 00 00 00 00 03 F0 AA 11
					39 00 00 00 00 00 08 D5 13 20 00 00 88 88 00
					39 00 00 00 00 00 16 D6 55 66 06 3A 45 81 3A 45 81 3A 45 81 3A 45 81 3A 45 81 3A 45 81
					39 00 00 00 00 00 23 D7 55 55 55 55 00 00 78 69 59 4A 3A 2A 1A 0C 00 00 7D 6B 5A 48 38 29 1A 0C 00 00 78 6A 5B 4D 3C 2C 1C 0D
					39 00 00 00 00 00 1F D8 00 00 24 20 1B 17 12 0D 09 04 00 00 2A 25 1F 1A 15 0F 0A 05 00 00 21 1D 19 15 10 0C 08 03
					39 00 00 00 00 00 13 E8 19 1B 24 34 4B 6B 94 C6 FF 00 03 0C 1E 38 5B 89 C0 FF
					39 00 00 00 00 00 1A E9 19 19 19 19 19 19 1A 1A 1F 23 2B 3E 5A 7E 92 AB C4 E0 FD FD FD FD FD FD FD
					39 00 00 00 00 00 16 D9 55 66 06 3A 45 81 3A 45 81 3A 45 81 3A 45 81 3A 45 81 3A 45 81
					39 00 00 00 00 00 23 E0 55 55 55 55 00 00 78 68 58 48 38 29 1A 0C 00 00 7A 69 57 45 36 28 1A 0C 00 00 7D 6C 5B 4A 3A 2A 1B 0D
					39 00 00 00 00 00 1F E1 00 00 26 21 1C 18 13 0E 09 04 00 00 29 24 1F 1A 14 0F 0A 04 00 00 28 23 1E 19 14 0E 0A 04
					39 00 00 00 00 00 16 E2 55 66 06 3A 45 81 3A 45 81 3A 45 81 3A 45 81 3A 45 81 3A 45 81
					39 00 00 00 00 00 23 E3 55 55 55 55 00 00 7B 6A 59 48 38 29 19 0C 00 00 7B 6A 58 46 36 27 19 0C 00 00 7E 6D 5C 4B 3A 2A 1B 0D
					39 00 00 00 00 00 1F E4 00 00 28 23 1E 19 14 0E 0A 04 00 00 29 24 1F 1A 14 0F 0A 04 00 00 28 23 1E 19 14 0E 0A 04
					39 00 00 00 00 00 16 E5 55 66 06 3A 45 81 3A 45 81 3A 45 81 3A 45 81 3A 45 81 3A 45 81
					39 00 00 00 00 00 23 E6 55 55 55 55 00 00 7E 6D 5C 4B 3B 2B 1B 0D 00 00 7B 6A 59 48 37 28 19 0C 00 00 81 70 5E 4C 3C 2C 1C 0D
					39 00 00 00 00 00 1F E7 00 00 28 23 1E 19 14 0E 0A 04 00 00 28 23 1E 19 14 0E 0A 04 00 00 29 24 1F 1A 14 0F 0A 04

					39 00 00 00 00 00 03 F0 AA 14
					39 00 00 00 00 00 02 BC 90
					39 00 00 00 00 00 02 BD 90
					39 00 00 00 00 00 02 BE 90

					39 00 00 00 00 00 03 F0 AA 15
					39 00 00 00 00 00 13 B5 33 27 41 33 77 11 30 70 10 24 30 00 44 00 00 40 00 00

					39 00 00 00 00 00 03 F0 AA 16
					39 00 00 00 00 00 11 D1 00 00 00 00 00 00 00 00 00 00 00 00 00 00 00 00

					39 00 00 00 00 00 03 F0 AA 18
					39 00 00 00 00 00 32 B8 01 9C 32 9C 06 00 00 9C 6A 9C 07 00 26 9C 97 9C 06 00 A9 1C 97 1C 02 00 C7 9F 69 9F 01 00 00 9F 5D 9F 05 00 0C 1F 97 1F 08 00 2A 2F 97 2F 04 00 AD

					39 00 00 00 00 00 03 F0 AA 19
					39 00 00 00 00 00 02 C0 00

					39 00 00 00 00 00 03 FF 5A 80
					39 00 00 00 00 00 02 65 25
					39 00 00 00 00 00 02 FD 01

					39 00 00 00 00 00 02 F9 10
					39 00 00 00 00 00 02 65 0A
					39 00 00 00 00 00 02 F9 1E

					39 00 00 00 00 00 03 FF 5A 81
					39 00 00 00 00 00 02 65 03
					39 00 00 00 00 00 02 F3 61
					39 00 00 00 00 00 02 65 0B
					39 00 00 00 00 00 02 F3 78

					39 00 00 00 00 00 03 FF 5A 83
					39 00 00 00 00 00 02 65 09
					39 00 00 00 00 00 03 F7 10 10
					39 00 00 00 00 00 02 65 0B
					39 00 00 00 00 00 02 F7 03

					39 00 00 00 00 00 03 F0 AA 00
					39 00 00 00 00 00 03 FF 5A 00

					05 00 00 00 55 00 01 11
					05 00 00 00 00 00 01 29
				];

				qcom,cmd-on-commands = [
					39 00 00 00 00 00 02 03 01
					39 00 00 00 00 00 05 2A 00 00 04 F8
					39 00 00 00 00 00 05 2B 00 00 05 40
					39 00 00 00 00 00 02 35 00
					39 00 00 00 00 00 03 51 00 00
					39 00 00 00 00 00 02 53 20
					39 00 00 00 00 00 02 59 09
					39 00 00 00 00 00 02 5E 00
					39 00 00 00 00 00 02 6B 01
					39 00 00 00 00 00 02 6C 03
					39 00 00 00 00 00 02 6D 00
					39 00 00 00 00 00 02 6F 01
					39 00 00 00 00 00 02 72 00

					39 00 00 00 00 00 5F 70 12 00 00 AB 30 80 0A D4 04 F8 00 0C 02 7C 02 7C 02 00 02 3E 00 20 01 37 00 08 00 0C 08 BB 07 32 18 00 10 F0 07 10 20 00 06 0F 0F 33 0E 1C 2A 38 46 54 62 69 70 77 79 7B 7D 7E 02 02 22 00 2A 40 2A BE 3A FC 3A FA 3A F8 3B 38 3B 78 3B B6 4B B6 4B F4 4B F4 6C 34 84 74 00 00 00 00 00 00

					39 00 00 00 00 00 03 F0 AA 10
					39 00 00 00 00 00 03 B9 01 10

					39 00 00 00 00 00 02 65 09
					39 00 00 00 00 00 02 CF 5B
					39 00 00 00 00 00 02 65 0B
					39 00 00 00 00 00 03 CF FD 79

					39 00 00 00 00 00 03 F0 AA 11
					39 00 00 00 00 00 08 D5 13 20 00 00 88 88 00
					39 00 00 00 00 00 16 D6 55 66 06 3A 45 81 3A 45 81 3A 45 81 3A 45 81 3A 45 81 3A 45 81
					39 00 00 00 00 00 23 D7 55 55 55 55 00 00 78 69 59 4A 3A 2A 1A 0C 00 00 7D 6B 5A 48 38 29 1A 0C 00 00 78 6A 5B 4D 3C 2C 1C 0D
					39 00 00 00 00 00 1F D8 00 00 24 20 1B 17 12 0D 09 04 00 00 2A 25 1F 1A 15 0F 0A 05 00 00 21 1D 19 15 10 0C 08 03
					39 00 00 00 00 00 13 E8 19 1B 24 34 4B 6B 94 C6 FF 00 03 0C 1E 38 5B 89 C0 FF
					39 00 00 00 00 00 1A E9 19 19 19 19 19 19 1A 1A 1F 23 2B 3E 5A 7E 92 AB C4 E0 FD FD FD FD FD FD FD
					39 00 00 00 00 00 16 D9 55 66 06 3A 45 81 3A 45 81 3A 45 81 3A 45 81 3A 45 81 3A 45 81
					39 00 00 00 00 00 23 E0 55 55 55 55 00 00 78 68 58 48 38 29 1A 0C 00 00 7A 69 57 45 36 28 1A 0C 00 00 7D 6C 5B 4A 3A 2A 1B 0D
					39 00 00 00 00 00 1F E1 00 00 26 21 1C 18 13 0E 09 04 00 00 29 24 1F 1A 14 0F 0A 04 00 00 28 23 1E 19 14 0E 0A 04
					39 00 00 00 00 00 16 E2 55 66 06 3A 45 81 3A 45 81 3A 45 81 3A 45 81 3A 45 81 3A 45 81
					39 00 00 00 00 00 23 E3 55 55 55 55 00 00 7B 6A 59 48 38 29 19 0C 00 00 7B 6A 58 46 36 27 19 0C 00 00 7E 6D 5C 4B 3A 2A 1B 0D
					39 00 00 00 00 00 1F E4 00 00 28 23 1E 19 14 0E 0A 04 00 00 29 24 1F 1A 14 0F 0A 04 00 00 28 23 1E 19 14 0E 0A 04
					39 00 00 00 00 00 16 E5 55 66 06 3A 45 81 3A 45 81 3A 45 81 3A 45 81 3A 45 81 3A 45 81
					39 00 00 00 00 00 23 E6 55 55 55 55 00 00 7E 6D 5C 4B 3B 2B 1B 0D 00 00 7B 6A 59 48 37 28 19 0C 00 00 81 70 5E 4C 3C 2C 1C 0D
					39 00 00 00 00 00 1F E7 00 00 28 23 1E 19 14 0E 0A 04 00 00 28 23 1E 19 14 0E 0A 04 00 00 29 24 1F 1A 14 0F 0A 04

					39 00 00 00 00 00 03 F0 AA 14
					39 00 00 00 00 00 02 BC 90
					39 00 00 00 00 00 02 BD 90
					39 00 00 00 00 00 02 BE 90

					39 00 00 00 00 00 03 F0 AA 15
					39 00 00 00 00 00 13 B5 33 27 41 33 77 11 30 70 10 24 30 00 44 00 00 40 00 00

					39 00 00 00 00 00 03 F0 AA 16
					39 00 00 00 00 00 11 D1 00 00 00 00 00 00 00 00 00 00 00 00 00 00 00 00

					39 00 00 00 00 00 03 F0 AA 18
					39 00 00 00 00 00 32 B8 01 9C 32 9C 06 00 00 9C 6A 9C 07 00 26 9C 97 9C 06 00 A9 1C 97 1C 02 00 C7 9F 69 9F 01 00 00 9F 5D 9F 05 00 0C 1F 97 1F 08 00 2A 2F 97 2F 04 00 AD

					39 00 00 00 00 00 03 F0 AA 19
					39 00 00 00 00 00 02 C0 00

					39 00 00 00 00 00 03 FF 5A 80
					39 00 00 00 00 00 02 65 25
					39 00 00 00 00 00 02 FD 01

					39 00 00 00 00 00 02 F9 10
					39 00 00 00 00 00 02 65 0A
					39 00 00 00 00 00 02 F9 1E

					39 00 00 00 00 00 03 FF 5A 81
					39 00 00 00 00 00 02 65 03
					39 00 00 00 00 00 02 F3 61
					39 00 00 00 00 00 02 65 0B
					39 00 00 00 00 00 02 F3 78

					39 00 00 00 00 00 03 FF 5A 83
					39 00 00 00 00 00 02 65 09
					39 00 00 00 00 00 03 F7 10 10
					39 00 00 00 00 00 02 65 0B
					39 00 00 00 00 00 02 F7 03

					39 00 00 00 00 00 03 F0 AA 00
					39 00 00 00 00 00 03 FF 5A 00

					05 00 00 00 55 00 01 11
					05 00 00 00 00 00 01 29

					//cmd aod mode
					39 00 00 40 00 00 01 28
					39 00 00 40 00 00 02 6F 02
					39 00 00 40 00 00 02 6D 01
					39 00 00 00 11 00 01 39
					39 00 00 40 00 00 03 44 06 8C
					39 00 00 00 00 00 01 29
				];

				qcom,mdss-dsi-off-command = [
					05 01 00 00 11 00 01 28
					05 01 00 00 78 00 01 10];
				qcom,mdss-dsi-on-command-state = "dsi_lp_mode";
				qcom,mdss-dsi-off-command-state = "dsi_lp_mode";

				qcom,compression-mode = "dsc";
				qcom,mdss-dsc-version = <0x12>;
				qcom,mdss-dsc-slice-height = <12>;
				qcom,mdss-dsc-slice-width = <636>;
				qcom,mdss-dsc-slice-per-pkt = <2>;
				qcom,mdss-dsc-bit-per-component = <10>;
				qcom,mdss-dsc-bit-per-pixel = <8>;
				qcom,mdss-dsc-block-prediction-enable;

				qcom,mdss-dsi-dfps-60-command = [
					39 00 00 00 00 00 02 6C 03];
				qcom,mdss-dsi-dfps-60-command-state = "dsi_hs_mode";

				qcom,mdss-dsi-dfps-90-command = [
					39 00 00 00 00 00 02 6C 02];
				qcom,mdss-dsi-dfps-90-command-state = "dsi_hs_mode";

				qcom,mdss-dsi-dfps-120-command = [
					39 00 00 00 00 00 02 6C 01];
				qcom,mdss-dsi-dfps-120-command-state = "dsi_hs_mode";

				qcom,mdss-dsi-dfps-144-command = [
					39 00 00 00 00 00 02 6C 00];
				qcom,mdss-dsi-dfps-144-command-state = "dsi_hs_mode";

				//fps delay effect cmd
				qcom,mdss-dsi-dfps-60-delay-command = [
					39 00 00 40 00 00 02 A4 01
					39 00 00 40 00 00 02 6C 03
					39 00 00 40 00 00 02 A4 00
					39 00 00 00 00 00 02 A6 05];
				qcom,mdss-dsi-dfps-60-delay-command-state = "dsi_hs_mode";

				qcom,mdss-dsi-dfps-90-delay-command = [
					39 00 00 40 00 00 02 A4 01
					39 00 00 40 00 00 02 6C 02
					39 00 00 40 00 00 02 A4 00
					39 00 00 00 00 00 02 A6 05];
				qcom,mdss-dsi-dfps-90-delay-command-state = "dsi_hs_mode";

				qcom,mdss-dsi-dfps-120-delay-command = [
					39 00 00 40 00 00 02 A4 01
					39 00 00 40 00 00 02 6C 01
					39 00 00 40 00 00 02 A4 00
					39 00 00 00 00 00 02 A6 05];
				qcom,mdss-dsi-dfps-120-delay-command-state = "dsi_hs_mode";

				qcom,mdss-dsi-dfps-144-delay-command = [
					39 00 00 40 00 00 02 A4 01
					39 00 00 40 00 00 02 6C 00
					39 00 00 40 00 00 02 A4 00
					39 00 00 00 00 00 02 A6 05];
				qcom,mdss-dsi-dfps-144-delay-command-state = "dsi_hs_mode";

				qcom,mdss-dsi-pcd-check-enable-command = [
					39 00 00 40 00 00 03 F0 AA 12
					39 00 00 00 00 00 03 D0 08 02];
				qcom,mdss-dsi-pcd-check-enable-command-state = "dsi_hs_mode";

				qcom,mdss-dsi-pcd-check-disable-command = [
					39 00 00 40 00 00 03 F0 AA 12
					39 00 00 40 00 00 03 D0 08 00
					39 00 00 40 00 00 03 F0 AA 00
					39 00 00 00 00 00 03 FF 5A 00];
				qcom,mdss-dsi-pcd-check-disable-command-state = "dsi_hs_mode";

				qcom,cmd-mode-switch-in-commands = [
					39 00 00 40 00 00 01 28
					39 00 00 40 00 00 02 6F 02
					39 00 00 40 00 00 02 6D 01
					39 00 00 00 11 00 01 39
					39 00 00 40 00 00 03 44 06 8C
					39 00 00 00 00 00 01 29];
				qcom,cmd-mode-switch-in-commands-state = "dsi_hs_mode";

				qcom,cmd-mode-switch-out-commands = [
					39 00 00 40 00 00 03 51 19 1A
					39 00 00 40 00 00 02 A4 01
					39 00 00 40 00 00 01 38
					39 00 00 40 00 00 02 6F 01
					39 00 00 40 00 00 03 44 00 00
					39 00 00 40 00 00 02 A4 00
					39 00 00 00 5A 00 02 A6 01];
				qcom,cmd-mode-switch-out-commands-state = "dsi_hs_mode";

				qcom,cmd-mode-backlight-commands = [
					39 00 00 00 00 00 02 6D 01];
				qcom,cmd-mode-backlight-commands-state = "dsi_hs_mode";
			};
		};
	};
};
