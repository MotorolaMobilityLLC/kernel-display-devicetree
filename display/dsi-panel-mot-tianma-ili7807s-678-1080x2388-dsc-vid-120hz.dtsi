&mdss_mdp {
	mot_tm_ili7807s_678_1080x2388_dsc_vid_120hz: qcom,mdss_dsi_mot_tm_ili7807s_678_1080x2388_dsc_120hz_vid_fhd {
		qcom,mdss-dsi-panel-name = "mipi_moto_vid_tm_1080p_dsc_678_120hz";
		qcom,mdss-dsi-panel-type = "dsi_video_mode";
		qcom,mdss-dsi-panel-physical-type = "lcd";
		qcom,dsi-ctrl-num = <0>;
		qcom,dsi-phy-num = <0>;
		qcom,mdss-dsi-virtual-channel-id = <0>;
		qcom,mdss-dsi-stream = <0>;
		qcom,mdss-dsi-bpp = <24>;
		qcom,mdss-dsi-underflow-color = <0xff>;
		qcom,mdss-dsi-border-color = <0>;
		qcom,mdss-dsi-traffic-mode = "non_burst_sync_event";
		qcom,mdss-dsi-bllp-power-mode;
		qcom,mdss-dsi-bllp-eof-power-mode;
		qcom,mdss-dsi-lane-0-state;
		qcom,mdss-dsi-lane-1-state;
		qcom,mdss-dsi-lane-2-state;
		qcom,mdss-dsi-lane-3-state;
		qcom,mdss-dsi-dma-trigger = "trigger_sw";
		qcom,mdss-dsi-mdp-trigger = "none";
		qcom,mdss-dsi-lp11-init;
		qcom,mdss-dsi-reset-sequence = <1 1>, <0 1>, <1 15>;
		qcom,adjust-timer-wakeup-ms = <1>;
		qcom,mdss-pan-physical-width-dimension = <71>;
		qcom,mdss-pan-physical-height-dimension = <157>;
		//qcom,mdss-dsi-panel-hdr-enabled;
		//qcom,mdss-dsi-panel-hdr-color-primaries = <15000 16000 33750
		//				 15800 13250 34450 7500 3000>;
		//qcom,mdss-dsi-panel-peak-brightness = <6450000>;
		//qcom,mdss-dsi-panel-blackness-level = <4961>;

		qcom,mdss-dsi-cabc-mv-command = [15 01 00 00 00 00 02 55 03];
		qcom,mdss-dsi-cabc-mv-command-state =  "dsi_hs_mode";
		qcom,mdss-dsi-cabc-ui-command = [15 01 00 00 00 00 02 55 01];
		qcom,mdss-dsi-cabc-ui-command-state =  "dsi_hs_mode";
		qcom,mdss-dsi-cabc-dis-command = [15 01 00 00 00 00 02 55 00];
		qcom,mdss-dsi-cabc-dis-command-state =  "dsi_hs_mode";

		qcom,mdss-dsi-display-timings {
			timing@0 {
				cell-index = <0>;
				qcom,mdss-dsi-panel-width = <1080>;
				qcom,mdss-dsi-panel-height = <2388>;
				qcom,mdss-dsi-h-front-porch = <21>;
				qcom,mdss-dsi-h-back-porch = <22>;
				qcom,mdss-dsi-h-pulse-width = <2>;
				qcom,mdss-dsi-h-sync-skew = <0>;
				qcom,mdss-dsi-v-back-porch = <40>;
				qcom,mdss-dsi-v-front-porch = <38>;
				qcom,mdss-dsi-v-pulse-width = <2>;
				qcom,mdss-dsi-panel-framerate = <120>;
				qcom,mdss-dsi-h-left-border = <0>;
				qcom,mdss-dsi-h-right-border = <0>;
				qcom,mdss-dsi-v-top-border = <0>;
				qcom,mdss-dsi-v-bottom-border = <0>;

				qcom,mdss-dsi-on-command = [
					39 01 00 00 00 00 04 FF 78 07 06
					15 01 00 00 00 00 02 3E E2
					15 01 00 00 00 00 02 80 00
					39 01 00 00 00 00 04 FF 78 07 06
					15 01 00 00 00 00 02 08 20
					39 01 00 00 00 00 04 FF 78 07 03
					15 01 00 00 00 00 02 83 C8
					15 01 00 00 00 00 02 84 04
					39 01 00 00 00 00 04 FF 78 07 03
					15 01 00 00 00 00 02 85 30
					15 01 00 00 00 00 02 88 E6
					15 01 00 00 00 00 02 89 F0
					15 01 00 00 00 00 02 8A F6
					15 01 00 00 00 00 02 8B FF
					15 01 00 00 00 00 02 87 4D
					15 01 00 00 00 00 02 8C D2
					15 01 00 00 00 00 02 8D D6
					15 01 00 00 00 00 02 8E DA
					15 01 00 00 00 00 02 8F DE
					15 01 00 00 00 00 02 90 DF
					15 01 00 00 00 00 02 91 E6
					15 01 00 00 00 00 02 92 E9
					15 01 00 00 00 00 02 93 ED
					15 01 00 00 00 00 02 94 F0
					15 01 00 00 00 00 02 95 FF
					15 01 00 00 00 00 02 96 B5
					15 01 00 00 00 00 02 97 BA
					15 01 00 00 00 00 02 98 BF
					15 01 00 00 00 00 02 99 C4
					15 01 00 00 00 00 02 9A C9
					15 01 00 00 00 00 02 9B CD
					15 01 00 00 00 00 02 9C D5
					15 01 00 00 00 00 02 9D E6
					15 01 00 00 00 00 02 9E F6
					15 01 00 00 00 00 02 9F F7
					15 01 00 00 00 00 02 AF 18
					39 01 00 00 00 00 04 FF 78 07 06
					15 01 00 00 00 00 02 4E 40
					15 01 00 00 00 00 02 4D 01
					15 01 00 00 00 00 02 48 09
					15 01 00 00 00 00 02 C7 05
					39 01 00 00 00 00 04 FF 78 07 0C
					15 01 00 00 00 00 02 00 3F
					15 01 00 00 00 00 02 01 D2
					15 01 00 00 00 00 02 02 3F
					15 01 00 00 00 00 02 03 D3
					39 01 00 00 00 00 04 FF 78 07 08
					39 01 00 00 00 00 03 FD 00 9F
					15 01 00 00 00 00 02 E1 E1
					39 01 00 00 00 00 03 FD 00 00
					39 01 00 00 00 00 04 FF 78 07 12
					15 01 00 00 00 00 02 01 22
					39 01 00 00 00 00 04 FF 78 07 02
					15 01 00 00 00 00 02 1B 00
					15 01 00 00 00 00 02 82 12
					39 01 00 00 00 00 04 FF 78 07 00
					39 01 00 00 00 00 03 51 03 FF
					15 01 00 00 00 00 02 53 2C
					15 01 00 00 00 00 02 55 01
					15 01 00 00 00 00 02 35 00
					05 01 00 00 46 00 02 11 00
					39 01 00 00 00 00 04 FF 78 07 06
					15 01 00 00 00 00 02 8D D8
					15 01 00 00 00 00 02 1E 44
					39 01 00 00 00 00 04 FF 78 07 00
					05 01 00 00 05 00 02 29 00
				];
				qcom,mdss-dsi-on-command-state = "dsi_lp_mode";
				qcom,mdss-dsi-off-command = [
					/*S88528AA1-5111,huangxinglue.wt,mod,20240204,improve suspend sequence*/
					05 01 00 00 01 00 00
					05 01 00 00 14 00 01 28
					05 01 00 00 64 00 01 10
				];
				qcom,mdss-dsi-off-command-state = "dsi_lp_mode";
				qcom,compression-mode = "dsc";
				qcom,mdss-dsc-slice-height = <12>;
				qcom,mdss-dsc-slice-width = <540>;
				qcom,mdss-dsc-slice-per-pkt = <2>;
				qcom,mdss-dsc-bit-per-component = <8>;
				qcom,mdss-dsc-bit-per-pixel = <8>;
				qcom,mdss-dsc-block-prediction-enable;
			};
		};
	};
};
