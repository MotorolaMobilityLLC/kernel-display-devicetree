/dts-v1/;
/plugin/;

#include "holi-sde-display-cdp.dtsi"

/ {
	model = "Qualcomm Technologies, Inc. Holi CDP";
	compatible = "qcom,holi-cdp", "qcom,holi", "qcom,cdp";
	qcom,msm-id = <454 0x10000>, <472 0x10000>;
	qcom,board-id = <1 0>;
};
