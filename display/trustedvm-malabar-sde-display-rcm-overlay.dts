// SPDX-License-Identifier: BSD-3-Clause
/*
 * Copyright (c) Qualcomm Technologies, Inc. and/or its subsidiaries.
 */

/dts-v1/;
/plugin/;

#include "trustedvm-malabar-sde.dtsi"
#include "trustedvm-malabar-sde-display-rcm.dtsi"

/ {
	model = "Qualcomm Technologies, Inc. Malabar  RCM";
	compatible = "qcom,malabar-rcm", "qcom,malabar", "qcom,malabarp-rcm", "qcom,malabarp",
			"qcom,rcm";
	qcom,msm-id = <733 0x10000>, <757 0x10000>;
	qcom,board-id = <0x10015 0>;
};
