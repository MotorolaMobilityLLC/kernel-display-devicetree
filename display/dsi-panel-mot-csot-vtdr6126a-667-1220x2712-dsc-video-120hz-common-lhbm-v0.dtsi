
/* Copyright (c) 2019-2020, The Linux Foundation. All rights reserved.
 *
 * This program is free software; you can redistribute it and/or modify
 * it under the terms of the GNU General Public License version 2 and
 * only version 2 as published by the Free Software Foundation.
 *
 * This program is distributed in the hope that it will be useful,
 * but WITHOUT ANY WARRANTY; without even the implied warranty of
 * MERCHANTABILITY or FITNESS FOR A PARTICULAR PURPOSE.  See the
 * GNU General Public License for more details.
 */

&mot_csot_vtdr6126a_667_1220p_dsc_vid_120hz_v0 {
qcom,mdss-dsi-panel-local-hbm-alpha-table = <
0x0010
0x0202
0x02E3
0x0394
0x041C
0x042C
0x042C
0x042C
0x042C
0x042C
0x042C
0x042C
0x042C
0x042C
0x0430
0x0430
0x0430
0x0430
0x0430
0x0430
0x0430
0x0430
0x0430
0x0430
0x0434
0x0434
0x0434
0x0434
0x0438
0x0438
0x0438
0x0438
0x0438
0x0438
0x0438
0x0438
0x0438
0x0438
0x0438
0x0438
0x043C
0x043C
0x043C
0x043C
0x043C
0x043C
0x043C
0x043C
0x043C
0x043C
0x0440
0x0440
0x0440
0x0440
0x0444
0x0444
0x0444
0x0444
0x0444
0x0444
0x0444
0x0444
0x0444
0x0444
0x0444
0x0444
0x0444
0x0444
0x0444
0x0444
0x0444
0x0444
0x0444
0x044C
0x044C
0x0450
0x0450
0x0450
0x0450
0x0450
0x0450
0x0450
0x0450
0x0454
0x0454
0x0454
0x0454
0x0454
0x0454
0x0454
0x0454
0x0454
0x0454
0x0454
0x0454
0x045C
0x045C
0x045C
0x045C
0x045C
0x045C
0x045C
0x0460
0x0460
0x0460
0x0460
0x0460
0x0460
0x0460
0x0460
0x0460
0x0460
0x0460
0x0460
0x0460
0x0460
0x0460
0x0460
0x0468
0x0468
0x0468
0x0468
0x0468
0x0468
0x0468
0x0468
0x046C
0x046C
0x046C
0x046C
0x046C
0x046C
0x046C
0x046C
0x046C
0x046C
0x046C
0x046C
0x046C
0x046C
0x0470
0x0478
0x0478
0x0478
0x0478
0x0478
0x0478
0x0478
0x0478
0x0478
0x0478
0x047C
0x047C
0x047C
0x047C
0x047C
0x047C
0x047C
0x047C
0x047C
0x047C
0x0481
0x0481
0x0485
0x0485
0x0485
0x0485
0x0485
0x0485
0x0485
0x0485
0x0485
0x0485
0x0485
0x0485
0x0489
0x0489
0x0489
0x0489
0x0489
0x0489
0x0489
0x0489
0x0489
0x0489
0x0489
0x048D
0x0491
0x0491
0x0491
0x0491
0x0491
0x0491
0x0491
0x0491
0x0491
0x0491
0x0491
0x0491
0x0491
0x0495
0x0495
0x0495
0x0495
0x0495
0x0495
0x0495
0x0495
0x0495
0x049D
0x049D
0x04A1
0x04A1
0x04A1
0x04A1
0x04A1
0x04A1
0x04A1
0x04A1
0x04A1
0x04A1
0x04A5
0x04A5
0x04A5
0x04A5
0x04A5
0x04A5
0x04A5
0x04A5
0x04A5
0x04A5
0x04AD
0x04AD
0x04AD
0x04AD
0x04AD
0x04AD
0x04AD
0x04AD
0x04AD
0x04AD
0x04AD
0x04AD
0x04AD
0x04AD
0x04AD
0x04AD
0x04AD
0x04AD
0x04AD
0x04AD
0x04B1
0x04B1
0x04B1
0x04B1
0x04B1
0x04B1
0x04B5
0x04B5
0x04B5
0x04B5
0x04B5
0x04B5
0x04B5
0x04B5
0x04B5
0x04B5
0x04B5
0x04B5
0x04B5
0x04B5
0x04B5
0x04B5
0x04B9
0x04B9
0x04B9
0x04B9
0x04BD
0x04BD
0x04BD
0x04BD
0x04BD
0x04BD
0x04C1
0x04C1
0x04C1
0x04C1
0x04C1
0x04C1
0x04C1
0x04C1
0x04C1
0x04C1
0x04C1
0x04C1
0x04C1
0x04C1
0x04C1
0x04C5
0x04C5
0x04C9
0x04C9
0x04C9
0x04C9
0x04C9
0x04C9
0x04C9
0x04C9
0x04CD
0x04CD
0x04CD
0x04CD
0x04CD
0x04CD
0x04CD
0x04CD
0x04CD
0x04CD
0x04CD
0x04CD
0x04CD
0x04CD
0x04D5
0x04D5
0x04D5
0x04D5
0x04D5
0x04D5
0x04D5
0x04D5
0x04D5
0x04D5
0x04D5
0x04D5
0x04D9
0x04D9
0x04D9
0x04D9
0x04D9
0x04D9
0x04D9
0x04D9
0x04D9
0x04D9
0x04D9
0x04E1
0x04E1
0x04E1
0x04E1
0x04E1
0x04E1
0x04E1
0x04E1
0x04E1
0x04E1
0x04E1
0x04E5
0x04E5
0x04E5
0x04E5
0x04E5
0x04E5
0x04E5
0x04E5
0x04E5
0x04E9
0x04E9
0x04ED
0x04ED
0x04ED
0x04ED
0x04ED
0x04F1
0x04F1
0x04F1
0x04F1
0x04F1
0x04F1
0x04F1
0x04F1
0x04F1
0x04F1
0x04F5
0x04F5
0x04F5
0x04F5
0x04F5
0x04F5
0x04F5
0x04F5
0x04F9
0x04F9
0x04FD
0x04FD
0x04FD
0x04FD
0x04FD
0x04FD
0x04FD
0x04FD
0x04FD
0x04FD
0x04FD
0x04FD
0x04FD
0x04FD
0x04FD
0x0501
0x0501
0x0501
0x0501
0x0501
0x0501
0x0505
0x0505
0x0505
0x0505
0x0505
0x0505
0x0509
0x0509
0x0509
0x0509
0x0509
0x0509
0x0509
0x0509
0x0509
0x0509
0x0509
0x0509
0x0509
0x0509
0x0509
0x0509
0x050D
0x050D
0x050D
0x0511
0x0511
0x0511
0x0511
0x0511
0x0511
0x0511
0x0511
0x0511
0x0511
0x0511
0x0511
0x0511
0x0511
0x0515
0x0515
0x0515
0x0515
0x0515
0x0515
0x051D
0x051D
0x051D
0x051D
0x051D
0x051D
0x051D
0x051D
0x051D
0x051D
0x0521
0x0521
0x0521
0x0521
0x0521
0x0521
0x0521
0x0521
0x0521
0x0521
0x0521
0x0521
0x0521
0x0525
0x0525
0x0525
0x0525
0x0525
0x0525
0x0529
0x0529
0x0529
0x0529
0x0529
0x0529
0x0529
0x0529
0x0529
0x0529
0x0529
0x0529
0x0529
0x0529
0x0529
0x0529
0x052D
0x052D
0x052D
0x052D
0x0531
0x0531
0x0531
0x0531
0x0531
0x0531
0x0531
0x0531
0x0531
0x0531
0x0531
0x0531
0x0531
0x0531
0x0531
0x0531
0x0531
0x0535
0x0535
0x0539
0x0539
0x0539
0x0539
0x053D
0x053D
0x053D
0x053D
0x053D
0x053D
0x053D
0x053D
0x053D
0x053D
0x0541
0x0541
0x0541
0x0541
0x0541
0x0541
0x0541
0x0541
0x0541
0x0541
0x0545
0x0545
0x0545
0x0545
0x0545
0x0545
0x0545
0x0545
0x0545
0x0549
0x0549
0x0549
0x0549
0x0549
0x0549
0x0549
0x0549
0x0549
0x0549
0x0549
0x054D
0x054D
0x054D
0x054D
0x054D
0x0551
0x0551
0x0551
0x0551
0x0551
0x0551
0x0551
0x0551
0x0551
0x0551
0x0551
0x0551
0x0551
0x0551
0x0551
0x0555
0x0555
0x0555
0x0555
0x0559
0x0559
0x0559
0x055D
0x055D
0x055D
0x055D
0x055D
0x055D
0x055D
0x055D
0x055D
0x055D
0x055D
0x055D
0x0561
0x0561
0x0561
0x0561
0x0561
0x0561
0x0561
0x0561
0x0561
0x0561
0x0561
0x0561
0x0565
0x0565
0x0565
0x0565
0x0565
0x0565
0x0565
0x0565
0x0565
0x0565
0x0565
0x0565
0x0565
0x0569
0x0569
0x0569
0x0569
0x0569
0x0569
0x056D
0x056D
0x056D
0x056D
0x056D
0x056D
0x056D
0x056D
0x056D
0x056D
0x056D
0x056D
0x056D
0x056D
0x056D
0x056D
0x0571
0x0571
0x0571
0x0571
0x0571
0x0571
0x0575
0x0575
0x0575
0x0575
0x0575
0x0579
0x0579
0x0579
0x057D
0x057D
0x057D
0x057D
0x057D
0x057D
0x057D
0x057D
0x057D
0x057D
0x057D
0x057D
0x0582
0x0582
0x0582
0x0586
0x0586
0x0586
0x0586
0x058A
0x058A
0x058A
0x058A
0x058A
0x058A
0x058A
0x058A
0x058A
0x058A
0x058A
0x058A
0x058A
0x058A
0x058E
0x058E
0x058E
0x058E
0x058E
0x058E
0x058E
0x058E
0x058E
0x058E
0x0592
0x0592
0x0592
0x0592
0x0592
0x0592
0x0592
0x0592
0x0592
0x0592
0x0592
0x0592
0x0592
0x0592
0x0592
0x0592
0x0592
0x0596
0x0596
0x0596
0x0596
0x0596
0x0596
0x0596
0x059A
0x059A
0x059A
0x059A
0x059A
0x059A
0x059A
0x059A
0x059E
0x059E
0x059E
0x059E
0x059E
0x059E
0x059E
0x059E
0x05A2
0x05A2
0x05A2
0x05A2
0x05A2
0x05A6
0x05A6
0x05A6
0x05A6
0x05A6
0x05A6
0x05A6
0x05A6
0x05A6
0x05A6
0x05A6
0x05A6
0x05A6
0x05A6
0x05A6
0x05A6
0x05AA
0x05AA
0x05AA
0x05AA
0x05AA
0x05AE
0x05AE
0x05AE
0x05AE
0x05AE
0x05AE
0x05AE
0x05AE
0x05AE
0x05AE
0x05AE
0x05AE
0x05AE
0x05AE
0x05AE
0x05AE
0x05AE
0x05AE
0x05AE
0x05B2
0x05B2
0x05B2
0x05B6
0x05B6
0x05B6
0x05B6
0x05B6
0x05B6
0x05B6
0x05B6
0x05B6
0x05B6
0x05B6
0x05B6
0x05B6
0x05B6
0x05B6
0x05BA
0x05BA
0x05BA
0x05BA
0x05BA
0x05BE
0x05BE
0x05BE
0x05BE
0x05BE
0x05BE
0x05C2
0x05C2
0x05C2
0x05C2
0x05C2
0x05C2
0x05C2
0x05C2
0x05C2
0x05C2
0x05C2
0x05C6
0x05C6
0x05C6
0x05C6
0x05C6
0x05C6
0x05C6
0x05C6
0x05C6
0x05CA
0x05CA
0x05CA
0x05CA
0x05CA
0x05CA
0x05CA
0x05CA
0x05CA
0x05CA
0x05CA
0x05CE
0x05CE
0x05CE
0x05CE
0x05CE
0x05CE
0x05CE
0x05CE
0x05D2
0x05D2
0x05D2
0x05D2
0x05D2
0x05D2
0x05D2
0x05D2
0x05D6
0x05D6
0x05D6
0x05D6
0x05D6
0x05D6
0x05D6
0x05D6
0x05D6
0x05D6
0x05D6
0x05D6
0x05D6
0x05DA
0x05DA
0x05DA
0x05DE
0x05DE
0x05DE
0x05DE
0x05DE
0x05DE
0x05DE
0x05DE
0x05DE
0x05DE
0x05DE
0x05E2
0x05E2
0x05E2
0x05E2
0x05E2
0x05E2
0x05E2
0x05E2
0x05E2
0x05E2
0x05E2
0x05E6
0x05E6
0x05E6
0x05E6
0x05E6
0x05E6
0x05E6
0x05E6
0x05E6
0x05E6
0x05E6
0x05E6
0x05E6
0x05EA
0x05EA
0x05EA
0x05EA
0x05EA
0x05EA
0x05EA
0x05EA
0x05EA
0x05EA
0x05EA
0x05EA
0x05EA
0x05EE
0x05EE
0x05EE
0x05EE
0x05EE
0x05EE
0x05EE
0x05EE
0x05EE
0x05EE
0x05EE
0x05F2
0x05F2
0x05F2
0x05F2
0x05F2
0x05F2
0x05F2
0x05F2
0x05F2
0x05F2
0x05F2
0x05F2
0x05F6
0x05F6
0x05F6
0x05F6
0x05F6
0x05F6
0x05FA
0x05FA
0x05FA
0x05FA
0x05FA
0x05FA
0x05FA
0x05FA
0x05FA
0x05FE
0x05FE
0x05FE
0x05FE
0x0602
0x0602
0x0602
0x0602
0x0602
0x0602
0x0602
0x0602
0x0606
0x0606
0x0606
0x0606
0x0606
0x0606
0x0606
0x0606
0x0606
0x0606
0x0606
0x0606
0x0606
0x060A
0x060A
0x060A
0x060E
0x060E
0x060E
0x060E
0x060E
0x060E
0x0612
0x0612
0x0612
0x0612
0x0612
0x0612
0x0612
0x0612
0x0612
0x0612
0x0616
0x0616
0x0616
0x0616
0x0616
0x0616
0x0616
0x0616
0x061A
0x061A
0x061A
0x061A
0x061A
0x061A
0x061A
0x061A
0x061A
0x061A
0x061A
0x061A
0x061A
0x061E
0x061E
0x061E
0x061E
0x061E
0x061E
0x0622
0x0622
0x0622
0x0622
0x0622
0x0622
0x0626
0x0626
0x0626
0x0626
0x0626
0x0626
0x0626
0x0626
0x0626
0x0626
0x0626
0x062A
0x062A
0x062A
0x062A
0x062A
0x062A
0x062A
0x062A
0x062E
0x062E
0x062E
0x062E
0x062E
0x062E
0x062E
0x062E
0x062E
0x062E
0x062E
0x0632
0x0632
0x0632
0x0632
0x0632
0x0632
0x0632
0x0632
0x0632
0x0636
0x0636
0x0636
0x0636
0x063A
0x063A
0x063A
0x063A
0x063A
0x063A
0x063A
0x063A
0x063A
0x063E
0x063E
0x063E
0x063E
0x063E
0x063E
0x063E
0x063E
0x063E
0x063E
0x063E
0x0642
0x0646
0x0646
0x064A
0x064A
0x064A
0x064A
0x064A
0x064E
0x064E
0x064E
0x064E
0x064E
0x064E
0x0652
0x0656
0x0656
0x0656
0x065A
0x065A
0x065A
0x065A
0x065A
0x065E
0x065E
0x065E
0x0662
0x0662
0x0662
0x0662
0x0662
0x0662
0x0662
0x0666
0x0666
0x0666
0x066A
0x066A
0x066A
0x066E
0x066E
0x066E
0x066E
0x0672
0x0672
0x0672
0x0676
0x0676
0x0676
0x0676
0x067A
0x067A
0x067E
0x067E
0x0687
0x0687
0x0687
0x0687
0x0687
0x0687
0x068B
0x068B
0x068B
0x068B
0x068F
0x068F
0x068F
0x068F
0x068F
0x068F
0x068F
0x068F
0x0693
0x0693
0x0693
0x0693
0x0693
0x0697
0x069B
0x069B
0x069B
0x069B
0x069B
0x069F
0x069F
0x06A3
0x06A3
0x06A3
0x06A3
0x06A7
0x06A7
0x06A7
0x06A7
0x06A7
0x06AB
0x06AB
0x06AB
0x06AB
0x06AB
0x06AF
0x06B3
0x06B3
0x06B3
0x06B3
0x06B3
0x06B3
0x06B3
0x06B7
0x06B7
0x06B7
0x06B7
0x06B7
0x06B7
0x06BB
0x06BB
0x06BF
0x06BF
0x06BF
0x06BF
0x06C3
0x06C3
0x06C3
0x06C7
0x06C7
0x06CB
0x06CB
0x06CB
0x06CF
0x06CF
0x06CF
0x06D3
0x06D3
0x06D3
0x06D3
0x06D3
0x06D3
0x06D3
0x06D7
0x06D7
0x06D7
0x06D7
0x06DB
0x06DB
0x06DB
0x06DF
0x06E3
0x06E3
0x06E3
0x06E3
0x06E3
0x06E3
0x06E7
0x06E7
0x06EB
0x06EB
0x06EB
0x06EB
0x06EB
0x06EB
0x06EB
0x06EF
0x06EF
0x06EF
0x06EF
0x06EF
0x06F3
0x06F3
0x06F3
0x06F3
0x06F3
0x06F3
0x06F3
0x06F3
0x06F3
0x06F7
0x06FB
0x06FB
0x06FB
0x06FF
0x06FF
0x06FF
0x0703
0x0703
0x0703
0x0707
0x0707
0x0707
0x0707
0x0707
0x0707
0x070B
0x070B
0x070B
0x070F
0x070F
0x0713
0x0713
0x0713
0x0717
0x0717
0x0717
0x0717
0x0717
0x071B
0x071B
0x071B
0x071F
0x071F
0x071F
0x071F
0x071F
0x071F
0x0723
0x0723
0x0723
0x0723
0x0723
0x0727
0x0727
0x0727
0x072B
0x072B
0x072B
0x072B
0x072F
0x072F
0x072F
0x072F
0x072F
0x072F
0x072F
0x072F
0x072F
0x0733
0x0733
0x0733
0x0733
0x0733
0x0737
0x0737
0x0737
0x0737
0x0737
0x0737
0x0737
0x073B
0x073B
0x073F
0x073F
0x0743
0x0743
0x0743
0x0747
0x0747
0x0747
0x074B
0x074B
0x074B
0x074B
0x074B
0x074B
0x074F
0x074F
0x074F
0x0753
0x0753
0x0753
0x0753
0x0757
0x0757
0x0757
0x0757
0x0757
0x075B
0x075B
0x075B
0x075B
0x075B
0x075B
0x075F
0x075F
0x075F
0x075F
0x0763
0x0763
0x0763
0x0763
0x0763
0x0763
0x0767
0x0767
0x0767
0x076B
0x076B
0x076B
0x076B
0x076F
0x076F
0x076F
0x076F
0x0773
0x0773
0x0773
0x0773
0x0773
0x0773
0x0777
0x0777
0x0777
0x0777
0x077B
0x077B
0x077B
0x077B
0x077F
0x077F
0x077F
0x0784
0x0784
0x0784
0x0784
0x0788
0x0788
0x0788
0x0788
0x0788
0x0788
0x078C
0x078C
0x078C
0x078C
0x0790
0x0790
0x0790
0x0790
0x0790
0x0790
0x0794
0x0794
0x0794
0x0794
0x0794
0x0794
0x0794
0x0798
0x0798
0x0798
0x0798
0x079C
0x079C
0x079C
0x07A0
0x07A0
0x07A4
0x07A4
0x07A4
0x07A4
0x07A4
0x07A8
0x07A8
0x07A8
0x07A8
0x07AC
0x07AC
0x07AC
0x07AC
0x07AC
0x07AC
0x07AC
0x07B0
0x07B0
0x07B0
0x07B4
0x07B4
0x07B4
0x07B8
0x07B8
0x07B8
0x07B8
0x07B8
0x07B8
0x07B8
0x07BC
0x07BC
0x07C0
0x07C0
0x07C0
0x07C0
0x07C0
0x07C0
0x07C0
0x07C4
0x07C4
0x07C4
0x07C4
0x07C4
0x07C8
0x07C8
0x07C8
0x07C8
0x07CC
0x07CC
0x07CC
0x07CC
0x07D0
0x07D0
0x07D0
0x07D0
0x07D0
0x07D0
0x07D0
0x07D0
0x07D4
0x07D4
0x07D8
0x07D8
0x07D8
0x07D8
0x07D8
0x07DC
0x07E0
0x07E0
0x07E0
0x07E0
0x07E0
0x07E0
0x07E4
0x07E4
0x07E4
0x07E4
0x07E4
0x07E8
0x07E8
0x07E8
0x07EC
0x07EC
0x07EC
0x07EC
0x07EC
0x07EC
0x07EC
0x07EC
0x07EC
0x07F0
0x07F0
0x07F0
0x07F0
0x07F0
0x07F4
0x07F4
0x07F4
0x07F4
0x07F4
0x07F4
0x07F4
0x07F4
0x07F8
0x07F8
0x07F8
0x07F8
0x07F8
0x07F8
0x07F8
0x07FC
0x07FC
0x07FC
0x07FC
0x0800
0x0800
0x0800
0x0804
0x0804
0x0808
0x0808
0x0808
0x0808
0x0808
0x080C
0x080C
0x080C
0x080C
0x080C
0x0810
0x0810
0x0810
0x0814
0x0814
0x0818
0x0818
0x0818
0x0818
0x081C
0x081C
0x081C
0x081C
0x081C
0x081C
0x0820
0x0820
0x0820
0x0820
0x0824
0x0828
0x082C
0x082C
0x082C
0x082C
0x082C
0x082C
0x082C
0x082C
0x082C
0x082C
0x0830
0x0830
0x0830
0x0834
0x0834
0x0834
0x0834
0x0838
0x0838
0x0838
0x0838
0x0838
0x0838
0x083C
0x083C
0x083C
0x0840
0x0840
0x0840
0x0840
0x0840
0x0844
0x0844
0x0844
0x0844
0x0844
0x0848
0x0848
0x0848
0x084C
0x084C
0x084C
0x084C
0x084C
0x084C
0x084C
0x0850
0x0850
0x0850
0x0850
0x0854
0x0854
0x0854
0x0854
0x0858
0x0858
0x0858
0x0858
0x0858
0x0858
0x085C
0x085C
0x085C
0x085C
0x0860
0x0860
0x0860
0x0860
0x0864
0x0868
0x0868
0x0868
0x0868
0x0868
0x0868
0x086C
0x086C
0x086C
0x0870
0x0870
0x0870
0x0870
0x0870
0x0870
0x0870
0x0870
0x0874
0x0874
0x0874
0x0874
0x0874
0x0874
0x0878
0x0878
0x0878
0x0878
0x0878
0x0878
0x087C
0x087C
0x0881
0x0881
0x0881
0x0881
0x0881
0x0881
0x0881
0x0885
0x0889
0x0889
0x0889
0x0889
0x0889
0x0889
0x0889
0x0889
0x088D
0x088D
0x088D
0x088D
0x0899
0x089D
0x089D
0x089D
0x089D
0x089D
0x089D
0x089D
0x089D
0x08A1
0x08A1
0x08A1
0x08A1
0x08A1
0x08A1
0x08A5
0x08A5
0x08A5
0x08A9
0x08A9
0x08A9
0x08A9
0x08A9
0x08A9
0x08AD
0x08AD
0x08B1
0x08B1
0x08B5
0x08B5
0x08B9
0x08B9
0x08B9
0x08B9
0x08BD
0x08BD
0x08BD
0x08BD
0x08C1
0x08C1
0x08C1
0x08C1
0x08C5
0x08C5
0x08C9
0x08C9
0x08C9
0x08C9
0x08C9
0x08C9
0x08CD
0x08CD
0x08D1
0x08D1
0x08D1
0x08D5
0x08D5
0x08D5
0x08D5
0x08D9
0x08DD
0x08DD
0x08E1
0x08E1
0x08E1
0x08E1
0x08E5
0x08E5
0x08E9
0x08E9
0x08E9
0x08E9
0x08E9
0x08E9
0x08ED
0x08ED
0x08ED
0x08ED
0x08ED
0x08ED
0x08F1
0x08F1
0x08F1
0x08F5
0x08F5
0x08F5
0x08F5
0x08F9
0x08F9
0x08F9
0x08F9
0x08F9
0x08F9
0x08F9
0x08F9
0x08FD
0x08FD
0x0901
0x0901
0x0905
0x0905
0x0905
0x0909
0x0909
0x0909
0x090D
0x090D
0x090D
0x0911
0x0911
0x0911
0x0915
0x0915
0x0915
0x0915
0x0919
0x0919
0x0919
0x091D
0x091D
0x0921
0x0921
0x0921
0x0921
0x0925
0x0925
0x0925
0x0929
0x0929
0x092D
0x092D
0x092D
0x092D
0x0931
0x0935
0x0935
0x0935
0x0935
0x0935
0x0935
0x0935
0x0939
0x0939
0x093D
0x093D
0x093D
0x093D
0x093D
0x093D
0x0941
0x0941
0x0941
0x0941
0x0945
0x0945
0x0945
0x0945
0x0949
0x094D
0x094D
0x094D
0x094D
0x0951
0x0951
0x0951
0x0955
0x0955
0x0955
0x0959
0x0959
0x0959
0x095D
0x095D
0x095D
0x095D
0x095D
0x095D
0x0961
0x0961
0x0961
0x0961
0x0965
0x0965
0x0965
0x0965
0x0969
0x0969
0x0969
0x096D
0x096D
0x096D
0x096D
0x096D
0x096D
0x096D
0x0971
0x0975
0x0975
0x0975
0x0975
0x0979
0x0979
0x0979
0x0979
0x0979
0x097D
0x097D
0x097D
0x097D
0x0982
0x0986
0x0986
0x098A
0x098A
0x098A
0x098A
0x098E
0x098E
0x098E
0x098E
0x0992
0x0992
0x0996
0x0996
0x0996
0x099A
0x099A
0x099A
0x099A
0x099A
0x099A
0x099E
0x099E
0x099E
0x09A2
0x09A2
0x09A2
0x09A2
0x09A2
0x09A6
0x09A6
0x09A6
0x09A6
0x09A6
0x09AA
0x09AA
0x09AA
0x09AE
0x09AE
0x09AE
0x09AE
0x09AE
0x09B2
0x09B2
0x09B6
0x09B6
0x09B6
0x09BA
0x09BA
0x09BA
0x09BE
0x09BE
0x09BE
0x09C2
0x09C2
0x09C2
0x09C2
0x09C2
0x09C2
0x09C2
0x09C6
0x09C6
0x09CA
0x09CA
0x09CA
0x09CA
0x09CE
0x09CE
0x09CE
0x09D2
0x09D2
0x09D2
0x09D2
0x09D6
0x09D6
0x09D6
0x09D6
0x09D6
0x09D6
0x09DA
0x09DA
0x09DA
0x09DE
0x09DE
0x09DE
0x09DE
0x09DE
0x09DE
0x09DE
0x09E2
0x09E2
0x09E2
0x09E2
0x09E2
0x09E2
0x09E6
0x09E6
0x09E6
0x09E6
0x09EA
0x09EA
0x09EA
0x09EA
0x09EE
0x09EE
0x09EE
0x09EE
0x09EE
0x09EE
0x09F2
0x09F2
0x09F2
0x09F6
0x09F6
0x09F6
0x09F6
0x09FA
0x09FA
0x09FA
0x09FA
0x09FA
0x09FE
0x09FE
0x09FE
0x0A02
0x0A06
0x0A0A
0x0A0A
0x0A0A
0x0A0A
0x0A0A
0x0A0E
0x0A0E
0x0A0E
0x0A12
0x0A12
0x0A12
0x0A12
0x0A16
0x0A16
0x0A16
0x0A1A
0x0A1A
0x0A1A
0x0A1A
0x0A1A
0x0A1A
0x0A1A
0x0A1E
0x0A1E
0x0A22
0x0A22
0x0A22
0x0A22
0x0A26
0x0A26
0x0A26
0x0A2A
0x0A2A
0x0A2A
0x0A2A
0x0A2A
0x0A2A
0x0A2E
0x0A2E
0x0A2E
0x0A32
0x0A32
0x0A32
0x0A32
0x0A32
0x0A32
0x0A32
0x0A36
0x0A36
0x0A36
0x0A36
0x0A3A
0x0A3A
0x0A3A
0x0A3E
0x0A3E
0x0A3E
0x0A3E
0x0A42
0x0A42
0x0A42
0x0A42
0x0A46
0x0A46
0x0A46
0x0A46
0x0A46
0x0A4A
0x0A4A
0x0A4A
0x0A4A
0x0A4A
0x0A4A
0x0A4E
0x0A56
0x0A56
0x0A5A
0x0A5A
0x0A5A
0x0A5A
0x0A5A
0x0A5E
0x0A5E
0x0A5E
0x0A5E
0x0A5E
0x0A5E
0x0A5E
0x0A62
0x0A62
0x0A66
0x0A66
0x0A66
0x0A66
0x0A66
0x0A66
0x0A6A
0x0A6E
0x0A6E
0x0A6E
0x0A6E
0x0A72
0x0A72
0x0A72
0x0A72
0x0A76
0x0A76
0x0A76
0x0A76
0x0A76
0x0A7A
0x0A7A
0x0A7E
0x0A7E
0x0A7E
0x0A7E
0x0A7E
0x0A7E
0x0A83
0x0A83
0x0A83
0x0A83
0x0A87
0x0A87
0x0A8B
0x0A8B
0x0A8B
0x0A8B
0x0A8F
0x0A8F
0x0A8F
0x0A8F
0x0A8F
0x0A93
0x0A93
0x0A93
0x0A93
0x0A97
0x0A97
0x0A97
0x0A97
0x0A97
0x0A97
0x0A97
0x0A9B
0x0A9B
0x0A9B
0x0A9B
0x0A9F
0x0A9F
0x0AA3
0x0AA3
0x0AA3
0x0AAB
0x0AAB
0x0AAB
0x0AAF
0x0AAF
0x0AAF
0x0AAF
0x0AAF
0x0AB3
0x0AB3
0x0AB7
0x0AB7
0x0AB7
0x0AB7
0x0ABB
0x0ABB
0x0ABB
0x0ABB
0x0ABB
0x0ABB
0x0ABB
0x0ABF
0x0ABF
0x0ABF
0x0ABF
0x0ABF
0x0ABF
0x0AC3
0x0AC3
0x0AC3
0x0AC3
0x0AC3
0x0AC3
0x0AC3
0x0AC7
0x0AC7
0x0ACB
0x0ACB
0x0ACB
0x0ACB
0x0ACB
0x0ACF
0x0ACF
0x0ACF
0x0ACF
0x0ACF
0x0ACF
0x0ACF
0x0ACF
0x0ACF
0x0ACF
0x0ACF
0x0ACF
0x0AD3
0x0AD3
0x0AD3
0x0AD3
0x0AD7
0x0AD7
0x0AD7
0x0AD7
0x0AD7
0x0AD7
0x0ADB
0x0ADB
0x0ADB
0x0ADB
0x0ADB
0x0ADF
0x0ADF
0x0ADF
0x0AE3
0x0AE3
0x0AE3
0x0AE3
0x0AE3
0x0AE7
0x0AE7
0x0AE7
0x0AE7
0x0AE7
0x0AE7
0x0AE7
0x0AEB
0x0AEF
0x0AEF
0x0AEF
0x0AEF
0x0AEF
0x0AF3
0x0AF3
0x0AF3
0x0AF3
0x0AF7
0x0AF7
0x0AF7
0x0AFB
0x0AFB
0x0AFB
0x0AFB
0x0AFB
0x0AFF
0x0AFF
0x0AFF
0x0AFF
0x0AFF
0x0B03
0x0B03
0x0B07
0x0B07
0x0B0B
0x0B0B
0x0B0B
0x0B0B
0x0B0B
0x0B0F
0x0B0F
0x0B0F
0x0B13
0x0B13
0x0B13
0x0B13
0x0B13
0x0B13
0x0B17
0x0B17
0x0B1B
0x0B1B
0x0B1B
0x0B1B
0x0B1B
0x0B1F
0x0B1F
0x0B1F
0x0B1F
0x0B1F
0x0B27
0x0B27
0x0B27
0x0B2B
0x0B2B
0x0B2B
0x0B2F
0x0B2F
0x0B2F
0x0B2F
0x0B2F
0x0B33
0x0B33
0x0B33
0x0B37
0x0B37
0x0B37
0x0B37
0x0B37
0x0B3B
0x0B3B
0x0B3B
0x0B3B
0x0B3F
0x0B3F
0x0B3F
0x0B3F
0x0B3F
0x0B3F
0x0B3F
0x0B3F
0x0B43
0x0B43
0x0B43
0x0B43
0x0B43
0x0B47
0x0B47
0x0B47
0x0B47
0x0B47
0x0B47
0x0B4B
0x0B4F
0x0B4F
0x0B4F
0x0B4F
0x0B4F
0x0B53
0x0B53
0x0B53
0x0B53
0x0B57
0x0B57
0x0B5B
0x0B5B
0x0B5B
0x0B5F
0x0B5F
0x0B5F
0x0B5F
0x0B5F
0x0B5F
0x0B5F
0x0B63
0x0B63
0x0B63
0x0B63
0x0B67
0x0B6B
0x0B6B
0x0B6B
0x0B6B
0x0B6B
0x0B6F
0x0B6F
0x0B6F
0x0B6F
0x0B6F
0x0B6F
0x0B6F
0x0B73
0x0B73
0x0B73
0x0B77
0x0B77
0x0B77
0x0B77
0x0B7B
0x0B7B
0x0B7B
0x0B7B
0x0B7B
0x0B7F
0x0B7F
0x0B7F
0x0B7F
0x0B7F
0x0B7F
0x0B84
0x0B84
0x0B84
0x0B88
0x0B8C
0x0B8C
0x0B8C
0x0B8C
0x0B8C
0x0B8C
0x0B90
0x0B90
0x0B90
0x0B90
0x0B90
0x0B94
0x0B94
0x0B94
0x0B98
0x0B98
0x0B98
0x0B98
0x0B98
0x0B98
0x0B9C
0x0B9C
0x0B9C
0x0B9C
0x0B9C
0x0B9C
0x0BA0
0x0BA0
0x0BA0
0x0BA0
0x0BA0
0x0BA0
0x0BA4
0x0BA4
0x0BA4
0x0BA4
0x0BA4
0x0BA8
0x0BA8
0x0BA8
0x0BA8
0x0BA8
0x0BAC
0x0BAC
0x0BB0
0x0BB4
0x0BBC
0x0BBC
0x0BC0
0x0BC0
0x0BC0
0x0BC0
0x0BC0
0x0BC4
0x0BC4
0x0BC4
0x0BC4
0x0BC4
0x0BC4
0x0BC8
0x0BC8
0x0BC8
0x0BC8
0x0BCC
0x0BCC
0x0BCC
0x0BCC
0x0BD0
0x0BD0
0x0BD0
0x0BD0
0x0BD4
0x0BD4
0x0BD4
0x0BD4
0x0BD4
0x0BD8
0x0BD8
0x0BD8
0x0BDC
0x0BE0
0x0BE0
0x0BE0
0x0BE4
0x0BE4
0x0BE4
0x0BE8
0x0BE8
0x0BE8
0x0BEC
0x0BEC
0x0BF0
0x0BF0
0x0BF0
0x0BF0
0x0BF4
0x0BF4
0x0BF4
0x0BF8
0x0BF8
0x0BF8
0x0BF8
0x0BF8
0x0BFC
0x0BFC
0x0BFC
0x0C00
0x0C00
0x0C00
0x0C04
0x0C04
0x0C08
0x0C08
0x0C08
0x0C08
0x0C0C
0x0C0C
0x0C0C
0x0C10
0x0C14
0x0C14
0x0C14
0x0C14
0x0C18
0x0C18
0x0C1C
0x0C1C
0x0C1C
0x0C20
0x0C20
0x0C20
0x0C24
0x0C24
0x0C24
0x0C24
0x0C28
0x0C28
0x0C28
0x0C28
0x0C2C
0x0C2C
0x0C2C
0x0C2C
0x0C30
0x0C30
0x0C34
0x0C34
0x0C34
0x0C38
0x0C38
0x0C3C
0x0C3C
0x0C3C
0x0C40
0x0C40
0x0C40
0x0C44
0x0C44
0x0C44
0x0C48
0x0C48
0x0C48
0x0C4C
0x0C4C
0x0C4C
0x0C50
0x0C50
0x0C50
0x0C50
0x0C54
0x0C58
0x0C58
0x0C58
0x0C58
0x0C58
0x0C5C
0x0C5C
0x0C5C
0x0C60
0x0C60
0x0C60
0x0C60
0x0C64
0x0C64
0x0C64
0x0C64
0x0C64
0x0C64
0x0C68
0x0C68
0x0C6C
0x0C6C
0x0C6C
0x0C70
0x0C70
0x0C70
0x0C74
0x0C74
0x0C74
0x0C78
0x0C78
0x0C78
0x0C7C
0x0C7C
0x0C81
0x0C81
0x0C81
0x0C85
0x0C85
0x0C85
0x0C85
0x0C85
0x0C85
0x0C89
0x0C89
0x0C89
0x0C8D
0x0C8D
0x0C8D
0x0C91
0x0C91
0x0C91
0x0C91
0x0C95
0x0C95
0x0C95
0x0C95
0x0C95
0x0C95
0x0C95
0x0C95
0x0C95
0x0C95
0x0C99
0x0C99
0x0C99
0x0C99
0x0C99
0x0C9D
0x0C9D
0x0CA1
0x0CA1
0x0CA1
0x0CA5
0x0CA5
0x0CA5
0x0CA9
0x0CA9
0x0CA9
0x0CA9
0x0CAD
0x0CAD
0x0CAD
0x0CB1
0x0CB1
0x0CB1
0x0CB1
0x0CB1
0x0CB5
0x0CB5
0x0CB5
0x0CB5
0x0CB9
0x0CB9
0x0CB9
0x0CBD
0x0CBD
0x0CBD
0x0CBD
0x0CBD
0x0CBD
0x0CC1
0x0CC1
0x0CC1
0x0CC5
0x0CC5
0x0CC5
0x0CC5
0x0CC5
0x0CC5
0x0CC9
0x0CC9
0x0CC9
0x0CC9
0x0CC9
0x0CCD
0x0CD1
0x0CD1
0x0CD1
0x0CD1
0x0CD1
0x0CD5
0x0CD5
0x0CDD
0x0CDD
0x0CDD
0x0CDD
0x0CE1
0x0CE1
0x0CE1
0x0CE1
0x0CE5
0x0CE5
0x0CE9
0x0CE9
0x0CE9
0x0CED
0x0CED
0x0CED
0x0CED
0x0CED
0x0CF1
0x0CF1
0x0CF1
0x0CF5
0x0CF5
0x0CF5
0x0CF5
0x0CF5
0x0CF9
0x0CF9
0x0CF9
0x0CFD
0x0CFD
0x0D01
0x0D01
0x0D05
0x0D05
0x0D05
0x0D09
0x0D0D
0x0D0D
0x0D0D
0x0D11
0x0D11
0x0D11
0x0D11
0x0D15
0x0D15
0x0D15
0x0D15
0x0D19
0x0D19
0x0D19
0x0D19
0x0D19
0x0D1D
0x0D1D
0x0D1D
0x0D1D
0x0D1D
0x0D21
0x0D21
0x0D21
0x0D21
0x0D25
0x0D25
0x0D29
0x0D29
0x0D2D
0x0D2D
0x0D2D
0x0D2D
0x0D31
0x0D31
0x0D35
0x0D35
0x0D35
0x0D39
0x0D39
0x0D3D
0x0D3D
0x0D3D
0x0D3D
0x0D3D
0x0D41
0x0D41
0x0D45
0x0D45
0x0D45
0x0D45
0x0D45
0x0D45
0x0D45
0x0D49
0x0D49
0x0D49
0x0D49
0x0D49
0x0D4D
0x0D4D
0x0D4D
0x0D4D
0x0D4D
0x0D4D
0x0D51
0x0D51
0x0D51
0x0D51
0x0D51
0x0D55
0x0D55
0x0D55
0x0D59
0x0D59
0x0D59
0x0D59
0x0D5D
0x0D5D
0x0D5D
0x0D5D
0x0D5D
0x0D61
0x0D61
0x0D61
0x0D61
0x0D65
0x0D65
0x0D69
0x0D69
0x0D69
0x0D69
0x0D69
0x0D69
0x0D69
0x0D6D
0x0D6D
0x0D6D
0x0D6D
0x0D71
0x0D71
0x0D75
0x0D75
0x0D75
0x0D75
0x0D79
0x0D79
0x0D79
0x0D7D
0x0D7D
0x0D7D
0x0D82
0x0D82
0x0D86
0x0D86
0x0D8A
0x0D8A
0x0D8A
0x0D8A
0x0D8E
0x0D8E
0x0D8E
0x0D8E
0x0D8E
0x0D92
0x0D96
0x0D96
0x0D96
0x0D96
0x0D9A
0x0D9A
0x0D9A
0x0D9A
0x0D9E
0x0D9E
0x0D9E
0x0D9E
0x0D9E
0x0DA2
0x0DA2
0x0DA6
0x0DA6
0x0DA6
0x0DA6
0x0DA6
0x0DAA
0x0DAA
0x0DAA
0x0DAE
0x0DAE
0x0DAE
0x0DAE
0x0DB2
0x0DB2
0x0DB2
0x0DB2
0x0DB6
0x0DB6
0x0DB6
0x0DB6
0x0DB6
0x0DBA
0x0DBA
0x0DBA
0x0DBE
0x0DBE
0x0DBE
0x0DBE
0x0DBE
0x0DBE
0x0DBE
0x0DBE
0x0DBE
0x0DC2
0x0DC2
0x0DC6
0x0DC6
0x0DC6
0x0DCA
0x0DCA
0x0DCA
0x0DCA
0x0DCA
0x0DCA
0x0DCE
0x0DCE
0x0DCE
0x0DD2
0x0DD2
0x0DD2
0x0DD6
0x0DD6
0x0DD6
0x0DD6
0x0DDA
0x0DDA
0x0DDA
0x0DDA
0x0DDA
0x0DDA
0x0DDE
0x0DDE
0x0DE2
0x0DE2
0x0DE2
0x0DE2
0x0DE2
0x0DE6
0x0DE6
0x0DE6
0x0DEA
0x0DEA
0x0DEA
0x0DEA
0x0DEA
0x0DEA
0x0DEE
0x0DEE
0x0DF2
0x0DF2
0x0DF2
0x0DF2
0x0DF6
0x0DF6
0x0DF6
0x0DF6
0x0DFA
0x0DFA
0x0DFA
0x0DFA
0x0DFA
0x0DFA
0x0DFE
0x0DFE
0x0DFE
0x0DFE
0x0DFE
0x0E02
0x0E06
0x0E06
0x0E06
0x0E06
0x0E06
0x0E0A
0x0E0E
0x0E0E
0x0E0E
0x0E0E
0x0E0E
0x0E0E
0x0E12
0x0E12
0x0E12
0x0E12
0x0E12
0x0E16
0x0E16
0x0E16
0x0E1A
0x0E1A
0x0E1A
0x0E1E
0x0E1E
0x0E1E
0x0E1E
0x0E1E
0x0E1E
0x0E22
0x0E22
0x0E26
0x0E26
0x0E26
0x0E26
0x0E26
0x0E2A
0x0E2A
0x0E2A
0x0E2A
0x0E2A
0x0E2E
0x0E2E
0x0E2E
0x0E2E
0x0E2E
0x0E2E
0x0E32
0x0E32
0x0E36
0x0E36
0x0E36
0x0E36
0x0E36
0x0E3A
0x0E3A
0x0E3A
0x0E3E
0x0E3E
0x0E3E
0x0E3E
0x0E3E
0x0E42
0x0E42
0x0E42
0x0E46
0x0E46
0x0E46
0x0E46
0x0E4A
0x0E4A
0x0E4A
0x0E4E
0x0E4E
0x0E4E
0x0E52
0x0E52
0x0E52
0x0E52
0x0E56
0x0E56
0x0E56
0x0E56
0x0E56
0x0E56
0x0E5A
0x0E5A
0x0E5E
0x0E5E
0x0E5E
0x0E62
0x0E62
0x0E62
0x0E66
0x0E66
0x0E66
0x0E66
0x0E66
0x0E6E
0x0E6E
0x0E6E
0x0E6E
0x0E6E
0x0E72
0x0E72
0x0E72
0x0E72
0x0E76
0x0E76
0x0E76
0x0E76
0x0E76
0x0E76
0x0E7A
0x0E7A
0x0E7A
0x0E7A
0x0E7A
0x0E7E
0x0E7E
0x0E7E
0x0E83
0x0E83
0x0E87
0x0E87
0x0E8B
0x0E8B
0x0E8B
0x0E8B
0x0E8B
0x0E8F
0x0E8F
0x0E8F
0x0E8F
0x0E93
0x0E93
0x0E93
0x0E97
0x0E97
0x0E97
0x0E97
0x0E97
0x0E97
0x0E97
0x0E9B
0x0E9B
0x0E9B
0x0E9B
0x0E9F
0x0E9F
0x0E9F
0x0EA3
0x0EA3
0x0EA3
0x0EA7
0x0EA7
0x0EA7
0x0EAB
0x0EAB
0x0EAB
0x0EAF
0x0EAF
0x0EAF
0x0EB3
0x0EB3
0x0EB3
0x0EB3
0x0EB3
0x0EB3
0x0EB3
0x0EB7
0x0EB7
0x0EB7
0x0EB7
0x0EB7
0x0EBB
0x0EBB
0x0EBB
0x0EBB
0x0EBF
0x0EBF
0x0EBF
0x0EBF
0x0EBF
0x0EBF
0x0EC3
0x0EC3
0x0EC7
0x0EC7
0x0EC7
0x0ECB
0x0ECB
0x0ECF
0x0ECF
0x0ECF
0x0ECF
0x0ECF
0x0ED3
0x0ED3
0x0ED3
0x0ED3
0x0ED3
0x0ED3
0x0ED3
0x0ED7
0x0ED7
0x0ED7
0x0ED7
0x0EDB
0x0EDB
0x0EDB
0x0EDF
0x0EDF
0x0EDF
0x0EDF
0x0EDF
0x0EE3
0x0EE3
0x0EE7
0x0EE7
0x0EEB
0x0EEB
0x0EEB
0x0EEB
0x0EEB
0x0EEF
0x0EEF
0x0EEF
0x0EEF
0x0EEF
0x0EF3
0x0EF3
0x0EF3
0x0EF3
0x0EF3
0x0EF7
0x0EF7
0x0EF7
0x0EF7
0x0EFB
0x0EFB
0x0EFB
0x0EFB
0x0EFB
0x0EFF
0x0EFF
0x0EFF
0x0EFF
0x0F03
0x0F03
0x0F03
0x0F07
0x0F07
0x0F07
0x0F07
0x0F0B
0x0F0B
0x0F0B
0x0F0B
0x0F0B
0x0F0B
0x0F0F
0x0F13
0x0F13
0x0F13
0x0F13
0x0F13
0x0F17
0x0F17
0x0F17
0x0F17
0x0F17
0x0F17
0x0F1B
0x0F1B
0x0F1B
0x0F1B
0x0F1F
0x0F1F
0x0F1F
0x0F1F
0x0F1F
0x0F1F
0x0F1F
0x0F1F
0x0F23
0x0F23
0x0F23
0x0F23
0x0F23
0x0F23
0x0F27
0x0F27
0x0F27
0x0F27
0x0F27
0x0F27
0x0F27
0x0F2B
0x0F2B
0x0F2B
0x0F2B
0x0F2B
0x0F2B
0x0F2B
0x0F2B
0x0F2F
0x0F2F
0x0F2F
0x0F33
0x0F33
0x0F33
0x0F33
0x0F33
0x0F3B
0x0F3B
0x0F3B
0x0F3F
0x0F3F
0x0F43
0x0F43
0x0F43
0x0F43
0x0F47
0x0F47
0x0F47
0x0F47
0x0F47
0x0F4B
0x0F4B
0x0F4B
0x0F4B
0x0F4B
0x0F4F
0x0F4F
0x0F4F
0x0F4F
0x0F4F
0x0F53
0x0F53
0x0F53
0x0F57
0x0F57
0x0F57
0x0F57
0x0F57
0x0F5B
0x0F5B
0x0F5B
0x0F5B
0x0F5F
0x0F5F
0x0F5F
0x0F5F
0x0F5F
0x0F63
0x0F63
0x0F67
0x0F67
0x0F67
0x0F67
0x0F67
0x0F67
0x0F6B
0x0F6B
0x0F6B
0x0F6F
0x0F6F
0x0F6F
0x0F73
0x0F73
0x0F73
0x0F73
0x0F77
0x0F77
0x0F77
0x0F77
0x0F77
0x0F7B
0x0F7B
0x0F7B
0x0F7B
0x0F7B
0x0F7B
0x0F7F
0x0F7F
0x0F7F
0x0F7F
0x0F7F
0x0F84
0x0F84
0x0F88
0x0F88
0x0F88
0x0F8C
0x0F8C
0x0F8C
0x0F90
0x0F90
0x0F90
0x0F94
0x0F94
0x0F94
0x0F94
0x0F94
0x0F94
0x0F94
0x0F98
0x0F98
0x0F98
0x0F98
0x0F9C
0x0F9C
0x0F9C
0x0F9C
0x0F9C
0x0F9C
0x0F9C
0x0FA0
0x0FA0
0x0FA0
0x0FA0
0x0FA4
0x0FA8
0x0FA8
0x0FA8
0x0FA8
0x0FAC
0x0FAC
0x0FAC
0x0FAC
0x0FB0
0x0FB0
0x0FB0
0x0FB4
0x0FB4
0x0FB4
0x0FB4
0x0FB4
0x0FB4
0x0FB8
0x0FB8
0x0FB8
0x0FB8
0x0FB8
0x0FBC
0x0FBC
0x0FBC
0x0FBC
0x0FBC
0x0FC0
0x0FC0
0x0FC4
0x0FC4
0x0FC4
0x0FC4
0x0FC8
0x0FC8
0x0FC8
0x0FCC
0x0FCC
0x0FCC
0x0FD0
0x0FD0
0x0FD0
0x0FD0
0x0FD0
0x0FD0
0x0FD4
0x0FD4
0x0FD4
0x0FD4
0x0FD4
0x0FD4
0x0FD4
0x0FD4
0x0FD8
0x0FD8
0x0FD8
0x0FD8
0x0FD8
0x0FD8
0x0FDC
0x0FDC
0x0FDC
0x0FDC
0x0FDC
0x0FE0
0x0FE0
0x0FE0
0x0FE8
>;
};
