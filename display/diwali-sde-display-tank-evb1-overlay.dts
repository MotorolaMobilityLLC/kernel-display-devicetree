/dts-v1/;
/plugin/;

#include "diwali-sde-display-tank-common.dtsi"

/ {
	model = "tank";
	compatible = "qcom,diwali-qrd", "qcom,diwali", "qcom,qrd", "moto,tank";
	qcom,msm-id = <506 0x10000>, <547 0x10000>, <564 0x10000>;
	qcom,board-id = <0x44 0x9100>;
};
