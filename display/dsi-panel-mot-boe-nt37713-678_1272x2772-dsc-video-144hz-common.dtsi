/* Copyright (c) 2019-2021, The Linux Foundation. All rights reserved.
 *
 * This program is free software; you can redistribute it and/or modify
 * it under the terms of the GNU General Public License version 2 and
 * only version 2 as published by the Free Software Foundation.
 *
 * This program is distributed in the hope that it will be useful,
 * but WITHOUT ANY WARRANTY; without even the implied warranty of
 * MERCHANTABILITY or FITNESS FOR A PARTICULAR PURPOSE.  See the
 * GNU General Public License for more details.
 */
&mdss_mdp {
	mot_boe_nt37713_678_1272x2772_dsc_vid: qcom,mdss_dsi_mot_boe_nt37713_678_1272x2772_dsc_vid {
		qcom,mdss-dsi-panel-name = "mipi_mot_vid_boe_1272p_dsc_678_144hz";
		qcom,mdss-dsi-panel-supplier = "boe";
		qcom,mdss-dsi-panel-type = "dsi_video_mode";
		qcom,mdss-dsi-panel-physical-type = "oled";
		qcom,dsi-ctrl-num = <0>;
		qcom,dsi-phy-num = <0>;
		qcom,mdss-dsi-virtual-channel-id = <0>;
		qcom,mdss-dsi-stream = <0>;
		qcom,mdss-pan-physical-width-dimension = <72>;
		qcom,mdss-pan-physical-height-dimension = <157>;
		qcom,mdss-dsi-bpp = <30>;
		qcom,mdss-dsi-underflow-color = <0xff>;
		qcom,mdss-dsi-border-color = <0>;

		qcom,mdss-dsi-traffic-mode = "non_burst_sync_event";
		qcom,mdss-dsi-bllp-eof-power-mode;
		qcom,mdss-dsi-bllp-power-mode;
		qcom,mdss-dsi-lp11-init;
		qcom,mdss-dsi-lane-0-state;
		qcom,mdss-dsi-lane-1-state;
		qcom,mdss-dsi-lane-2-state;
		qcom,mdss-dsi-lane-3-state;
		qcom,mdss-dsi-dma-trigger = "trigger_sw";
		qcom,mdss-dsi-mdp-trigger = "none";
		qcom,mdss-dsi-reset-sequence = <1 1>, <0 2>, <1 20>;

		qcom,mdss-dsi-wr-mem-start = <0x2c>;
		qcom,mdss-dsi-wr-mem-continue = <0x3c>;

		qcom,mdss-dsi-dc-off-command = [
				39 00 00 40 00 00 02 6F 01
				39 00 00 00 00 00 02 8B 00];
		qcom,mdss-dsi-dc-off-command-state = "dsi_hs_mode";
		qcom,mdss-dsi-dc-on-command = [
				39 00 00 40 00 00 02 6F 01
				39 00 00 00 00 00 02 8B 01];
		qcom,mdss-dsi-dc-on-command-state = "dsi_hs_mode";

		qcom,mdss-dsi-hbm-on-command = [
				39 00 00 00 00 00 03 51 3F FC];
		qcom,mdss-dsi-hbm-off-command = [
				39 00 00 40 00 00 06 F0 55 AA 52 08 02
				39 00 00 40 00 00 02 6F 02
				39 00 00 40 00 00 02 D2 20
				39 00 00 40 00 00 02 87 00];

		qcom,mdss-dsi-hbm-fod;
		qcom,mdss-dsi-hbm-fod-on-command = [
				39 00 00 40 00 00 06 F0 55 AA 52 08 02
				39 00 00 40 00 00 02 6F 02
				39 00 00 40 00 00 02 D2 21
				39 00 00 40 00 00 02 6F 01
				39 00 00 40 00 00 02 8B 01
				39 00 00 00 00 00 02 87 25];

		qcom,mdss-dsi-panel-lhbm-wait-fps-valid;
		qcom,mdss-dsi-panel-local-hbm-wait-fps-count = <30>;
		qcom,mdss-dsi-panel-local-hbm-wait-fps-interval = <1>;
		qcom,mdss-dsi-panel-lhbm-not-allowed-fps-list = <60 90 144>;

		qcom,mdss-dsi-panel-lhbm-wait-bl-valid;
		qcom,mdss-dsi-panel-local-hbm-wait-bl-count = <30>;
		qcom,mdss-dsi-panel-local-hbm-wait-bl-interval = <1>;

		qcom,mdss-dsi-panel-lhbm-with-dc;

		qcom,mdss-dsi-display-timings {
			timing@0 {
				cell-index = <0>;
				qcom,mdss-dsi-video-mode;
				qcom,mdss-dsi-cmd-mode;
				qcom,mdss-dsi-panel-framerate = <60>;
				qcom,mdss-dsi-panel-width = <1272>;
				qcom,mdss-dsi-panel-height = <2772>;
				qcom,mdss-dsi-h-front-porch = <108>;
				qcom,mdss-dsi-h-back-porch = <16>;
				qcom,mdss-dsi-h-pulse-width = <16>;
				qcom,mdss-dsi-h-sync-skew = <0>;
				qcom,mdss-dsi-h-sync-pulse = <0>;
				qcom,mdss-dsi-v-back-porch = <22>;
				qcom,mdss-dsi-v-front-porch = <2892>;
				qcom,mdss-dsi-v-pulse-width = <2>;
				qcom,mdss-dsi-h-left-border = <0>;
				qcom,mdss-dsi-h-right-border = <0>;
				qcom,mdss-dsi-v-top-border = <0>;
				qcom,mdss-dsi-v-bottom-border = <0>;
				qcom,vid-on-commands = [
					39 00 00 00 00 00 06 F0 55 AA 52 08 04
					39 00 00 00 00 00 02 C2 11
					39 00 00 00 00 00 02 6F 0B
					39 00 00 00 00 00 03 B5 00 04
					39 00 00 00 00 00 02 6F 0C
					39 00 00 00 00 00 04 B6 02 00 00
					39 00 00 00 00 00 02 6F 0F
					39 00 00 00 00 00 04 B6 0d b6 00
					39 00 00 00 00 00 02 6F 18
					39 00 00 00 00 00 04 B6 0F C0 00
					39 00 00 00 00 00 02 6F 1B
					39 00 00 00 00 00 04 B6 0d 60 80
					39 00 00 00 00 00 02 6F 00
					39 00 00 00 00 00 04 B8 1D 30 00
					39 00 00 00 00 00 02 6F 03
					39 00 00 00 00 00 03 B8 0F FE
					39 00 00 00 00 00 02 6F 05
					39 00 00 00 00 00 04 B8 1D 40 00
					39 00 00 00 00 00 02 6F 08
					39 00 00 00 00 00 03 B8 1F FE
					39 00 00 00 00 00 02 6F 01
					39 00 00 00 00 00 04 B5 00 14 03
					39 00 00 00 00 00 05 FF AA 55 A5 80
					39 00 00 00 00 00 02 6F 1F
					39 00 00 00 00 00 02 F4 0B
					39 00 00 00 00 00 02 6F 20
					39 00 00 00 00 00 02 F4 3F
					39 00 00 00 00 00 02 6F 08
					39 00 00 00 00 00 02 FC 83
					39 00 00 00 00 00 02 6F 24
					39 00 00 00 00 00 02 F8 FF
					39 00 00 00 00 00 02 6F 0A
					39 00 00 00 00 00 06 F6 60 60 60 60 60
					39 00 00 00 00 00 05 FF AA 55 A5 81
					39 00 00 00 00 00 02 6F 05
					39 00 00 00 00 00 03 FE 3C 3C
					39 00 00 00 00 00 05 FF AA 55 A5 84
					39 00 00 00 00 00 02 6F 10
					39 00 00 00 00 00 02 F8 02
					39 00 00 00 00 00 02 F2 15
					39 00 00 00 00 00 05 2A 00 00 04 F7
					39 00 00 00 00 00 05 2B 00 00 05 DB
					39 00 00 00 00 00 02 6F 10
					39 00 00 00 00 00 09 8D 00 00 04 F7 00 00 05 DB
					39 00 00 00 00 00 04 17 21 00 10
					39 00 00 00 00 00 02 71 00
					39 00 00 00 00 00 05 3B 00 18 00 2C
					39 00 00 00 00 00 02 6F 04
					39 00 00 00 00 00 05 3B 00 18 00 30
					39 00 00 00 00 00 02 6F 08
					39 00 00 00 00 00 05 3B 00 18 03 E4
					39 00 00 00 00 00 02 6F 0C
					39 00 00 00 00 00 05 3B 00 18 0B 4C
					39 00 00 00 00 00 02 6F 10
					39 00 00 00 00 00 05 3B 00 18 00 30
					39 00 00 00 00 00 02 90 03
					39 00 00 00 00 00 02 6F 01
					39 00 00 00 00 00 02 90 43
					39 00 00 00 00 00 13 91 AB A8 00 0C C2 00 02 3E 01 37 00 08 08 BB 07 32 10 F0
					39 00 00 00 00 00 02 53 20
					39 00 00 00 00 00 02 88 01
					39 00 00 00 00 00 03 81 01 19
					39 00 00 00 00 00 02 35 00
					39 00 00 00 00 00 03 5F 00 00
					39 00 00 00 00 00 02 6F 04
					39 00 00 00 00 00 03 51 00 10
					39 00 00 00 00 00 02 62 81
					39 00 00 00 00 00 02 6F 01
					39 00 00 00 00 00 05 62 12 10 12 12
					39 00 00 00 00 00 02 6F 05
					39 00 00 00 00 00 05 62 1F 1F 1F 1F
					39 00 00 00 00 00 02 2F 03
					39 00 00 00 00 00 06 F0 55 AA 52 08 01
					39 00 00 00 00 00 02 6F 01
					39 00 00 00 00 00 02 D2 00
					39 00 00 00 00 00 06 F0 55 AA 52 08 01
					39 00 00 00 00 00 02 6F 02
					39 00 00 00 00 00 02 C7 46
					05 00 00 00 78 00 01 11
					05 00 00 00 00 00 01 29
				];

				qcom,cmd-on-commands = [
					39 00 00 00 00 00 06 F0 55 AA 52 08 04
					39 00 00 00 00 00 02 C2 11
					39 00 00 00 00 00 02 6F 0B
					39 00 00 00 00 00 03 B5 00 04
					39 00 00 00 00 00 02 6F 0C
					39 00 00 00 00 00 04 B6 02 00 00
					39 00 00 00 00 00 02 6F 0F
					39 00 00 00 00 00 04 B6 0d b6 00
					39 00 00 00 00 00 02 6F 18
					39 00 00 00 00 00 04 B6 0F C0 00
					39 00 00 00 00 00 02 6F 1B
					39 00 00 00 00 00 04 B6 0d 60 80
					39 00 00 00 00 00 02 6F 00
					39 00 00 00 00 00 04 B8 1D 30 00
					39 00 00 00 00 00 02 6F 03
					39 00 00 00 00 00 03 B8 0F FE
					39 00 00 00 00 00 02 6F 05
					39 00 00 00 00 00 04 B8 1D 40 00
					39 00 00 00 00 00 02 6F 08
					39 00 00 00 00 00 03 B8 1F FE
					39 00 00 00 00 00 02 6F 01
					39 00 00 00 00 00 04 B5 00 14 03
					39 00 00 00 00 00 05 FF AA 55 A5 80
					39 00 00 00 00 00 02 6F 1F
					39 00 00 00 00 00 02 F4 0B
					39 00 00 00 00 00 02 6F 20
					39 00 00 00 00 00 02 F4 3F
					39 00 00 00 00 00 02 6F 08
					39 00 00 00 00 00 02 FC 83
					39 00 00 00 00 00 02 6F 24
					39 00 00 00 00 00 02 F8 FF
					39 00 00 00 00 00 02 6F 0A
					39 00 00 00 00 00 06 F6 60 60 60 60 60
					39 00 00 00 00 00 05 FF AA 55 A5 81
					39 00 00 00 00 00 02 6F 05
					39 00 00 00 00 00 03 FE 3C 3C
					39 00 00 00 00 00 05 FF AA 55 A5 84
					39 00 00 00 00 00 02 6F 10
					39 00 00 00 00 00 02 F8 02
					39 00 00 00 00 00 02 F2 15
					39 00 00 00 00 00 05 2A 00 00 04 F7
					39 00 00 00 00 00 05 2B 00 00 05 DB
					39 00 00 00 00 00 02 6F 10
					39 00 00 00 00 00 09 8D 00 00 04 F7 00 00 05 DB
					39 00 00 00 00 00 04 17 21 00 10
					39 00 00 00 00 00 02 71 00
					39 00 00 00 00 00 05 3B 00 18 00 2C
					39 00 00 00 00 00 02 6F 04
					39 00 00 00 00 00 05 3B 00 18 00 30
					39 00 00 00 00 00 02 6F 08
					39 00 00 00 00 00 05 3B 00 18 03 E4
					39 00 00 00 00 00 02 6F 0C
					39 00 00 00 00 00 05 3B 00 18 0B 4C
					39 00 00 00 00 00 02 6F 10
					39 00 00 00 00 00 05 3B 00 18 00 30
					39 00 00 00 00 00 02 90 03
					39 00 00 00 00 00 02 6F 01
					39 00 00 00 00 00 02 90 43
					39 00 00 00 00 00 13 91 AB A8 00 0C C2 00 02 3E 01 37 00 08 08 BB 07 32 10 F0
					39 00 00 00 00 00 02 53 20
					39 00 00 00 00 00 02 88 01
					39 00 00 00 00 00 03 81 01 19
					39 00 00 00 00 00 02 35 00
					39 00 00 00 00 00 03 5F 00 00
					39 00 00 00 00 00 02 6F 04
					39 00 00 00 00 00 03 51 00 10
					39 00 00 00 00 00 02 62 81
					39 00 00 00 00 00 02 6F 01
					39 00 00 00 00 00 05 62 12 10 12 12
					39 00 00 00 00 00 02 6F 05
					39 00 00 00 00 00 05 62 1F 1F 1F 1F
					39 00 00 00 00 00 02 2F 03
					39 00 00 00 00 00 06 F0 55 AA 52 08 01
					39 00 00 00 00 00 02 6F 01
					39 00 00 00 00 00 02 D2 00
					39 00 00 00 00 00 06 F0 55 AA 52 08 01
					39 00 00 00 00 00 02 6F 02
					39 00 00 00 00 00 02 C7 46
					05 00 00 00 78 00 01 11

					//cmd aod mode
					39 00 00 00 00 00 01 39

					05 00 00 00 00 00 01 29
				];

				qcom,mdss-dsi-off-command = [
					05 01 00 00 11 00 01 28
					05 01 00 00 78 00 01 10];
				qcom,mdss-dsi-on-command-state = "dsi_lp_mode";
				qcom,mdss-dsi-off-command-state = "dsi_lp_mode";
				qcom,mdss-dsi-timing-switch-command-state =
					"dsi_lp_mode";
				qcom,compression-mode = "dsc";
				qcom,mdss-dsc-version = <0x12>;
				qcom,mdss-dsc-slice-height = <12>;
				qcom,mdss-dsc-slice-width = <636>;
				qcom,mdss-dsc-slice-per-pkt = <2>;
				qcom,mdss-dsc-bit-per-component = <10>;
				qcom,mdss-dsc-bit-per-pixel = <8>;
				qcom,mdss-dsc-block-prediction-enable;
				qcom,mdss-dsc-novateck-ic;

				qcom,mdss-dsi-dfps-60-command = [
						39 00 00 00 00 00 02 2f 03];
				qcom,mdss-dsi-dfps-60-command-state = "dsi_lp_mode";

				qcom,mdss-dsi-dfps-90-command = [
						39 00 00 00 00 00 02 2f 02];
				qcom,mdss-dsi-dfps-90-command-state = "dsi_lp_mode";

				qcom,mdss-dsi-dfps-120-command = [
						39 00 00 00 00 00 02 2f 01];
				qcom,mdss-dsi-dfps-120-command-state = "dsi_lp_mode";

				qcom,mdss-dsi-dfps-144-command = [
						39 00 00 00 00 00 02 2f 00];
				qcom,mdss-dsi-dfps-144-command-state = "dsi_lp_mode";

				//fps delay effect cmd
				qcom,mdss-dsi-dfps-60-delay-command = [
					39 00 00 00 00 00 0E A9 10 A2 00 0F 03 00 00 81 10 2F 00 00 03];
				qcom,mdss-dsi-dfps-60-delay-command-state = "dsi_lp_mode";

				qcom,mdss-dsi-dfps-90-delay-command = [
					39 00 00 00 00 00 0E A9 10 A2 00 0F 03 00 00 81 10 2F 00 00 02];
				qcom,mdss-dsi-dfps-90-delay-command-state = "dsi_lp_mode";

				qcom,mdss-dsi-dfps-120-delay-command = [
					39 00 00 00 00 00 0E A9 10 A2 00 0F 03 00 00 81 10 2F 00 00 01];
				qcom,mdss-dsi-dfps-120-delay-command-state = "dsi_lp_mode";

				qcom,mdss-dsi-dfps-144-delay-command = [
					39 00 00 00 00 00 0E A9 10 A2 00 0F 03 00 00 81 10 2F 00 00 00];
				qcom,mdss-dsi-dfps-144-delay-command-state = "dsi_lp_mode";

				qcom,mdss-dsi-pcd-check-enable-command = [
					39 00 00 40 00 00 06 F0 55 AA 52 08 01
					39 00 00 00 00 00 02 D0 10
					];
				qcom,mdss-dsi-pcd-check-enable-command-state = "dsi_hs_mode";
				qcom,mdss-dsi-pcd-check-disable-command = [
					39 00 00 40 00 00 06 F0 55 AA 52 08 01
					39 00 00 00 00 00 02 D0 00
					];
				qcom,mdss-dsi-pcd-check-disable-command-state = "dsi_hs_mode";

				qcom,cmd-mode-switch-in-commands = [
					39 00 00 40 00 00 06 F0 55 AA 52 08 00
					39 00 00 40 00 00 04 BE 40 40 40
					39 00 00 40 00 00 01 39
					39 00 00 40 00 00 06 F0 55 AA 52 08 00
					39 00 00 40 00 00 04 BE 40 40 47
					39 00 00 40 00 00 02 6F 04
					39 00 00 00 00 00 03 51 00 10
					];
				qcom,cmd-mode-switch-in-commands-state = "dsi_hs_mode";

				qcom,cmd-mode-switch-out-commands = [
					39 00 00 40 00 00 03 51 3E 80
					39 00 00 00 78 00 01 38
					];
				qcom,cmd-mode-switch-out-commands-state = "dsi_hs_mode";

				qcom,cmd-mode-backlight-commands = [
					39 00 00 40 00 00 02 6F 04
					39 00 00 00 00 00 03 51 00 10
					];
				qcom,cmd-mode-backlight-commands-state = "dsi_hs_mode";

			};
		};
	};
};
