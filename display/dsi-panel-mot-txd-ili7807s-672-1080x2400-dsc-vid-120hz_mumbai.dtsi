&mdss_mdp {
	mot_txd_ili7807s_672_1080x2400_dsc_vid_120hz_mumbai: qcom,mdss_dsi_mot_txd_ili7807s_672_dsc_120hz_vid_mumbai {
		qcom,mdss-dsi-panel-name = "mipi_mot_vid_txd_1080p_dsc_672_120hz_mumbai";
		qcom,mdss-dsi-panel-type = "dsi_video_mode";
		qcom,dsi-ctrl-num = <0>;
		qcom,dsi-phy-num = <0>;
		qcom,mdss-dsi-virtual-channel-id = <0>;
		qcom,mdss-dsi-stream = <0>;
		qcom,mdss-pan-physical-width-dimension = <70>;
		qcom,mdss-pan-physical-height-dimension = <156>;
		qcom,mdss-dsi-bpp = <24>;
		qcom,mdss-dsi-border-color = <0>;
		qcom,mdss-dsi-traffic-mode = "non_burst_sync_event";
		qcom,mdss-dsi-bllp-power-mode;
		qcom,mdss-dsi-bllp-eof-power-mode;
		qcom,mdss-dsi-lane-0-state;
		qcom,mdss-dsi-lane-1-state;
		qcom,mdss-dsi-lane-2-state;
		qcom,mdss-dsi-lane-3-state;
		qcom,mdss-dsi-dma-trigger = "trigger_sw";
		qcom,mdss-dsi-mdp-trigger = "none";
		qcom,mdss-dsi-reset-sequence = <1 10>, <0 2>, <1 10>;
		qcom,mdss-dsi-backlight-off-dimming-enabled;
		qcom,mdss-dsi-backlight-off-dimming = <450 30>;
		qcom,mdss-dsi-backlight-off-threshold = <700>;
		qcom,mdss-dsi-backlight-on-dimming-enabled;
		qcom,mdss-dsi-backlight-on-dimming = <150 30>;
		qcom,mdss-dsi-backlight-on-threshold = <700>;
		qcom,mdss-dsi-backlight-default = <1638>;
		qcom,mdss-dsi-tx-eot-append;
		qcom,adjust-timer-wakeup-ms = <1>;

		qcom,mdss-dsi-display-timings {
			timing@0 {
				//cell-index = <0>;
				qcom,mdss-dsi-panel-width = <1080>;
				qcom,mdss-dsi-panel-height = <2400>;
				qcom,mdss-dsi-h-front-porch = <22>;
				qcom,mdss-dsi-h-back-porch = <22>;
				qcom,mdss-dsi-h-pulse-width = <4>;
				qcom,mdss-dsi-h-sync-skew = <0>;
				qcom,mdss-dsi-v-back-porch = <40>;
				qcom,mdss-dsi-v-front-porch = <40>;
				qcom,mdss-dsi-v-pulse-width = <4>;
				qcom,mdss-dsi-panel-framerate = <120>;
				qcom,mdss-dsi-on-command = [
					39 00 00 40 00 00 04 FF 78 07 06
					39 00 00 40 00 00 02 3E E2
					39 00 00 40 00 00 02 80 00
					39 00 00 40 00 00 04 FF 78 07 06
					39 00 00 40 00 00 02 8D D8
					39 00 00 40 00 00 04 FF 78 07 0E
					39 00 00 40 00 00 02 45 0B
					39 00 00 40 00 00 02 46 28
					39 00 00 40 00 00 02 B1 31
					39 00 00 40 00 00 02 C2 31
					39 00 00 40 00 00 02 C3 31
					39 00 00 40 00 00 02 C4 31
					39 00 00 40 00 00 02 C5 31
					39 00 00 40 00 00 02 C6 31
					39 00 00 40 00 00 02 C7 31
					39 00 00 40 00 00 02 C8 31
					39 00 00 40 00 00 02 C9 31
					39 00 00 40 00 00 02 4D 60
					39 00 00 40 00 00 04 FF 78 07 1E
					39 00 00 40 00 00 02 C2 85
					39 00 00 40 00 00 02 C3 85
					39 00 00 40 00 00 02 C4 35
					39 00 00 40 00 00 04 FF 78 07 0C
					39 00 00 40 00 00 02 80 3F
					39 00 00 40 00 00 02 81 F1
					39 00 00 40 00 00 02 82 3F
					39 00 00 40 00 00 02 83 F0
					39 00 00 40 00 00 04 FF 78 07 08
					39 00 00 40 00 00 03 FD 00 9F
					39 00 00 40 00 00 02 E1 D7
					39 00 00 40 00 00 03 FD 00 00
					39 00 00 40 00 00 04 FF 78 07 02
					39 00 00 40 00 00 02 82 12
					39 00 00 40 00 00 04 FF 78 07 06
					39 00 00 40 00 00 02 1E 44
					39 00 00 40 00 00 04 FF 78 07 00
					39 00 00 40 00 00 03 51 07 FF
					39 00 00 40 00 00 02 53 2C
					39 00 00 40 00 00 02 55 01
					39 00 00 40 00 00 02 35 00
					05 00 00 00 41 00 02 11 00
					05 00 00 00 05 00 02 29 00
				];
				qcom,mdss-dsi-on-command-state = "dsi_lp_mode";
				qcom,mdss-dsi-off-command = [
					39 00 00 00 01 00 04 FF 78 07 00
					05 00 00 00 14 00 01 28
					05 00 00 00 69 00 01 10
					39 00 00 40 00 00 04 FF 78 07 06
					39 00 00 00 00 00 02 8D DC
				];
				qcom,mdss-dsi-off-command-state = "dsi_lp_mode";
				qcom,compression-mode = "dsc";
				qcom,mdss-dsc-slice-height = <10>;
				qcom,mdss-dsc-slice-width = <540>;
				qcom,mdss-dsc-slice-per-pkt = <2>;
				qcom,mdss-dsc-bit-per-component = <8>;
				qcom,mdss-dsc-bit-per-pixel = <8>;
				qcom,mdss-dsc-block-prediction-enable;
			};
		};
	};
};
