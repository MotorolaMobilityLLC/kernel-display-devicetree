/* Copyright (c) 2019-2021, The Linux Foundation. All rights reserved.
 *
 * This program is free software; you can redistribute it and/or modify
 * it under the terms of the GNU General Public License version 2 and
 * only version 2 as published by the Free Software Foundation.
 *
 * This program is distributed in the hope that it will be useful,
 * but WITHOUT ANY WARRANTY; without even the implied warranty of
 * MERCHANTABILITY or FITNESS FOR A PARTICULAR PURPOSE.  See the
 * GNU General Public License for more details.
 */
&mdss_mdp {
	mot_csot_vtdr6126a_667_1220p_dsc_vid_120hz_v0: qcom,mdss_dsi_mot_csot_vtdr6126a_667_1220p_dsc_vid_v0 {
		qcom,mdss-dsi-panel-name = "mipi_mot_vid_csot_1220p_dsc_667";
		qcom,mdss-dsi-panel-supplier = "csot";
		qcom,mdss-dsi-panel-type = "dsi_video_mode";
		qcom,mdss-dsi-panel-physical-type = "oled";
		qcom,dsi-ctrl-num = <0>;
		qcom,dsi-phy-num = <0>;
		qcom,mdss-dsi-virtual-channel-id = <0>;
		qcom,mdss-dsi-stream = <0>;
		qcom,mdss-pan-physical-width-dimension = <69>;
		qcom,mdss-pan-physical-height-dimension = <154>;
		qcom,mdss-dsi-bpp = <30>;
		qcom,mdss-dsi-underflow-color = <0xff>;
		qcom,mdss-dsi-border-color = <0>;

		qcom,mdss-dsi-traffic-mode = "non_burst_sync_event";
		qcom,mdss-dsi-bllp-eof-power-mode;
		qcom,mdss-dsi-bllp-power-mode;
		qcom,mdss-dsi-lp11-init;
		qcom,mdss-dsi-lane-0-state;
		qcom,mdss-dsi-lane-1-state;
		qcom,mdss-dsi-lane-2-state;
		qcom,mdss-dsi-lane-3-state;
		qcom,mdss-dsi-dma-trigger = "trigger_sw";
		qcom,mdss-dsi-mdp-trigger = "none";
		qcom,mdss-dsi-reset-sequence = <1 2>, <0 5>, <1 20>;//

		qcom,mdss-dsi-wr-mem-start = <0x2c>;
		qcom,mdss-dsi-wr-mem-continue = <0x3c>;

		qcom,mdss-dsi-dc-off-command = [
				39 00 00 00 00 00 02 5E 00];
		qcom,mdss-dsi-dc-off-command-state = "dsi_hs_mode";
		qcom,mdss-dsi-dc-on-command = [
				39 00 00 00 00 00 02 5E 01];
		qcom,mdss-dsi-dc-on-command-state = "dsi_hs_mode";

		qcom,mdss-dsi-hbm-on-command = [
				39 00 00 40 00 00 03 51 3E 80
				39 00 00 00 00 00 02 62 00];
		qcom,mdss-dsi-hbm-on-command-state = "dsi_hs_mode";
		qcom,mdss-dsi-hbm-off-command = [
				39 00 00 00 00 00 02 62 00];
		qcom,mdss-dsi-hbm-off-command-state = "dsi_hs_mode";
		qcom,mdss-dsi-hbm-fod;
		qcom,mdss-dsi-hbm-fod-on-command = [
				39 00 00 40 00 00 05 63 10 00 14 AC
				39 00 00 00 00 00 02 62 03];
		qcom,mdss-dsi-hbm-fod-on-command-state = "dsi_hs_mode";

		qcom,mdss-dsi-panel-local-hbm-enabled;
		qcom,mdss-dsi-panel-local-hbm-DC-HYBIRD-THRESHOLD-BL = <3525>;
		qcom,mdss-dsi-panel-local-hbm-alpha-register = <0x63>;
		qcom,mdss-dsi-panel-local-hbm-alpha-size = <16001>;
		qcom,mdss-dsi-panel-bl-num = <1>;

		qcom,mdss-dsi-display-timings {
			timing@0 {
				cell-index = <0>;
				qcom,mdss-dsi-panel-framerate = <120>;
				qcom,mdss-dsi-panel-width = <1220>;
				qcom,mdss-dsi-panel-height = <2712>;
				qcom,mdss-dsi-h-front-porch = <26>;
				qcom,mdss-dsi-h-back-porch = <16>;
				qcom,mdss-dsi-h-pulse-width = <16>;
				qcom,mdss-dsi-h-sync-skew = <0>;
				qcom,mdss-dsi-h-sync-pulse = <0>;
				qcom,mdss-dsi-v-back-porch = <22>;
				qcom,mdss-dsi-v-front-porch = <52>;
				qcom,mdss-dsi-v-pulse-width = <2>;
				qcom,mdss-dsi-h-left-border = <0>;
				qcom,mdss-dsi-h-right-border = <0>;
				qcom,mdss-dsi-v-top-border = <0>;
				qcom,mdss-dsi-v-bottom-border = <0>;
				qcom,mdss-dsi-on-command = [
					39 00 00 00 00 00 02 03 01
					39 00 00 00 00 00 02 35 00
					39 00 00 00 00 00 03 44 06 8c
					39 00 00 00 00 00 03 51 00 00
					39 00 00 00 00 00 02 53 20
					39 00 00 00 00 00 02 59 09
					39 00 00 00 00 00 02 5e 00
					39 00 00 00 00 00 02 6c 01
					39 00 00 00 00 00 02 6d 00

					39 00 00 00 00 00 02 6f 01
					39 00 00 00 00 00 05 2A 00 00 04 C3
					39 00 00 00 00 00 05 2B 00 00 05 87

					39 00 00 00 00 00 02 A4 01
					05 00 00 00 00 00 01 38
					39 00 00 00 00 00 02 6F 01
					39 00 00 00 00 00 02 A4 00

					39 00 00 00 00 00 02 72 00
					39 00 00 00 00 00 5F 70 11 00 00 89 30 80 0a 98 04 c4 00 0c 02 62 02 62 02 00 02 32 00 20 01 31 00 08 00 0c 08 bb 07 7b 18 00 10 f0 03 0c 20 00 06 0b 0b 33 0e 1c 2a 38 46 54 62 69 70 77 79 7b 7d 7e 01 02 01 00 09 40 09 be 19 fc 19 fa 19 f8 1a 38 1a 78 1a b6 2a b6 2a f4 2a f4 4b 34 63 74 00 00 00 00 00 00

					39 00 00 00 00 00 03 f0 aa 16
					39 00 00 00 00 00 10 d1 00 00 00 00 00 00 00 00 00 00 00 00 00 00 00

					39 00 00 00 00 00 03 f0 aa 1c
					39 00 00 00 00 00 15 c1 0d c6 10 b0 15 2d 1d 26 2c 54 36 e8 3e 80 3e 81 3e 81 3e 81
					39 00 00 00 00 00 03 c4 01 ff
					39 00 00 00 00 00 02 65 00
					39 00 00 00 00 00 04 c2 B1 AB B3
					39 00 00 00 00 00 02 65 02
					39 00 00 00 00 00 04 c4 02 02 02
					39 00 00 00 00 00 02 65 03
					39 00 00 00 00 00 04 c2 B1 AB B3
					39 00 00 00 00 00 02 65 05
					39 00 00 00 00 00 04 c4 02 02 02
					39 00 00 00 00 00 02 65 06
					39 00 00 00 00 00 04 c2 B2 AB B3
					39 00 00 00 00 00 02 65 08
					39 00 00 00 00 00 04 c4 02 02 02
					39 00 00 00 00 00 02 65 09
					39 00 00 00 00 00 04 c2 B2 AB B3
					39 00 00 00 00 00 02 65 0b
					39 00 00 00 00 00 04 c4 04 04 05
					39 00 00 00 00 00 02 65 0c
					39 00 00 00 00 00 04 c2 B3 AD B6
					39 00 00 00 00 00 02 65 0e
					39 00 00 00 00 00 04 c4 0b 0c 0e
					39 00 00 00 00 00 02 65 0f
					39 00 00 00 00 00 04 c2 B5 AF B9
					39 00 00 00 00 00 02 65 11
					39 00 00 00 00 00 04 c4 12 12 14
					39 00 00 00 00 00 02 65 12
					39 00 00 00 00 00 04 c2 B8 B1 BC
					39 00 00 00 00 00 02 65 14
					39 00 00 00 00 00 04 c4 21 20 23
					39 00 00 00 00 00 02 65 15
					39 00 00 00 00 00 04 c2 B9 B3 BE
					39 00 00 00 00 00 02 65 17
					39 00 00 00 00 00 04 c4 21 20 23
					39 00 00 00 00 00 02 65 18
					39 00 00 00 00 00 04 c2 00 00 00
					39 00 00 00 00 00 02 65 1a
					39 00 00 00 00 00 04 c4 0a 0a 0a
					39 00 00 00 00 00 02 65 1b
					39 00 00 00 00 00 04 c2 00 00 00
					39 00 00 00 00 00 02 65 1d
					39 00 00 00 00 00 04 c4 0a 0a 0a

					39 00 00 00 00 00 03 FF 5A 81
					39 00 00 00 00 00 02 65 03
					39 00 00 00 00 00 02 f3 49
					39 00 00 00 00 00 02 65 0B
					39 00 00 00 00 00 02 f3 58

					39 00 00 00 00 00 03 ff 5a 80
					39 00 00 00 00 00 02 65 25
					39 00 00 00 00 00 02 fd 01
					39 00 00 00 00 00 02 f9 10
					39 00 00 00 00 00 02 65 0a
					39 00 00 00 00 00 02 f9 1e
					39 00 00 00 00 00 03 ff 5a 83
					39 00 00 00 00 00 02 65 0B
					39 00 00 00 00 00 02 f7 03

					39 00 00 00 00 00 03 ff 5a 83
					39 00 00 00 00 00 02 65 09
					39 00 00 00 00 00 03 f7 10 10

					39 00 00 00 00 00 03 ff 5a 00
					39 00 00 00 00 00 03 f0 aa 00

					05 00 00 00 64 00 01 11
					05 00 00 00 00 00 01 29
				];

				qcom,mdss-dsi-off-command = [
					05 01 00 00 11 00 01 28
					05 01 00 00 78 00 01 10];
				qcom,mdss-dsi-on-command-state = "dsi_lp_mode";
				qcom,mdss-dsi-off-command-state = "dsi_lp_mode";
				qcom,mdss-dsi-timing-switch-command-state =
					"dsi_lp_mode";
				qcom,compression-mode = "dsc";
				qcom,mdss-dsc-slice-height = <12>;
				qcom,mdss-dsc-slice-width = <610>;
				qcom,mdss-dsc-slice-per-pkt = <2>;
				qcom,mdss-dsc-bit-per-component = <10>;
				qcom,mdss-dsc-bit-per-pixel = <8>;
				qcom,mdss-dsc-block-prediction-enable;
				qcom,mdss-dsi-dfps-60-command = [
						39 00 00 00 00 00 02 6C 03];
				qcom,mdss-dsi-dfps-60-command-state = "dsi_hs_mode";

				qcom,mdss-dsi-dfps-90-command = [
						39 00 00 00 00 00 02 6c 02];
				qcom,mdss-dsi-dfps-90-command-state = "dsi_hs_mode";

				qcom,mdss-dsi-dfps-120-command = [
						39 00 00 00 00 00 02 6c 01];
				qcom,mdss-dsi-dfps-120-command-state = "dsi_hs_mode";
			};
		};
	};
};
