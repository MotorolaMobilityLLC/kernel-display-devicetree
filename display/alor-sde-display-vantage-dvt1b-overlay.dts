// SPDX-License-Identifier: BSD-3-Clause
/*
 * Copyright (c) Qualcomm Technologies, Inc. and/or its subsidiaries.
 */

/dts-v1/;
/plugin/;

#include "alor-sde-display-vantage.dtsi"

#define VANTAGE_RADIO_JAPAN 3

/ {
	model = "vantage";
	compatible = "qcom,alor-qrd", "qcom,alor", "qcom,qrd";
	qcom,msm-id = <685 0x10000>;
	qcom,board-id = <0x41 0xB1B0>, <0x41 0xC000>, <(VANTAGE_RADIO_JAPAN <<8 | 0x41) 0xA100>;
};
