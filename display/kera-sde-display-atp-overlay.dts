// SPDX-License-Identifier: BSD-3-Clause
/*
 * Copyright (c) Qualcomm Technologies, Inc. and/or its subsidiaries.
 */

/dts-v1/;
/plugin/;

#include "kera-sde-display-mtp.dtsi"

/ {
	model = "Qualcomm Technologies, Inc. Kera ATP";
	compatible = "qcom,kera-atp", "qcom,kera", "qcom,kerap-atp", "qcom,kerap",
			"qcom,atp";
	qcom,msm-id = <686 0x10000>, <659 0x10000>, <720 0x10000>, <721 0x10000>,
			<731 0x10000>, <732 0x10000>;
	qcom,board-id = <33 0>;
};
