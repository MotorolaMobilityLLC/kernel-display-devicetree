/* Copyright (c) 2019-2021, The Linux Foundation. All rights reserved.
 *
 * This program is free software; you can redistribute it and/or modify
 * it under the terms of the GNU General Public License version 2 and
 * only version 2 as published by the Free Software Foundation.
 *
 * This program is distributed in the hope that it will be useful,
 * but WITHOUT ANY WARRANTY; without even the implied warranty of
 * MERCHANTABILITY or FITNESS FOR A PARTICULAR PURPOSE.  See the
 * GNU General Public License for more details.
 */
&mdss_mdp {
	mot_tm_vtdr6115_667_1080x2400_dsc_120hz_vid: qcom,mdss_dsi_mot_tm_vtdr6115_667_1080x2400_dsc_120hz_vid {
		qcom,mdss-dsi-panel-name = "mipi_mot_vid_tm_667_1080p_dsc_120hz";
		qcom,mdss-dsi-panel-supplier = "tm";
		qcom,mdss-dsi-panel-type = "dsi_video_mode";
		qcom,mdss-dsi-panel-physical-type = "oled";
		qcom,dsi-ctrl-num = <0>;
		qcom,dsi-phy-num = <0>;
		qcom,mdss-dsi-virtual-channel-id = <0>;
		qcom,mdss-dsi-stream = <0>;
		qcom,mdss-pan-physical-width-dimension = <69>;
		qcom,mdss-pan-physical-height-dimension = <155>;
		qcom,mdss-dsi-bpp = <30>;
		qcom,mdss-dsi-underflow-color = <0xff>;
		qcom,mdss-dsi-border-color = <0>;

		qcom,mdss-dsi-traffic-mode = "non_burst_sync_event";
		qcom,mdss-dsi-bllp-eof-power-mode;
		qcom,mdss-dsi-bllp-power-mode;
		qcom,mdss-dsi-lp11-init;
		qcom,mdss-dsi-lane-0-state;
		qcom,mdss-dsi-lane-1-state;
		qcom,mdss-dsi-lane-2-state;
		qcom,mdss-dsi-lane-3-state;
		qcom,mdss-dsi-dma-trigger = "trigger_sw";
		qcom,mdss-dsi-mdp-trigger = "none";
		qcom,mdss-dsi-reset-sequence = <1 2>, <0 5>, <1 20>;

		qcom,mdss-dsi-dc-off-command = [
				39 01 00 00 00 00 02 5E 00];
		qcom,mdss-dsi-dc-off-command-state = "dsi_hs_mode";
		qcom,mdss-dsi-dc-on-command = [
				39 01 00 00 00 00 02 5E 01];
		qcom,mdss-dsi-dc-on-command-state = "dsi_hs_mode";


		qcom,mdss-dsi-hbm-detect-fps;
		qcom,mdss-dsi-hbm-on-command = [
				39 00 00 40 00 00 02 62 00
				39 00 00 40 00 00 03 51 0F FF
				39 00 00 40 00 00 03 F0 AA 13
				39 01 00 00 00 00 02 C6 00];
		qcom,mdss-dsi-hbm-off-command = [
				39 00 00 40 00 00 02 62 00
				39 00 00 40 00 00 03 51 0D BA
				39 00 00 40 00 00 03 F0 AA 13
				39 01 00 00 00 00 02 C6 00];

		qcom,mdss-dsi-hbm-fod;
		qcom,mdss-dsi-hbm-fod-on-command = [
				39 00 00 40 00 00 03 F0 AA 13
				39 00 00 40 00 00 02 C6 01
				39 00 00 40 00 00 03 63 03 FF
				39 00 00 40 00 00 03 51 05 2C
				39 01 00 00 00 00 02 62 03];

		qcom,mdss-dsi-panel-lhbm-wait-fps-valid;
		qcom,mdss-dsi-panel-local-hbm-wait-fps-count = <30>;
		qcom,mdss-dsi-panel-local-hbm-wait-fps-interval = <1>;
		qcom,mdss-dsi-panel-lhbm-not-allowed-fps-list = <60 90>;

		qcom,mdss-dsi-panel-local-hbm-enabled;
		qcom,mdss-dsi-panel-local-hbm-DC-HYBIRD-THRESHOLD-BL = <1324>; //0x052c
		qcom,mdss-dsi-panel-local-hbm-alpha-register = <0x63>;
		qcom,mdss-dsi-panel-local-hbm-alpha-size = <4096>;
		qcom,mdss-dsi-panel-local-hbm-alpha-table = <
				0   226 226 226 226 226 227 227 227 227 227 228 228 228 228 229
				229 229 229 229 229 230 230 230 230 230 231 231 231 231 231 232
				232 232 232 232 233 233 233 233 233 234 234 234 234 235 235 235
				235 236 236 236 237 237 237 238 238 238 239 239 240 240 241 241
				241 241 242 242 242 242 243 243 243 243 244 244 244 244 245 245
				245 245 246 246 246 247 247 247 248 248 248 249 249 249 250 250
				250 251 251 251 252 252 252 253 253 253 254 254 254 255 255 255
				256 256 256 257 257 257 258 258 258 259 259 259 260 260 261 261
				262 262 262 263 263 263 264 264 264 265 265 265 266 266 266 267
				267 267 268 268 269 269 270 270 271 271 272 272 273 273 273 274
				274 274 275 275 275 276 276 276 277 277 278 278 278 279 279 279
				280 280 280 281 281 281 282 282 282 282 283 283 283 283 284 284
				284 285 285 285 286 286 286 287 287 287 287 288 288 288 289 289
				289 290 290 290 290 291 291 291 291 292 292 292 293 293 293 294
				294 294 294 295 295 295 296 296 296 296 297 297 297 298 298 298
				298 299 299 299 300 300 300 300 301 301 301 302 302 302 302 303
				303 303 304 304 304 305 305 305 306 306 306 307 307 308 308 309
				309 310 310 311 311 311 312 312 312 313 313 313 314 314 315 315
				316 316 317 317 318 318 319 319 319 320 320 321 321 322 322 322
				323 323 323 324 324 325 325 326 326 327 327 328 328 329 329 330
				330 331 331 332 332 333 333 334 334 335 335 336 336 337 337 338
				338 339 339 340 340 341 342 342 343 344 344 345 346 346 347 348
				348 349 349 350 351 351 352 352 353 353 354 355 355 356 357 357
				358 358 359 360 360 361 362 363 364 365 366 367 368 369 370 371
				372 372 373 373 374 375 375 376 377 377 378 379 379 380 381 381
				382 382 383 383 383 384 384 384 385 385 385 386 386 386 387 387
				388 388 389 390 391 392 392 393 394 395 396 396 397 398 399 399
				400 401 402 403 403 404 405 406 406 407 408 409 409 410 411 412
				413 413 414 415 416 416 417 418 419 420 420 421 422 423 423 424
				425 426 426 427 428 429 429 430 431 432 433 433 434 435 436 436
				437 438 439 439 440 441 442 442 443 444 445 446 446 447 448 449
				449 450 451 452 452 453 454 455 455 456 457 458 458 459 460 461
				461 462 463 464 464 465 466 467 467 468 469 470 470 471 472 473
				474 475 476 477 477 478 479 480 480 481 482 483 483 484 485 486
				486 487 488 489 489 490 491 492 492 493 494 495 495 496 497 498
				498 499 499 499 500 500 500 501 501 501 501 502 502 502 503 503
				503 504 504 504 505 506 506 507 507 509 510 511 511 512 512 513
				514 514 515 516 517 518 519 520 521 521 522 523 524 524 525 526
				527 527 528 528 529 529 530 530 531 531 532 532 533 533 534 534
				535 535 536 536 537 537 538 538 539 539 540 540 541 541 542 542
				543 543 544 544 545 545 546 546 547 547 548 548 549 549 549 550
				550 550 551 551 551 552 552 552 553 553 553 554 554 555 555 556
				556 556 557 557 557 558 558 558 559 559 560 560 561 561 562 562
				562 563 564 564 565 566 567 567 568 569 570 570 571 572 573 573
				574 575 576 576 577 578 579 579 580 581 582 582 583 584 585 585
				586 587 588 588 589 590 591 591 592 593 593 594 595 596 596 597
				598 599 599 600 601 602 602 603 604 605 605 606 607 608 608 609
				610 611 611 612 613 613 614 615 616 616 617 618 619 619 620 621
				622 622 623 624 625 625 626 627 628 628 629 630 630 631 632 633
				633 634 635 636 636 637 638 639 639 640 641 642 642 643 644 644
				645 646 647 647 648 649 650 650 651 652 653 653 654 655 656 656
				657 658 658 659 660 661 661 662 663 664 664 665 666 667 667 668
				669 669 670 671 672 672 673 674 675 675 676 677 678 678 679 680
				680 681 682 683 683 684 685 686 686 687 688 689 689 690 691 691
				692 693 694 694 695 696 697 697 698 699 699 700 701 702 702 703
				704 705 705 706 707 708 708 709 710 710 711 712 713 713 714 715
				716 716 717 718 718 719 720 721 721 722 723 724 724 725 726 726
				727 728 729 729 730 731 732 732 733 734 734 735 736 737 737 738
				739 740 740 741 742 742 743 744 745 746 746 747 748 749 750 750
				751 752 753 754 754 755 755 756 756 757 758 759 760 761 762 762
				762 763 763 764 765 766 767 768 768 768 769 769 770 770 771 772
				773 774 775 776 777 778 779 779 779 780 781 782 783 783 784 784
				785 786 787 787 788 789 789 790 791 792 792 793 794 795 795 796
				797 797 798 799 800 801 801 802 802 803 804 805 805 807 807 808
				809 810 810 810 811 812 813 814 815 816 816 816 817 818 818 819
				820 820 821 822 823 823 824 825 826 826 827 828 828 829 830 830
				830 831 832 833 834 835 835 837 838 838 839 839 841 842 842 843
				844 844 845 846 847 847 848 848 849 850 851 852 852 853 854 854
				855 856 857 857 857 858 858 859 860 861 861 862 863 863 864 865
				866 866 867 868 868 869 870 871 871 872 873 873 874 875 876 877
				878 879 880 881 882 883 884 885 886 887 888 889 890 891 892 893
				894 895 896 896 897 898 899 900 901 902 903 904 905 906 906 907
				908 909 909 910 911 912 913 913 914 915 915 916 917 917 918 918
				919 919 920 920 921 922 923 924 925 926 927 928 929 929 930 931
				931 932 933 933 934 935 935 936 937 937 938 939 939 940 941 941
				942 943 943 944 944 945 946 947 948 949 949 950 950 951 951 952
				953 954 954 955 956 957 957 958 958 958 959 960 960 961 962 962
				963 964 964 965 965 966 967 967 968 969 969 970 971 971 972 973
				973 974 975 975 976 977 977 978 978 979 980 980 981 981 981 982
				983 984 985 986 986 987 988 988 989 990 990 991 992 993 994 995
				996 996 997 998 999 1000 1001 1002 1003 1004 1004 1005 1005 1006 1006 1007
				1007 1008 1008 1009 1009 1010 1010 1011 1011 1012 1012 1013 1014 1015 1016 1017
				1018 1019 1019 1020 1020 1021 1021 1022 1022 1023 1023 1023 1023 1023 1023 1023
				1023 1023 1023 1023 1023 1023 1023 1023 1023 1023 1023 1023 1023 1023 1023 1023
				1023 1023 1023 1023 1023 1023 1023 1023 1023 1023 1023 1023 1023 1023 1023 1023
				1023 1023 1023 1023 1023 1023 1023 1023 1023 1023 1023 1023 1023 1023 1023 1023
				1023 1023 1023 1023 1023 1023 1023 1023 1023 1023 1023 1023 1023 1023 1023 1023
				1023 1023 1023 1023 1023 1023 1023 1023 1023 1023 1023 1023 1023 1023 1023 1023
				1023 1023 1023 1023 1023 1023 1023 1023 1023 1023 1023 1023 1023 1023 1023 1023
				1023 1023 1023 1023 1023 1023 1023 1023 1023 1023 1023 1023 1023 1023 1023 1023
				1023 1023 1023 1023 1023 1023 1023 1023 1023 1023 1023 1023 1023 1023 1023 1023
				1023 1023 1023 1023 1023 1023 1023 1023 1023 1023 1023 1023 1023 1023 1023 1023
				1023 1023 1023 1023 1023 1023 1023 1023 1023 1023 1023 1023 1023 1023 1023 1023
				1023 1023 1023 1023 1023 1023 1023 1023 1023 1023 1023 1023 1023 1023 1023 1023
				1023 1023 1023 1023 1023 1023 1023 1023 1023 1023 1023 1023 1023 1023 1023 1023
				1023 1023 1023 1023 1023 1023 1023 1023 1023 1023 1023 1023 1023 1023 1023 1023
				1023 1023 1023 1023 1023 1023 1023 1023 1023 1023 1023 1023 1023 1023 1023 1023
				1023 1023 1023 1023 1023 1023 1023 1023 1023 1023 1023 1023 1023 1023 1023 1023
				1023 1023 1023 1023 1023 1023 1023 1023 1023 1023 1023 1023 1023 1023 1023 1023
				1023 1023 1023 1023 1023 1023 1023 1023 1023 1023 1023 1023 1023 1023 1023 1023
				1023 1023 1023 1023 1023 1023 1023 1023 1023 1023 1023 1023 1023 1023 1023 1023
				1023 1023 1023 1023 1023 1023 1023 1023 1023 1023 1023 1023 1023 1023 1023 1023
				1023 1023 1023 1023 1023 1023 1023 1023 1023 1023 1023 1023 1023 1023 1023 1023
				1023 1023 1023 1023 1023 1023 1023 1023 1023 1023 1023 1023 1023 1023 1023 1023
				1023 1023 1023 1023 1023 1023 1023 1023 1023 1023 1023 1023 1023 1023 1023 1023
				1023 1023 1023 1023 1023 1023 1023 1023 1023 1023 1023 1023 1023 1023 1023 1023
				1023 1023 1023 1023 1023 1023 1023 1023 1023 1023 1023 1023 1023 1023 1023 1023
				1023 1023 1023 1023 1023 1023 1023 1023 1023 1023 1023 1023 1023 1023 1023 1023
				1023 1023 1023 1023 1023 1023 1023 1023 1023 1023 1023 1023 1023 1023 1023 1023
				1023 1023 1023 1023 1023 1023 1023 1023 1023 1023 1023 1023 1023 1023 1023 1023
				1023 1023 1023 1023 1023 1023 1023 1023 1023 1023 1023 1023 1023 1023 1023 1023
				1023 1023 1023 1023 1023 1023 1023 1023 1023 1023 1023 1023 1023 1023 1023 1023
				1023 1023 1023 1023 1023 1023 1023 1023 1023 1023 1023 1023 1023 1023 1023 1023
				1023 1023 1023 1023 1023 1023 1023 1023 1023 1023 1023 1023 1023 1023 1023 1023
				1023 1023 1023 1023 1023 1023 1023 1023 1023 1023 1023 1023 1023 1023 1023 1023
				1023 1023 1023 1023 1023 1023 1023 1023 1023 1023 1023 1023 1023 1023 1023 1023
				1023 1023 1023 1023 1023 1023 1023 1023 1023 1023 1023 1023 1023 1023 1023 1023
				1023 1023 1023 1023 1023 1023 1023 1023 1023 1023 1023 1023 1023 1023 1023 1023
				1023 1023 1023 1023 1023 1023 1023 1023 1023 1023 1023 1023 1023 1023 1023 1023
				1023 1023 1023 1023 1023 1023 1023 1023 1023 1023 1023 1023 1023 1023 1023 1023
				1023 1023 1023 1023 1023 1023 1023 1023 1023 1023 1023 1023 1023 1023 1023 1023
				1023 1023 1023 1023 1023 1023 1023 1023 1023 1023 1023 1023 1023 1023 1023 1023
				1023 1023 1023 1023 1023 1023 1023 1023 1023 1023 1023 1023 1023 1023 1023 1023
				1023 1023 1023 1023 1023 1023 1023 1023 1023 1023 1023 1023 1023 1023 1023 1023
				1023 1023 1023 1023 1023 1023 1023 1023 1023 1023 1023 1023 1023 1023 1023 1023
				1023 1023 1023 1023 1023 1023 1023 1023 1023 1023 1023 1023 1023 1023 1023 1023
				1023 1023 1023 1023 1023 1023 1023 1023 1023 1023 1023 1023 1023 1023 1023 1023
				1023 1023 1023 1023 1023 1023 1023 1023 1023 1023 1023 1023 1023 1023 1023 1023
				1023 1023 1023 1023 1023 1023 1023 1023 1023 1023 1023 1023 1023 1023 1023 1023
				1023 1023 1023 1023 1023 1023 1023 1023 1023 1023 1023 1023 1023 1023 1023 1023
				1023 1023 1023 1023 1023 1023 1023 1023 1023 1023 1023 1023 1023 1023 1023 1023
				1023 1023 1023 1023 1023 1023 1023 1023 1023 1023 1023 1023 1023 1023 1023 1023
				1023 1023 1023 1023 1023 1023 1023 1023 1023 1023 1023 1023 1023 1023 1023 1023
				1023 1023 1023 1023 1023 1023 1023 1023 1023 1023 1023 1023 1023 1023 1023 1023
				1023 1023 1023 1023 1023 1023 1023 1023 1023 1023 1023 1023 1023 1023 1023 1023
				1023 1023 1023 1023 1023 1023 1023 1023 1023 1023 1023 1023 1023 1023 1023 1023
				1023 1023 1023 1023 1023 1023 1023 1023 1023 1023 1023 1023 1023 1023 1023 1023
				1023 1023 1023 1023 1023 1023 1023 1023 1023 1023 1023 1023 1023 1023 1023 1023
				1023 1023 1023 1023 1023 1023 1023 1023 1023 1023 1023 1023 1023 1023 1023 1023
				1023 1023 1023 1023 1023 1023 1023 1023 1023 1023 1023 1023 1023 1023 1023 1023
				1023 1023 1023 1023 1023 1023 1023 1023 1023 1023 1023 1023 1023 1023 1023 1023
				1023 1023 1023 1023 1023 1023 1023 1023 1023 1023 1023 1023 1023 1023 1023 1023
				1023 1023 1023 1023 1023 1023 1023 1023 1023 1023 1023 1023 1023 1023 1023 1023
				1023 1023 1023 1023 1023 1023 1023 1023 1023 1023 1023 1023 1023 1023 1023 1023
				1023 1023 1023 1023 1023 1023 1023 1023 1023 1023 1023 1023 1023 1023 1023 1023
				1023 1023 1023 1023 1023 1023 1023 1023 1023 1023 1023 1023 1023 1023 1023 1023
				1023 1023 1023 1023 1023 1023 1023 1023 1023 1023 1023 1023 1023 1023 1023 1023
				1023 1023 1023 1023 1023 1023 1023 1023 1023 1023 1023 1023 1023 1023 1023 1023
				1023 1023 1023 1023 1023 1023 1023 1023 1023 1023 1023 1023 1023 1023 1023 1023
				1023 1023 1023 1023 1023 1023 1023 1023 1023 1023 1023 1023 1023 1023 1023 1023
				1023 1023 1023 1023 1023 1023 1023 1023 1023 1023 1023 1023 1023 1023 1023 1023
				1023 1023 1023 1023 1023 1023 1023 1023 1023 1023 1023 1023 1023 1023 1023 1023
				1023 1023 1023 1023 1023 1023 1023 1023 1023 1023 1023 1023 1023 1023 1023 1023
				1023 1023 1023 1023 1023 1023 1023 1023 1023 1023 1023 1023 1023 1023 1023 1023
				1023 1023 1023 1023 1023 1023 1023 1023 1023 1023 1023 1023 1023 1023 1023 1023
				1023 1023 1023 1023 1023 1023 1023 1023 1023 1023 1023 1023 1023 1023 1023 1023
				1023 1023 1023 1023 1023 1023 1023 1023 1023 1023 1023 1023 1023 1023 1023 1023
				1023 1023 1023 1023 1023 1023 1023 1023 1023 1023 1023 1023 1023 1023 1023 1023
				1023 1023 1023 1023 1023 1023 1023 1023 1023 1023 1023 1023 1023 1023 1023 1023
				1023 1023 1023 1023 1023 1023 1023 1023 1023 1023 1023 1023 1023 1023 1023 1023
				1023 1023 1023 1023 1023 1023 1023 1023 1023 1023 1023 1023 1023 1023 1023 1023
				1023 1023 1023 1023 1023 1023 1023 1023 1023 1023 1023 1023 1023 1023 1023 1023
				1023 1023 1023 1023 1023 1023 1023 1023 1023 1023 1023 1023 1023 1023 1023 1023
				1023 1023 1023 1023 1023 1023 1023 1023 1023 1023 1023 1023 1023 1023 1023 1023
				1023 1023 1023 1023 1023 1023 1023 1023 1023 1023 1023 1023 1023 1023 1023 1023
				1023 1023 1023 1023 1023 1023 1023 1023 1023 1023 1023 1023 1023 1023 1023 1023
				1023 1023 1023 1023 1023 1023 1023 1023 1023 1023 1023 1023 1023 1023 1023 1023
				1023 1023 1023 1023 1023 1023 1023 1023 1023 1023 1023 1023 1023 1023 1023 1023
				1023 1023 1023 1023 1023 1023 1023 1023 1023 1023 1023 1023 1023 1023 1023 1023
				1023 1023 1023 1023 1023 1023 1023 1023 1023 1023 1023 1023 1023 1023 1023 1023
				1023 1023 1023 1023 1023 1023 1023 1023 1023 1023 1023 1023 1023 1023 1023 1023
				1023 1023 1023 1023 1023 1023 1023 1023 1023 1023 1023 1023 1023 1023 1023 1023
				1023 1023 1023 1023 1023 1023 1023 1023 1023 1023 1023 1023 1023 1023 1023 1023
				1023 1023 1023 1023 1023 1023 1023 1023 1023 1023 1023 1023 1023 1023 1023 1023
				1023 1023 1023 1023 1023 1023 1023 1023 1023 1023 1023 1023 1023 1023 1023 1023
				1023 1023 1023 1023 1023 1023 1023 1023 1023 1023 1023 1023 1023 1023 1023 1023
				1023 1023 1023 1023 1023 1023 1023 1023 1023 1023 1023 1023 1023 1023 1023 1023
				1023 1023 1023 1023 1023 1023 1023 1023 1023 1023 1023 1023 1023 1023 1023 1023
				1023 1023 1023 1023 1023 1023 1023 1023 1023 1023 1023 1023 1023 1023 1023 1023
				1023 1023 1023 1023 1023 1023 1023 1023 1023 1023 1023 1023 1023 1023 1023 1023
				1023 1023 1023 1023 1023 1023 1023 1023 1023 1023 1023 1023 1023 1023 1023 1023
				1023 1023 1023 1023 1023 1023 1023 1023 1023 1023 1023 1023 1023 1023 1023 1023
				1023 1023 1023 1023 1023 1023 1023 1023 1023 1023 1023 1023 1023 1023 1023 1023
				1023 1023 1023 1023 1023 1023 1023 1023 1023 1023 1023 1023 1023 1023 1023 1023
				1023 1023 1023 1023 1023 1023 1023 1023 1023 1023 1023 1023 1023 1023 1023 1023
				1023 1023 1023 1023 1023 1023 1023 1023 1023 1023 1023 1023 1023 1023 1023 1023
				1023 1023 1023 1023 1023 1023 1023 1023 1023 1023 1023 1023 1023 1023 1023 1023
				1023 1023 1023 1023 1023 1023 1023 1023 1023 1023 1023 1023 1023 1023 1023 1023
				1023 1023 1023 1023 1023 1023 1023 1023 1023 1023 1023 1023 1023 1023 1023 1023
				1023 1023 1023 1023 1023 1023 1023 1023 1023 1023 1023 1023 1023 1023 1023 1023
				1023 1023 1023 1023 1023 1023 1023 1023 1023 1023 1023 1023 1023 1023 1023 1023
				1023 1023 1023 1023 1023 1023 1023 1023 1023 1023 1023 1023 1023 1023 1023 1023
				1023 1023 1023 1023 1023 1023 1023 1023 1023 1023 1023 1023 1023 1023 1023 1023
				1023 1023 1023 1023 1023 1023 1023 1023 1023 1023 1023 1023 1023 1023 1023 1023
				1023 1023 1023 1023 1023 1023 1023 1023 1023 1023 1023 1023 1023 1023 1023 1023
				1023 1023 1023 1023 1023 1023 1023 1023 1023 1023 1023 1023 1023 1023 1023 1023
				1023 1023 1023 1023 1023 1023 1023 1023 1023 1023 1023 1023 1023 1023 1023 1023
				1023 1023 1023 1023 1023 1023 1023 1023 1023 1023 1023 1023 1023 1023 1023 1023
				1023 1023 1023 1023 1023 1023 1023 1023 1023 1023 1023 1023 1023 1023 1023 1023
				1023 1023 1023 1023 1023 1023 1023 1023 1023 1023 1023 1023 1023 1023 1023 1023
				1023 1023 1023 1023 1023 1023 1023 1023 1023 1023 1023 1023 1023 1023 1023 1023
				1023 1023 1023 1023 1023 1023 1023 1023 1023 1023 1023 1023 1023 1023 1023 1023
				1023 1023 1023 1023 1023 1023 1023 1023 1023 1023 1023 1023 1023 1023 1023 1023
				1023 1023 1023 1023 1023 1023 1023 1023 1023 1023 1023 1023 1023 1023 1023 1023
				1023 1023 1023 1023 1023 1023 1023 1023 1023 1023 1023 1023 1023 1023 1023 1023
				1023 1023 1023 1023 1023 1023 1023 1023 1023 1023 1023 1023 1023 1023 1023 1023
				1023 1023 1023 1023 1023 1023 1023 1023 1023 1023 1023 1023 1023 1023 1023 1023
				1023 1023 1023 1023 1023 1023 1023 1023 1023 1023 1023 1023 1023 1023 1023 1023
				1023 1023 1023 1023 1023 1023 1023 1023 1023 1023 1023 1023 1023 1023 1023 1023
				1023 1023 1023 1023 1023 1023 1023 1023 1023 1023 1023 1023 1023 1023 1023 1023
				1023 1023 1023 1023 1023 1023 1023 1023 1023 1023 1023 1023 1023 1023 1023 1023
				1023 1023 1023 1023 1023 1023 1023 1023 1023 1023 1023 1023 1023 1023 1023 1023
				1023 1023 1023 1023 1023 1023 1023 1023 1023 1023 1023 1023 1023 1023 1023 1023
				1023 1023 1023 1023 1023 1023 1023 1023 1023 1023 1023 1023 1023 1023 1023 1023
				1023 1023 1023 1023 1023 1023 1023 1023 1023 1023 1023 1023 1023 1023 1023 1023
				1023 1023 1023 1023 1023 1023 1023 1023 1023 1023 1023 1023 1023 1023 1023 1023
				1023 1023 1023 1023 1023 1023 1023 1023 1023 1023 1023 1023 1023 1023 1023 1023
				1023 1023 1023 1023 1023 1023 1023 1023 1023 1023 1023 1023 1023 1023 1023 1023
				1023 1023 1023 1023 1023 1023 1023 1023 1023 1023 1023 1023 1023 1023 1023 1023
				1023 1023 1023 1023 1023 1023 1023 1023 1023 1023 1023 1023 1023 1023 1023 1023
				1023 1023 1023 1023 1023 1023 1023 1023 1023 1023 1023 1023 1023 1023 1023 1023
				1023 1023 1023 1023 1023 1023 1023 1023 1023 1023 1023 1023 1023 1023 1023 1023
				1023 1023 1023 1023 1023 1023 1023 1023 1023 1023 1023 1023 1023 1023 1023 1023
				1023 1023 1023 1023 1023 1023 1023 1023 1023 1023 1023 1023 1023 1023 1023 1023
				1023 1023 1023 1023 1023 1023 1023 1023 1023 1023 1023 1023 1023 1023 1023 1023
				1023 1023 1023 1023 1023 1023 1023 1023 1023 1023 1023 1023 1023 1023 1023 1023
				1023 1023 1023 1023 1023 1023 1023 1023 1023 1023 1023 1023 1023 1023 1023 1023
				1023 1023 1023 1023 1023 1023 1023 1023 1023 1023 1023 1023 1023 1023 1023 1023
				1023 1023 1023 1023 1023 1023 1023 1023 1023 1023 1023 1023 1023 1023 1023 1023
				1023 1023 1023 1023 1023 1023 1023 1023 1023 1023 1023 1023 1023 1023 1023 1023
				1023 1023 1023 1023 1023 1023 1023 1023 1023 1023 1023 1023 1023 1023 1023 1023
				1023 1023 1023 1023 1023 1023 1023 1023 1023 1023 1023 1023 1023 1023 1023 1023
				1023 1023 1023 1023 1023 1023 1023 1023 1023 1023 1023 1023 1023 1023 1023 1023
				1023 1023 1023 1023 1023 1023 1023 1023 1023 1023 1023 1023 1023 1023 1023 1023
				1023 1023 1023 1023 1023 1023 1023 1023 1023 1023 1023 1023 1023 1023 1023 1023
				1023 1023 1023 1023 1023 1023 1023 1023 1023 1023 1023 1023 1023 1023 1023 1023
				1023 1023 1023 1023 1023 1023 1023 1023 1023 1023 1023 1023 1023 1023 1023 1023
				1023 1023 1023 1023 1023 1023 1023 1023 1023 1023 1023 1023 1023 1023 1023 1023
				1023 1023 1023 1023 1023 1023 1023 1023 1023 1023 1023 1023 1023 1023 1023 1023
				1023 1023 1023 1023 1023 1023 1023 1023 1023 1023 1023 1023 1023 1023 1023 1023
				1023 1023 1023 1023 1023 1023 1023 1023 1023 1023 1023 1023 1023 1023 1023 1023
				1023 1023 1023 1023 1023 1023 1023 1023 1023 1023 1023 1023 1023 1023 1023 1023
				1023 1023 1023 1023 1023 1023 1023 1023 1023 1023 1023 1023 1023 1023 1023 1023
				1023 1023 1023 1023 1023 1023 1023 1023 1023 1023 1023 1023 1023 1023 1023 1023
				1023 1023 1023 1023 1023 1023 1023 1023 1023 1023 1023 1023 1023 1023 1023 1023
				1023 1023 1023 1023 1023 1023 1023 1023 1023 1023 1023 1023 1023 1023 1023 1023
				1023 1023 1023 1023 1023 1023 1023 1023 1023 1023 1023 1023 1023 1023 1023 1023
				1023 1023 1023 1023 1023 1023 1023 1023 1023 1023 1023 1023 1023 1023 1023 1023
				1023 1023 1023 1023 1023 1023 1023 1023 1023 1023 1023 1023 1023 1023 1023 1023
				1023 1023 1023 1023 1023 1023 1023 1023 1023 1023 1023 1023 1023 1023 1023 1023
				1023 1023 1023 1023 1023 1023 1023 1023 1023 1023 1023 1023 1023 1023 1023 1023
				1023 1023 1023 1023 1023 1023 1023 1023 1023 1023 1023 1023 1023 1023 1023 1023
				1023 1023 1023 1023 1023 1023 1023 1023 1023 1023 1023 1023 1023 1023 1023 1023
				1023 1023 1023 1023 1023 1023 1023 1023 1023 1023 1023 1023 1023 1023 1023 1023
				1023 1023 1023 1023 1023 1023 1023 1023 1023 1023 1023 1023 1023 1023 1023 1023
				1023 1023 1023 1023 1023 1023 1023 1023 1023 1023 1023 1023 1023 1023 1023 1023>;

		qcom,mdss-dsi-display-timings {
			timing@0 {
				cell-index = <0>;
				qcom,mdss-dsi-panel-framerate = <120>;
				qcom,mdss-dsi-panel-width = <1080>;
				qcom,mdss-dsi-panel-height = <2400>;
				qcom,mdss-dsi-h-front-porch = <32>;
				qcom,mdss-dsi-h-back-porch = <32>;
				qcom,mdss-dsi-h-pulse-width = <32>;
				qcom,mdss-dsi-h-sync-skew = <0>;
				qcom,mdss-dsi-v-back-porch = <20>;
				qcom,mdss-dsi-v-front-porch = <528>;
				qcom,mdss-dsi-v-pulse-width = <4>;
				qcom,mdss-dsi-h-left-border = <0>;
				qcom,mdss-dsi-h-right-border = <0>;
				qcom,mdss-dsi-v-top-border = <0>;
				qcom,mdss-dsi-v-bottom-border = <0>;

				qcom,mdss-dsi-on-command = [
						39 01 00 00 00 00 03 F0 AA 10
						39 01 00 00 00 00 17 D0 84 34 70 14 20 00 39 0D 22 19 00 00 0D 32 19 00 00 0B 04 04 22 22

						39 01 00 00 00 00 02 03 01
						39 01 00 00 00 00 02 35 00
						39 01 00 00 00 00 02 53 20
						39 01 00 00 00 00 03 51 00 00
						39 01 00 00 00 00 02 59 09
						39 01 00 00 00 00 02 6F 01
						39 01 00 00 00 00 02 6C 01
						39 01 00 00 00 00 02 62 00
						39 01 00 00 00 00 02 6D 00

						39 01 00 00 00 00 5F 70 11 00 00 AB 30 80 09 60 04 38 00 0C 02 1C 02 1C 02 00 02 0E 00 20 01 1F 00 07 00 0C 08 BB 08 7A 18 00 10 F0 07 10 20 00 06 0F 0F 33 0E 1C 2A 38 46 54 62 69 70 77 79 7B 7D 7E 02 02 22 00 2A 40 2A BE 3A FC 3A FA 3A F8 3B 38 3B 78 3B B6 4B B6 4B F4 4B F4 6C 34 84 74 00 00 00 00 00 00

						39 01 00 00 00 00 03 F0 AA 12
						39 01 00 00 00 00 02 65 10
						39 01 00 00 00 00 02 D9 2D

						39 01 00 00 00 00 03 F0 AA 13
						39 01 00 00 00 00 07 C5 02 AE 02 78 03 2C

						39 01 00 00 00 00 03 FF 5A 80
						39 01 00 00 00 00 02 65 0E
						39 01 00 00 00 00 02 F9 B9
						39 01 00 00 00 00 02 65 0A
						39 01 00 00 00 00 02 F9 A8

						39 01 00 00 00 00 03 FF 5A 81
						39 01 00 00 00 00 02 65 08
						39 01 00 00 00 00 03 F6 51 44

						39 01 00 00 00 00 03 FF 5A 81
						39 01 00 00 00 00 02 65 03
						39 01 00 00 00 00 02 F4 03

						05 01 00 00 50 00 01 11

						39 01 00 00 00 00 03 FF 5A 81
						39 01 00 00 00 00 02 F3 08

						39 01 00 00 00 00 03 FF 5A 00
						39 01 00 00 00 00 03 F0 AA 00

						05 01 00 00 00 00 01 29

						39 01 00 00 00 00 03 F0 AA 12
						39 01 00 00 00 00 02 65 10
						39 01 00 00 00 00 02 D9 0F
				];

				qcom,mdss-dsi-off-command = [
						05 01 00 00 00 00 01 28
						39 01 00 00 05 00 02 6C 02
						05 01 00 00 3C 00 01 10];
				qcom,mdss-dsi-on-command-state = "dsi_lp_mode";
				qcom,mdss-dsi-off-command-state = "dsi_lp_mode";
				qcom,mdss-dsi-h-sync-pulse = <0>;
				qcom,compression-mode = "dsc";
				qcom,mdss-dsc-slice-height = <12>;
				qcom,mdss-dsc-slice-width = <540>;
				qcom,mdss-dsc-slice-per-pkt = <2>;
				qcom,mdss-dsc-bit-per-component = <10>;
				qcom,mdss-dsc-bit-per-pixel = <8>;
				qcom,mdss-dsc-block-prediction-enable;

				qcom,mdss-dsi-dfps-60-command = [
						39 00 00 40 00 00 02 6C 00
						39 01 00 00 00 00 02 62 00];
				qcom,mdss-dsi-dfps-60-command-state = "dsi_hs_mode";

				qcom,mdss-dsi-dfps-90-command = [
						39 00 00 40 00 00 02 6C 01
						39 00 00 40 00 00 02 62 01
						39 00 00 40 00 00 03 F0 AA 10
						39 01 00 00 00 00 0E B1 01 54 00 18 0D 98 00 01 54 00 18 05 E8];
				qcom,mdss-dsi-dfps-90-command-state = "dsi_hs_mode";

				qcom,mdss-dsi-dfps-120-command = [
						39 00 00 40 00 00 02 6C 01
						39 00 00 40 00 00 02 62 00
						39 00 00 40 00 00 03 F0 AA 10
						39 01 00 00 00 00 0E B1 01 54 00 18 0D 98 00 01 54 00 18 02 10];
				qcom,mdss-dsi-dfps-120-command-state = "dsi_hs_mode";

			};
		};
	};
};
