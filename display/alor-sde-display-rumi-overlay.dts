// SPDX-License-Identifier: BSD-3-Clause
/*
 * Copyright (c) Qualcomm Technologies, Inc. and/or its subsidiaries.
 */

/dts-v1/;
/plugin/;

#include "alor-sde-display-rumi.dtsi"

/ {
	model = "Qualcomm technologies, Inc. ALOR RUMI";
	compatible = "qcom,alor-rumi", "qcom,alor", "qcom,rumi";
	qcom,msm-id = <685 0x10000>, <727 0x10000>;
	qcom,board-id = <15 0>;
};
