// SPDX-License-Identifier: BSD-3-Clause
/*
 * Copyright (c) Qualcomm Technologies, Inc. and/or its subsidiaries.
 */

/dts-v1/;
/plugin/;

#include "kera-sde.dtsi"

/ {
	qcom,msm-id = <686 0x10000>, <659 0x10000>;
	qcom,board-id = <0 0>;
};
