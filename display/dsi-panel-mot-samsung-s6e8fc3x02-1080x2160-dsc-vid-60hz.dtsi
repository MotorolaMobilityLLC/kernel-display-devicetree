&mdss_mdp {
	mot_samsung_s6e8fc3x02_1080x2160_dsc_vid_60hz: qcom,mdss_dsi_mot_samsung_s6e8fc3x02_1080x2160_dsc_vid_60hz {
		qcom,mdss-dsi-panel-name =
		 "s6e8fc3x02 amoled cmd mode dsi samsung panel with DSC";
		qcom,mdss-dsi-panel-type = "dsi_video_mode";
		qcom,mdss-dsi-panel-physical-type = "oled";
		qcom,dsi-ctrl-num = <0>;
		qcom,dsi-phy-num = <0>;
		//qcom,cont-splash-enabled;
		//qcom,mdss-dsi-dma-schedule-line = <15>;
		qcom,mdss-dsi-virtual-channel-id = <0>;
		qcom,mdss-dsi-stream = <0>;
		qcom,mdss-pan-physical-width-dimension = <61>;
		qcom,mdss-pan-physical-height-dimension = <122>;
		qcom,mdss-dsi-bpp = <24>;
		qcom,mdss-dsi-border-color = <0>;
		qcom,mdss-dsi-h-sync-pulse = <0>;
		qcom,mdss-dsi-traffic-mode = "burst_mode";
		qcom,mdss-dsi-lane-map = "lane_map_0123";
		qcom,mdss-dsi-bllp-eof-power-mode;
		qcom,mdss-dsi-bllp-power-mode;
		qcom,mdss-dsi-tx-eot-append;
		qcom,mdss-dsi-lane-0-state;
		qcom,mdss-dsi-lane-1-state;
		qcom,mdss-dsi-lane-2-state;
		qcom,mdss-dsi-lane-3-state;
		qcom,mdss-dsi-dma-trigger = "trigger_sw";
		qcom,mdss-dsi-mdp-trigger = "none";
		qcom,mdss-dsi-lp11-init;
		qcom,mdss-dsi-hbm-on-command = [39 01 00 00 00 00 03 51 0D BB];
		qcom,mdss-dsi-hbm-off-command = [39 01 00 00 00 00 03 51 0D BA];
		qcom,mdss-dsi-hbm-on-command-state =  "dsi_lp_mode";
		qcom,mdss-dsi-hbm-off-command-state =  "dsi_lp_mode";
		qcom,mdss-dsi-reset-sequence = <1 10>, <0 10>, <1 10>;
		//qcom,mdss-dsi-te-using-wd;
		//qcom,sde-has-idle-pc;
		qcom,mdss-dsi-pcd-check;
		qcom,mdss-bl-lvl-formula;
		qcom,mdss-dsi-display-timings {
			timing@0 {
			 qcom,mdss-dsi-panel-width = <1080>;
			 qcom,mdss-dsi-panel-height = <2160>;
			 qcom,mdss-dsi-h-front-porch = <76>;
			 qcom,mdss-dsi-h-back-porch = <51>;
			 qcom,mdss-dsi-h-pulse-width = <33>;
			 qcom,mdss-dsi-h-sync-skew = <0>;
			 qcom,mdss-dsi-v-back-porch = <10>;
			 qcom,mdss-dsi-v-front-porch = <2308>;
			 qcom,mdss-dsi-v-pulse-width = <2>;
			 qcom,mdss-dsi-panel-framerate = <60>;
			 qcom,mdss-dsi-on-command = [
				39 01 00 00 00 00 03 9F A5 A5
				15 01 00 00 14 00 02 11 00
				39 01 00 00 00 00 03 9F 5A 5A
				//te OPEN
			 	39 01 00 00 00 00 03 9F A5 A5
				15 01 00 00 00 00 02 35 00
				39 01 00 00 00 00 03 9F 5A 5A

				//Freq setting
				39 01 00 00 00 00 03 F0 5A 5A
				39 01 00 00 00 00 03 F1 5A 5A
				39 01 00 00 00 00 02 60 21
				39 01 00 00 00 00 04 B0 00 0B F2
				39 01 00 00 00 00 03 F2 00 44
				39 01 00 00 00 00 04 B0 01 9E B2
				39 01 00 00 00 00 0F B2 08 C0 08 5B 08 5B 07 F5 07 90 07 2C 06 61
				39 01 00 00 00 00 13 B3 05 97 04 CE 04 05 03 3C 02 70 01 42 00 14 00 14 00 14
				39 01 00 00 00 00 02 F7 0B
				39 01 00 00 00 00 03 F1 A5 A5
				39 01 00 00 00 00 03 F0 A5 A5

				//VINT VOLTAGE CONTROL
				39 01 00 00 00 00 03 F0 5A 5A
				39 01 00 00 00 00 03 FC 5A 5A
				39 01 00 00 00 00 04 B0 00 11 FE
				39 01 00 00 00 00 02 FE 00
				39 01 00 00 00 00 03 F0 A5 A5
				39 01 00 00 00 00 03 FC A5 A5

				//DSC SETTING
				15 01 00 00 00 00 02 9D 00
				39 01 00 00 00 00 5A 9E 11 00 00 89 30 80 08 70 04 38 00 28 02 1C 02 1C 02 00 02 0E 00 20 03 DD 00 07 00 0C 02 77 02 8B 18 00 10 F0 03 0C 20 00 06 0B 0B 33 0E 1C 2A 38 46 54 62 69 70 77 79 7B 7D 7E 01 02 01 00 09 40 09 BE 19 FC 19 FA 19 F8 1A 38 1A 78 1A B6 2A F6 2B 34 2B 74 3B 74 6B F4 00

				//diming setting
				39 01 00 00 00 00 03 F0 5A 5A
				39 01 00 00 00 00 02 53 20
				39 01 00 00 00 00 03 51 00 00
				39 01 00 00 00 00 03 F0 A5 A5
				39 01 00 00 00 00 03 F0 5A 5A
				39 01 00 00 00 00 04 B0 00 0D B2
				39 01 00 00 00 00 02 B2 01
				39 01 00 00 00 00 04 B0 00 0C B2
				39 01 00 00 00 00 02 B2 30
				39 01 00 00 00 00 03 F0 A5 A5
				39 01 00 00 00 00 03 F0 5A 5A
				39 01 00 00 00 00 04 B0 00 89 B1
				39 01 00 00 00 00 02 B1 2F
				39 01 00 00 00 00 03 F0 A5 A5
				39 01 00 00 00 00 03 9F A5 A5
				15 01 00 00 70 00 02 29 00
				39 01 00 00 00 00 03 9F 5A 5A

				];
			 qcom,mdss-dsi-on-command-state = "dsi_lp_mode";
			 qcom,mdss-dsi-off-command = [
				 05 01 00 00 32 00 01 28
				 05 01 00 00 50 00 01 10];
			 qcom,mdss-dsi-off-command-state = "dsi_hs_mode";

			qcom,mdss-dsi-hbm-on-command = [39 01 00 00 00 00 03 51 0D BB];
			qcom,mdss-dsi-hbm-off-command = [39 01 00 00 00 00 03 51 0D BA];
			qcom,mdss-dsi-hbm-on-command-state =  "dsi_lp_mode";
			qcom,mdss-dsi-hbm-off-command-state =  "dsi_lp_mode";

			};
		};
	};
};
