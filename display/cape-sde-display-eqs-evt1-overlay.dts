/dts-v1/;
/plugin/;

#include "cape-sde-display-eqs-common.dtsi"

/ {
	model = "eqs";
	compatible = "qcom,cape-mtp", "qcom,cape", "qcom,mtp", "moto,eqs";
	qcom,msm-id = <530 0x10000>, <531 0x10000>, <540 0x10000>;
	qcom,board-id = <0x41 0xA100>, <0x41 0xA200>, <0x41 0xB1A1>, <0x41 0xB1B1>,
                    <0x41 0xB2A1>, <0x41 0xB2B1>, <0x41 0xB2B3>, <0x41 0xC1A0>;
};
