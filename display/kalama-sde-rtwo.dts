/dts-v1/;
/plugin/;

#include "kalama-sde.dtsi"

/ {
	qcom,msm-id = <519 0x10000>, <536 0x10000>;
	qcom,board-id = <0 0>;
};

/* Can not do delete-property in overlay dtsi, have to add kalama-sde-rtwo file */
&sde_dp {

	//mmi,aux-switch-enable-gpio = <&tlmm 2 0x00>;
	//mmi,aux-switch-flip-gpio = <&tlmm 71 0x00>;

       /delete-property/ qcom,mst-enable;
};
