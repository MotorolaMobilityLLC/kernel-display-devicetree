// SPDX-License-Identifier: BSD-3-Clause
/*
 * Copyright (c) Qualcomm Technologies, Inc. and/or its subsidiaries.
 */

/dts-v1/;
/plugin/;

#include "tuna-sde-display-rumi.dtsi"

/ {
	model = "Qualcomm Technologies, Inc. Tuna RUMI";
	compatible = "qcom,tuna-rumi", "qcom,tuna", "qcom,rumi";
	qcom,msm-id = <655 0x10000>, <694 0x10000>;
	qcom,board-id = <15 0>;
};
