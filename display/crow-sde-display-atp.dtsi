#include "crow-sde-display-idp.dtsi"

&qupv3_se0_i2c {
	goodix-berlin@5d {
		panel = <&dsi_vtdr6130_amoled_cmd
			&dsi_vtdr6130_amoled_video
			&dsi_vtdr6130_amoled_120hz_cmd
			&dsi_vtdr6130_amoled_120hz_video
			&dsi_vtdr6130_amoled_qsync_144hz_cmd
			&dsi_vtdr6130_amoled_qsync_144hz_video
			&dsi_vtdr6130_amoled_90hz_video>;
	};
};

&spmi_bus {
	pm7550ba_amoled_ecm {
		display-panels = <&dsi_vtdr6130_amoled_cmd
				 &dsi_vtdr6130_amoled_video
				 &dsi_vtdr6130_amoled_120hz_cmd
				 &dsi_vtdr6130_amoled_120hz_video
				 &dsi_vtdr6130_amoled_qsync_144hz_cmd
				 &dsi_vtdr6130_amoled_qsync_144hz_video
				 &dsi_vtdr6130_amoled_90hz_video>;
	};
};
