// SPDX-License-Identifier: BSD-3-Clause
/*
 * Copyright (c) Qualcomm Technologies, Inc. and/or its subsidiaries.
 */

/dts-v1/;
/plugin/;

#include "trustedvm-canoe-sde.dtsi"
#include "trustedvm-canoe-sde-display-mtp.dtsi"

/ {
	model = "Qualcomm Technologies, Inc. Canoe MTP - TrustedVM";
	compatible = "qcom,canoe-mtp", "qcom,canoe", "qcom,canoep-cdp", "qcom,canoep",
			   "qcom,mtp";
	qcom,msm-id = <660 0x10000>, <660 0x20000>, <661 0x10000>, <661 0x20000>,
		      <0x1000294 0x10000>, <0x1000294 0x20000>,
		      <0x1000295 0x10000>, <0x1000295 0x20000>;
	qcom,board-id = <8 0>;
};
