/dts-v1/;
/plugin/;

#include "crow-sde-display-idps.dtsi"

/ {
	model = "Qualcomm Technologies, Inc. Crow IDPS";
	compatible = "qcom,crow-idp", "qcom,crow", "qcom,idp";
	qcom,msm-id = <608 0x10000>;
	qcom,board-id = <34 4>;
};
