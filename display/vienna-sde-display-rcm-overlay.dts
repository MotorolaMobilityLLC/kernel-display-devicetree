// SPDX-License-Identifier: BSD-3-Clause
/*
 * Copyright (c) Qualcomm Technologies, Inc. and/or its subsidiaries.
 */

/dts-v1/;
/plugin/;

#include "vienna-sde-display.dtsi"
#include "vienna-sde-display-rcm.dtsi"

/ {
	model = "Qualcomm Technologies, Inc. Vienna RCM";
	compatible = "qcom,vienna-rcm", "qcom,vienna", "qcom,rcm";
	qcom,msm-id = <669 0x10000>, <670 0x10000>;
	qcom,board-id = <0x10015 0x0>, <0x10015 0x01>;
};
