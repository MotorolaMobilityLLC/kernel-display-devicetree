/dts-v1/;
/plugin/;

#include "waipio-sde-display-hiphi-common.dtsi"

/ {
	model = "hiphi";
	compatible = "qcom,waipio-mtp", "qcom,waipio", "qcom,mtp", "moto,hiphi";
	qcom,msm-id = <457 0x10000>, <482 0x10000>;
	qcom,board-id = <0x47 0x9100>;
};
