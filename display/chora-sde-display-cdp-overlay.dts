// SPDX-License-Identifier: BSD-3-Clause
/*
 * Copyright (c) Qualcomm Technologies, Inc. and/or its subsidiaries.
 */

/dts-v1/;
/plugin/;

#include "chora-sde-display-cdp.dtsi"

/ {
	model = "Qualcomm Technologies, Inc. Chora CDP evros";
	compatible = "qcom,chora-cdp", "qcom,chora", "qcom,cdp";
	qcom,msm-id = <724 0x10000>, <744 0x10000>;
	qcom,board-id = <0x10001 0x0>, <0x20001 0x0>, <0x10101 0x0>;
};
