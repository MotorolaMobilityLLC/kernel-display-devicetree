/dts-v1/;
/plugin/;
#define RTWO_RADIO_ATT 1
#include "khaje-sde-display-fogona-common.dtsi"
#include "khaje-fogona-touchscreen-overlay.dtsi"
/ {
	model = "fogona";
	compatible = "qcom,khaje-idp", "qcom,khaje", "qcom,idp", "mot,fogona";
	qcom,msm-id = <518 0x10000>, <585 0x10000>, <586 0x10000>;
	qcom,board-id = <(RTWO_RADIO_ATT << 8 | 0x41) 0xB100>,<(RTWO_RADIO_ATT << 8 | 0x41) 0xB200>,<(RTWO_RADIO_ATT << 8 | 0x41) 0xA200>,<(RTWO_RADIO_ATT << 8 | 0x41) 0xC000>;
	//qcom,pmic-id = <0x2D 0x0 0x0 0x0>;
};
