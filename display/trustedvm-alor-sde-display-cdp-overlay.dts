// SPDX-License-Identifier: BSD-3-Clause
/*
 * Copyright (c) Qualcomm Technologies, Inc. and/or its subsidiaries.
 */

/dts-v1/;
/plugin/;

#include "trustedvm-alor-sde.dtsi"
#include "trustedvm-alor-sde-display-cdp.dtsi"

/ {
	model = "Qualcomm Technologies, Inc. Alor SVM CDP";
	compatible = "qcom,alor-cdp", "qcom,alor", "qcom,alorp-cdp",
			"qcom,alorp", "qcom,cdp";
	qcom,msm-id = <685 0x10000>, <727 0x10000>;
	qcom,board-id = <0x10001 0>, <0x20001 0>;
};
