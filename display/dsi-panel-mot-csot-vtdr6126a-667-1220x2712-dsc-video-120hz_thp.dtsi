/* Copyright (c) 2019-2025, The Linux Foundation. All rights reserved.
 *
 * This program is free software; you can redistribute it and/or modify
 * it under the terms of the GNU General Public License version 2 and
 * only version 2 as published by the Free Software Foundation.
 *
 * This program is distributed in the hope that it will be useful,
 * but WITHOUT ANY WARRANTY; without even the implied warranty of
 * MERCHANTABILITY or FITNESS FOR A PARTICULAR PURPOSE.  See the
 * GNU General Public License for more details.
 */
&mdss_mdp {
	mot_csot_vtdr6126a_667_1220p_dsc_vid_120hz_thp: qcom,mdss_dsi_mot_csot_vtdr6126a_667_120hz_dsc_vid_thp {
		qcom,mdss-dsi-panel-name = "mipi_mot_vid_csot_1220p_dsc_667";
		qcom,mdss-dsi-panel-supplier = "csot";
		qcom,mdss-dsi-panel-type = "dsi_video_mode";
		qcom,mdss-dsi-panel-physical-type = "oled";
		qcom,dsi-ctrl-num = <0>;
		qcom,dsi-phy-num = <0>;
		qcom,mdss-dsi-virtual-channel-id = <0>;
		qcom,mdss-dsi-stream = <0>;
		qcom,mdss-pan-physical-width-dimension = <69>;
		qcom,mdss-pan-physical-height-dimension = <154>;
		qcom,mdss-dsi-bpp = <30>;
		qcom,mdss-dsi-underflow-color = <0xff>;
		qcom,mdss-dsi-border-color = <0>;

		qcom,mdss-dsi-traffic-mode = "non_burst_sync_event";
		qcom,mdss-dsi-bllp-eof-power-mode;
		qcom,mdss-dsi-bllp-power-mode;
		qcom,mdss-dsi-lp11-init;
		qcom,mdss-dsi-lane-0-state;
		qcom,mdss-dsi-lane-1-state;
		qcom,mdss-dsi-lane-2-state;
		qcom,mdss-dsi-lane-3-state;
		qcom,mdss-dsi-dma-trigger = "trigger_sw";
		qcom,mdss-dsi-mdp-trigger = "none";
		qcom,mdss-dsi-reset-sequence = <1 2>, <0 5>, <1 25>;

		qcom,mdss-dsi-dc-on-command = [
				39 00 00 00 00 00 02 5E 01];
		qcom,mdss-dsi-dc-on-command-state = "dsi_hs_mode";

		qcom,mdss-dsi-dc-off-command = [
				39 00 00 00 00 00 02 5E 00];
		qcom,mdss-dsi-dc-off-command-state = "dsi_hs_mode";

		qcom,mdss-dsi-hbm-on-command = [
				39 00 00 40 00 00 02 62 00
				39 00 00 00 00 00 03 51 3E 80];
		qcom,mdss-dsi-hbm-on-command-state = "dsi_hs_mode";

		qcom,mdss-dsi-hbm-off-command = [
				39 00 00 40 00 00 02 62 00
				39 00 00 00 00 00 03 51 2C 50];
		qcom,mdss-dsi-hbm-off-command-state = "dsi_hs_mode";

		qcom,mdss-dsi-hbm-fod;
		qcom,mdss-dsi-hbm-fod-on-command = [
				39 00 00 40 00 00 03 F0 AA 13
				39 00 00 40 00 00 19 C5 02 AC 02 6D 03 27 02 AC 02 6D 03 27 02 AC 02 6D 03 28 02 AE 02 6F 03 2A
				39 00 00 40 00 00 05 63 10 00 1D 24
				39 00 00 00 00 00 02 62 03];
		qcom,mdss-dsi-hbm-fod-on-command-state = "dsi_hs_mode";

		qcom,mdss-dsi-panel-local-hbm-enabled;
		qcom,mdss-dsi-panel-local-hbm-DC-HYBIRD-THRESHOLD-BL = <7459>;
		qcom,mdss-dsi-panel-local-hbm-alpha-register = <0x63>;
		qcom,mdss-dsi-panel-local-hbm-alpha-size = <16001>;
		qcom,mdss-dsi-panel-local-hbm-DDIC-type = <0x6126>;

		qcom,mdss-dsi-display-timings {
			timing@0 {
				cell-index = <0>;
				qcom,mdss-dsi-panel-framerate = <120>;
				qcom,mdss-dsi-panel-width = <1220>;
				qcom,mdss-dsi-panel-height = <2712>;
				qcom,mdss-dsi-h-front-porch = <26>;
				qcom,mdss-dsi-h-back-porch = <16>;
				qcom,mdss-dsi-h-pulse-width = <16>;
				qcom,mdss-dsi-h-sync-skew = <0>;
				qcom,mdss-dsi-h-sync-pulse = <0>;
				qcom,mdss-dsi-v-back-porch = <18>;
				qcom,mdss-dsi-v-front-porch = <604>;
				qcom,mdss-dsi-v-pulse-width = <2>;
				qcom,mdss-dsi-h-left-border = <0>;
				qcom,mdss-dsi-h-right-border = <0>;
				qcom,mdss-dsi-v-top-border = <0>;
				qcom,mdss-dsi-v-bottom-border = <0>;
				qcom,mdss-dsi-on-command = [
					39 00 00 00 00 00 05 2A 00 00 04 C3
					39 00 00 00 00 00 05 2B 00 00 05 87

					39 00 00 00 00 00 02 A4 01
					39 00 00 00 00 00 01 38
					39 00 00 00 00 00 02 6F 01
					39 00 00 00 00 00 02 A4 00

					39 00 00 00 00 00 02 03 01
					39 00 00 00 00 00 02 35 00
					39 00 00 00 00 00 02 53 20
					39 00 00 00 00 00 02 59 00
					39 00 00 00 00 00 03 51 00 00
					39 00 00 00 00 00 02 72 00
					39 00 00 00 00 00 02 5E 00
					39 00 00 00 00 00 02 6F 01
					39 00 00 00 00 00 02 6C 01

					39 00 00 00 00 00 1A 70 11 00 00 AB 30 80 0A 98 04 C4 00 0C 02 62 02 62 02 00 01 1A 00 20 02 5B 00
					39 00 00 00 00 00 02 65 19
					39 00 00 00 00 00 1A 70 08 00 01 00 BB 07 7B 18 00 10 F0 07 10 20 00 06 0F 0F 33 0E 1C 2A 38 46 54
					39 00 00 00 00 00 02 65 32
					39 00 00 00 00 00 1A 70 62 69 70 77 79 7B 7D 7E 02 02 22 00 2A 40 2A BE 3A FC 3A FA 3A F8 3B 38 3B
					39 00 00 00 00 00 02 65 4B
					39 00 00 00 00 00 14 70 78 3B B6 4B B6 4B F4 4B F4 6C 34 84 74 00 00 00 00 00 00

					39 00 00 00 00 00 03 F0 AA 16
					39 00 00 00 00 00 11 D1 00 00 00 00 00 00 00 00 00 00 00 00 00 00 00 00

					39 00 00 00 00 00 03 FF 5A 80
					39 00 00 00 00 00 02 65 0A
					39 00 00 00 00 00 02 F9 1E
					39 00 00 00 00 00 02 65 25
					39 00 00 00 00 00 02 FD 01

					39 00 00 00 00 00 03 FF 5A 81
					39 00 00 00 00 00 02 65 03
					39 00 00 00 00 00 02 F3 61
					39 00 00 00 00 00 02 65 0B
					39 00 00 00 00 00 02 F3 78

					39 00 00 00 00 00 03 FF 5A 83
					39 00 00 00 00 00 02 65 09
					39 00 00 00 00 00 03 F7 10 10
					39 00 00 00 00 00 02 65 0B
					39 00 00 00 00 00 02 F7 03
					39 00 00 00 00 00 03 F0 AA 10
					39 00 00 00 00 00 02 65 09
					39 00 00 00 00 00 02 CF 5B
					39 00 00 00 00 00 02 65 0B
					39 00 00 00 00 00 03 CF FD 79
					39 00 00 00 00 00 03 44 06 8C
					39 00 00 00 00 00 03 FF 5A 00
					39 00 00 00 00 00 03 F0 AA 00
					05 00 00 00 55 00 01 11
					05 00 00 00 00 00 01 29
				];

				qcom,mdss-dsi-off-command = [
					05 00 00 00 11 00 01 28
					05 00 00 00 78 00 01 10];
				qcom,mdss-dsi-on-command-state = "dsi_lp_mode";
				qcom,mdss-dsi-off-command-state = "dsi_lp_mode";
				qcom,compression-mode = "dsc";
				qcom,mdss-dsc-slice-height = <12>;
				qcom,mdss-dsc-slice-width = <610>;
				qcom,mdss-dsc-slice-per-pkt = <2>;
				qcom,mdss-dsc-bit-per-component = <10>;
				qcom,mdss-dsc-bit-per-pixel = <8>;
				qcom,mdss-dsc-block-prediction-enable;

				qcom,mdss-dsi-dfps-60-command = [
						39 00 00 00 00 00 02 6C 03];
				qcom,mdss-dsi-dfps-60-command-state = "dsi_hs_mode";

				qcom,mdss-dsi-dfps-90-command = [
						39 00 00 00 00 00 02 6C 02];
				qcom,mdss-dsi-dfps-90-command-state = "dsi_hs_mode";

				qcom,mdss-dsi-dfps-120-command = [
						39 00 00 00 00 00 02 6C 01];
				qcom,mdss-dsi-dfps-120-command-state = "dsi_hs_mode";
			};
		};
	};
};
