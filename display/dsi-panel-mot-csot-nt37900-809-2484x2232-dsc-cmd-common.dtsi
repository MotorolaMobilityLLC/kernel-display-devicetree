/* Copyright (c) 2019-2020, The Linux Foundation. All rights reserved.
 *
 * This program is free software; you can redistribute it and/or modify
 * it under the terms of the GNU General Public License version 2 and
 * only version 2 as published by the Free Software Foundation.
 *
 * This program is distributed in the hope that it will be useful,
 * but WITHOUT ANY WARRANTY; without even the implied warranty of
 * MERCHANTABILITY or FITNESS FOR A PARTICULAR PURPOSE.  See the
 * GNU General Public License for more details.
 */
&mdss_mdp {
mot_csot_nt37900_809_2484x2232_dsc_cmd: qcom,mdss_dsi_mot_csot_nt37900_809_2484x2232_dsc_cmd {
compatible = "qcom,mdss-dsi-panel";
qcom,mdss-dsi-panel-name = "mipi_mot_cmd_csot_1440p_dsc_809";
qcom,mdss-dsi-panel-supplier = "csot";
qcom,mdss-dsi-panel-type = "dsi_cmd_mode";
qcom,mdss-dsi-virtual-channel-id = <0>;
qcom,mdss-dsi-stream = <0>;
qcom,mdss-pan-physical-width-dimension = <137>;
qcom,mdss-pan-physical-height-dimension = <152>;
qcom,mdss-dsi-bpp = <24>;
qcom,mdss-dsi-underflow-color = <0xff>;
qcom,mdss-dsi-border-color = <0>;

qcom,dsi-ctrl-num = <1>;
qcom,dsi-phy-num = <1>;

qcom,mdss-dsi-traffic-mode = "burst_mode";
qcom,mdss-dsi-bllp-eof-power-mode;
qcom,mdss-dsi-bllp-power-mode;
qcom,mdss-dsi-lane-0-state;
qcom,mdss-dsi-lane-1-state;
qcom,mdss-dsi-lane-2-state;
qcom,mdss-dsi-lane-3-state;

qcom,mdss-dsi-dma-trigger = "trigger_sw";
qcom,mdss-dsi-mdp-trigger = "none";
qcom,mdss-dsi-reset-sequence = <0 3>, <1 1>, <0 1>, <1 20>;
qcom,mdss-dsi-lp11-init;
qcom,mdss-dsi-tx-eot-append;
qcom,mdss-dsi-te-pin-select = <1>;
qcom,mdss-dsi-te-dcs-command = <1>;
qcom,mdss-dsi-te-using-te-pin;

//qcom,bklt-dcs-2bytes-enabled;
qcom,mdss-dsi-bl-min-level = <4>;
qcom,mdss-dsi-bl-max-level = <14056>;
qcom,mdss-dsi-bl-pmic-control-type = "bl_ctrl_dcs";

qcom,mdss-dsi-panel-hdr-enabled;
qcom,mdss-dsi-panel-hdr-color-primaries = <14500 15500 32000
	        17000 15500 30000 8000 3000>;
qcom,mdss-dsi-panel-peak-brightness = <4200000>;

qcom,mdss-dsi-panel-blackness-level = <3230>;

qcom,mdss-dsi-dc-off-command = [
		39 00 00 00 00 00 02 6F 01
		];

qcom,mdss-dsi-dc-off-command-state = "dsi_hs_mode";
qcom,mdss-dsi-dc-on-command = [
		39 00 00 00 00 00 02 6F 01
		];
qcom,mdss-dsi-dc-on-command-state = "dsi_hs_mode";
//qcom,mdss-dsi-nt37705-dc-detect-fps;

qcom,mdss-dsi-display-timings {
	timing@0{
		qcom,mdss-dsi-cmd-mode;
		qcom,mdss-dsi-panel-framerate = <60>;
		qcom,mdss-dsi-panel-width = <2484>;
		qcom,mdss-dsi-panel-height = <2232>;
		qcom,mdss-dsi-h-front-porch = <20>;
		qcom,mdss-dsi-h-back-porch = <20>;
		qcom,mdss-dsi-h-pulse-width = <16>;
		qcom,mdss-dsi-h-sync-skew = <0>;
		qcom,mdss-dsi-h-sync-pulse = <0>;
		qcom,mdss-dsi-v-back-porch = <40>;
		qcom,mdss-dsi-v-front-porch = <32>;
		qcom,mdss-dsi-v-pulse-width = <2>;
		qcom,mdss-dsi-h-left-border = <0>;
		qcom,mdss-dsi-h-right-border = <0>;
		qcom,mdss-dsi-v-top-border = <0>;
		qcom,mdss-dsi-v-bottom-border = <0>;
		qcom,mdss-dsi-timing-switch-command = [
			39 00 00 40 00 00 02 35 00 //TE1=0
		];
		qcom,mdss-dsi-on-command = [
		//Flash  Auto Program Set
		39 00 00 00 00 00 06 F0 55 AA 52 08 04
		39 00 00 40 00 00 02 C2 12	

		//Reload setting
		39 00 00 40 00 00 02 6F 01
		39 00 00 40 00 00 03 B5 00 00

		39 00 00 40 00 00 02 6F 03
		39 00 00 40 00 00 02 B5 07

		39 00 00 40 00 00 02 6F 00
		39 00 00 40 00 00 04 B8 3B 00 00

		39 00 00 40 00 00 02 6F 03
		39 00 00 40 00 00 03 B8 FF DC 

		39 00 00 40 00 00 02 6F 05
		39 00 00 40 00 00 04 B8 3C 00 00

		39 00 00 40 00 00 02 6F 08
		39 00 00 40 00 00 03 B8 FF DC

		39 00 00 40 00 00 02 6F 0A
		39 00 00 40 00 00 04 B8 3D 00 00

		39 00 00 40 00 00 02 6F 0D
		39 00 00 40 00 00 03 B8 FF DC

		39 00 00 40 14 00 02 9D AA

		39 00 00 40 00 00 05 FF AA 55 A5 80

		//VESAOSC=138.5MHz
		39 00 00 40 00 00 02 6F 29
		39 00 00 40 00 00 03 F8 0B B5   

		//DSPOSC=-192MHz 
		39 00 00 40 00 00 02 6F 0D
		39 00 00 40 00 00 03 F8 01 3E   

		//DDIC_POWER_OFF_SEQ
		39 00 00 40 00 00 02 6F 08
		39 00 00 40 00 00 08 F6 70 07 70 70 70 70 70

		// MAFR Line
		39 00 00 40 00 00 02 6F 01
		39 00 00 40 00 00 05 6B 01 E8 05 D0

		39 00 00 40 00 00 05 FF AA 55 A5 81
		39 00 00 40 00 00 02 6F 0A
		39 00 00 40 00 00 02 FD 00

		//TE skip frame mode
		39 00 00 40 00 00 02 6F 0D
		39 00 00 40 00 00 02 FB 80

		//idc_en
		39 00 00 40 00 00 02 6F 0D
		39 00 00 40 00 00 02 FE 83

		//idc_det_dbvth
		39 00 00 40 00 00 02 6F 10
		39 00 00 40 00 00 03 FE 07 FF

		39 00 00 40 00 00 05 FF AA 55 A5 82
		//MIPI Improve
		39 00 00 40 00 00 02 6F 11
		39 00 00 40 00 00 02 F8 0F

		//RM = 1, DM = 0
		39 00 00 40 00 00 02 17 30

		//Normal Gamma
		39 00 00 40 00 00 02 26 00

		//GIR on LIR on
		39 00 00 40 00 00 02 5F 00

		//FCON=0=60Hz
		39 00 00 40 00 00 02 2F 02

		//2484x2232
		39 00 00 40 00 00 05 2A 00 00 09 B3
		39 00 00 40 00 00 05 2B 00 00 08 B7
		39 00 00 40 00 00 02 35 00

		//14bit DBV = 14056  800NIT
		39 00 00 40 00 00 03 51 36 E8

		//idle_dimming_dbv = 16383
		39 00 00 40 00 00 02 6F 04
		39 00 00 40 00 00 03 51 3F FF
		39 00 00 40 00 00 02 53 20

		//TE skip opt
		39 00 00 40 00 00 03 5A 01 01

		//VESA, slice 8 (2-dec  8bit
		39 00 00 40 00 00 03 90 03 43
		39 00 00 40 00 00 13 91 89 28 00 08 C2 00 03 6D 01 01 00 11 0D B7 05 87 10 F0

                05 00 00 00 78 00 01 11
                05 00 00 00 00 00 01 29];	/* display on */
		qcom,mdss-dsi-off-command = [
			05 00 00 00 00 00 01 28		/* display_off */
			05 00 00 00 64 00 01 10];	/* enter sleep mode */

		qcom,mdss-dsi-on-command-state = "dsi_lp_mode";
		qcom,mdss-dsi-off-command-state = "dsi_lp_mode";
		qcom,mdss-dsi-timing-switch-command-state =
			"dsi_hs_mode";
		qcom,compression-mode = "dsc";
		/* Why QCOM doesn't use this, even it used 2 encoder
		 * as for that dsi_sw43404_amoled_cmd, for ex */
		/* qcom,mdss-dsc-encoders = <2>; */
		qcom,mdss-dsc-version = <0x11>;
		qcom,mdss-dsc-slice-height = <8>;
		qcom,mdss-dsc-slice-width = <1242>;
		qcom,mdss-dsc-slice-per-pkt = <2>;
		qcom,mdss-dsc-bit-per-component = <8>;
		qcom,mdss-dsc-bit-per-pixel = <8>;
		qcom,mdss-dsc-block-prediction-enable;
		//qcom,mdss-dsc-novateck-ic;
	};

};

};

};
