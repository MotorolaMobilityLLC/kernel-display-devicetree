// SPDX-License-Identifier: BSD-3-Clause
/*
 * Copyright (c) Qualcomm Technologies, Inc. and/or its subsidiaries.
 */

/dts-v1/;
/plugin/;

#include "trustedvm-alor-sde.dtsi"
#include "trustedvm-alor-sde-display-mtp.dtsi"

/ {
	model = "Qualcomm Technologies, Inc. Alor SVM MTP";
	compatible = "qcom,alor-mtp", "qcom,alor", "qcom,alorp-mtp",
			"qcom,alorp", "qcom,mtp";
	qcom,msm-id = <685 0x10000>, <727 0x10000>;
	qcom,board-id = <0x10008 0>, <0x20008 0>, <0x30008 0>;
};
