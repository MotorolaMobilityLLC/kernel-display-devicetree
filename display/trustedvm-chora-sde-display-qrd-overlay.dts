// SPDX-License-Identifier: BSD-3-Clause
/*
 * Copyright (c) Qualcomm Technologies, Inc. and/or its subsidiaries.
 */

/dts-v1/;
/plugin/;

#include "trustedvm-chora-sde.dtsi"
#include "trustedvm-chora-sde-display-qrd.dtsi"

/ {
	model = "Qualcomm Technologies, Inc. Chora SVM QRD";
	compatible = "qcom,chora-qrd", "qcom,chora", "qcom,qrd";
	qcom,msm-id = <724 0x10000>, <744 0x10000>;
	qcom,board-id = <0x1000b 0x0>, <0x2000b 0x0>;
};
