
/* Copyright (c) 2019-2020, The Linux Foundation. All rights reserved.
 *
 * This program is free software; you can redistribute it and/or modify
 * it under the terms of the GNU General Public License version 2 and
 * only version 2 as published by the Free Software Foundation.
 *
 * This program is distributed in the hope that it will be useful,
 * but WITHOUT ANY WARRANTY; without even the implied warranty of
 * MERCHANTABILITY or FITNESS FOR A PARTICULAR PURPOSE.  See the
 * GNU General Public License for more details.
 */

&mdss_mdp {
mot_csot_nt37705_667_curve_1080x2400_dsc_cmd_v0: qcom,mdss_dsi_mot_csot_nt37705_667_curve_1080x2400_dsc_cmd_v0 {
qcom,mdss-dsi-panel-local-hbm-alpha-table = <
292
292
292
292
292
292
292
292
293
293
293
293
293
293
293
293
293
293
293
293
293
293
293
293
293
293
293
293
293
293
293
293
293
293
293
293
294
294
294
294
294
294
294
294
294
294
294
294
295
295
295
295
295
295
295
295
295
296
296
296
296
296
296
296
296
297
297
297
297
297
297
297
298
298
298
298
298
298
299
299
299
299
299
299
300
300
300
300
300
301
301
301
301
301
302
302
302
302
302
303
303
303
303
304
304
304
304
305
305
305
305
306
306
306
306
307
307
307
307
308
308
308
308
309
309
309
310
310
310
310
311
311
311
312
312
312
313
313
313
314
314
314
315
315
315
316
316
316
317
317
317
318
318
318
319
319
319
320
320
320
321
321
322
322
322
323
323
323
324
324
325
325
325
326
326
327
327
327
328
328
329
329
329
330
330
331
331
332
332
332
333
333
334
334
335
335
335
336
336
337
337
338
338
339
339
339
340
340
341
341
342
342
343
343
344
344
345
345
346
346
347
347
347
348
348
349
349
350
350
351
351
352
352
353
353
354
354
355
355
356
357
357
358
358
359
359
360
360
361
361
362
362
363
363
364
364
365
366
366
367
367
368
368
369
369
370
370
371
372
372
373
373
374
374
375
376
376
377
377
378
378
379
380
380
381
381
382
382
383
384
384
385
385
386
387
387
388
388
389
389
390
391
391
392
392
393
394
394
395
395
396
397
397
398
399
399
400
400
401
402
402
403
403
404
405
405
406
407
407
408
408
409
410
410
411
412
412
413
414
414
415
415
416
417
417
418
419
419
420
421
427
428
427
431
432
430
433
432
432
431
436
436
437
436
436
437
440
440
441
440
440
441
440
444
445
444
444
447
448
448
449
448
450
451
450
450
453
456
456
455
456
458
459
460
460
459
460
459
459
464
463
463
464
463
463
468
465
467
468
471
469
472
471
474
474
473
474
472
475
476
476
475
478
475
481
482
479
481
480
481
481
486
487
488
488
487
488
490
489
488
491
491
490
491
495
492
493
495
494
495
494
496
499
498
497
497
500
503
503
504
503
504
504
505
504
506
507
506
507
509
508
509
509
510
509
510
516
515
516
515
515
516
517
520
518
519
520
518
521
524
525
525
524
525
524
530
527
528
529
529
530
531
535
532
535
534
536
535
538
539
539
540
539
540
546
545
544
545
545
546
547
550
550
551
550
549
549
552
557
554
554
553
556
553
559
558
559
558
560
559
562
563
563
562
567
568
568
567
570
571
569
570
571
572
572
573
574
571
571
576
573
578
578
579
580
581
581
582
583
588
585
585
586
591
588
592
589
594
595
591
592
593
598
598
595
596
601
602
602
599
604
605
605
606
607
608
608
609
610
611
612
612
613
618
615
619
616
617
618
622
619
620
621
622
622
623
624
625
625
626
631
632
629
629
634
635
636
632
633
638
635
639
640
637
642
643
643
644
645
642
646
647
648
649
650
650
651
652
649
654
654
655
656
657
657
658
659
660
661
661
662
659
664
664
665
666
667
668
668
665
670
671
672
668
673
674
675
675
676
677
678
675
675
680
681
682
683
687
684
685
682
687
687
688
685
690
690
691
688
689
694
694
695
692
697
698
698
699
700
697
698
698
703
704
701
705
706
703
708
705
709
710
711
712
709
713
710
711
712
713
713
714
719
720
717
717
718
719
724
721
721
722
723
724
725
725
730
727
728
729
729
730
731
728
733
733
734
731
736
737
737
734
739
740
741
741
738
743
744
741
745
746
743
744
745
749
746
751
748
753
753
750
751
752
753
753
754
759
760
761
761
762
759
764
761
761
766
763
768
769
765
774
771
768
773
773
774
775
772
777
777
778
779
780
777
781
782
783
784
781
786
786
787
788
789
790
790
795
792
797
794
794
795
796
797
798
798
803
800
801
806
806
807
808
809
810
811
811
816
813
814
815
815
816
817
818
823
819
820
821
822
823
828
828
825
826
827
828
828
829
834
831
836
836
837
834
839
840
840
841
842
843
844
841
845
846
847
848
849
849
850
851
852
853
853
854
855
856
857
858
858
859
864
861
866
862
863
864
865
866
867
871
872
869
874
875
875
880
877
874
879
879
880
881
878
883
884
884
885
882
883
888
884
889
886
891
892
889
889
890
891
892
897
893
898
899
900
901
902
902
903
904
905
906
906
907
908
909
910
911
911
916
913
910
915
915
916
917
918
919
916
916
921
922
919
920
920
921
926
927
928
929
925
930
931
932
933
937
934
935
936
937
934
938
939
940
941
942
943
943
944
945
946
947
947
948
949
950
951
952
952
953
954
955
956
956
957
958
951
960
961
953
962
955
964
957
958
958
967
968
969
970
970
971
972
973
966
967
975
976
969
978
971
972
980
981
974
975
976
976
977
986
987
980
981
981
982
983
992
985
986
986
987
988
989
990
990
991
992
993
994
995
995
996
997
998
999
1000
1000
1001
1002
1003
1004
1004
1005
1006
1007
1008
1009
1009
1010
1011
1012
1013
1014
1014
1015
1016
1017
1018
1019
1019
1020
1021
1022
1023
1023
1024
1025
1026
1027
1028
1028
1029
1030
1031
1032
1033
1033
1034
1035
1036
1037
1038
1038
1039
1040
1041
1042
1043
1043
1044
1045
1046
1047
1047
1048
1049
1050
1051
1052
1052
1053
1062
1055
1056
1057
1057
1066
1059
1068
1061
1062
1062
1063
1072
1073
1074
1075
1067
1076
1077
1078
1079
1080
1080
1081
1082
1083
1084
1084
1085
1086
1079
1088
1089
1089
1090
1091
1092
1093
1094
1094
1095
1096
1097
1098
1099
1099
1100
1101
1102
1103
1104
1104
1105
1106
1107
1108
1109
1109
1110
1111
1112
1113
1114
1114
1115
1116
1117
1118
1118
1119
1120
1121
1122
1123
1123
1124
1125
1134
1127
1128
1136
1129
1130
1131
1132
1133
1133
1134
1135
1136
1137
1138
1138
1147
1140
1141
1150
1151
1151
1144
1145
1154
1147
1148
1156
1149
1158
1151
1160
1153
1161
1162
1163
1156
1165
1166
1166
1167
1168
1169
1170
1171
1171
1172
1173
1174
1175
1176
1176
1177
1178
1171
1172
1173
1181
1174
1175
1184
1185
1186
1186
1187
1188
1189
1190
1191
1191
1192
1193
1194
1195
1196
1196
1197
1198
1199
1200
1201
1201
1202
1203
1204
1205
1206
1206
1207
1208
1209
1210
1203
1203
1212
1213
1206
1207
1208
1208
1209
1210
1211
1220
1221
1221
1222
1223
1224
1225
1218
1226
1227
1228
1229
1230
1231
1231
1232
1233
1234
1235
1236
1236
1237
1238
1239
1240
1241
1241
1242
1243
1244
1245
1246
1246
1247
1248
1249
1250
1251
1251
1252
1253
1254
1255
1256
1256
1257
1258
1259
1260
1261
1261
1262
1263
1264
1265
1266
1266
1267
1268
1269
1270
1271
1271
1272
1273
1274
1275
1276
1276
1277
1278
1279
1280
1281
1281
1282
1283
1284
1285
1286
1286
1287
1288
1289
1290
1291
1291
1292
1293
1294
1295
1296
1297
1297
1298
1299
1300
1301
1302
1302
1303
1304
1305
1306
1307
1307
1308
1309
1310
1311
1312
1312
1313
1314
1315
1316
1317
1317
1318
1319
1320
1321
1322
1322
1323
1324
1325
1326
1327
1327
1328
1329
1330
1331
1332
1332
1333
1334
1335
1336
1337
1337
1338
1339
1340
1341
1342
1343
1343
1344
1345
1346
1347
1348
1348
1349
1350
1351
1352
1353
1353
1354
1355
1356
1357
1358
1358
1359
1360
1361
1362
1363
1363
1364
1365
1366
1367
1368
1368
1369
1370
1371
1372
1373
1373
1374
1375
1376
1377
1378
1379
1379
1380
1381
1382
1383
1384
1384
1385
1386
1387
1388
1389
1389
1390
1391
1392
1393
1394
1394
1395
1396
1397
1398
1399
1399
1400
1401
1402
1403
1404
1404
1405
1406
1407
1408
1409
1410
1410
1411
1412
1413
1414
1415
1415
1416
1417
1418
1419
1420
1420
1421
1422
1423
1424
1425
1425
1426
1427
1428
1429
1430
1430
1431
1432
1433
1434
1435
1436
1436
1437
1438
1439
1440
1441
1441
1442
1443
1444
1445
1446
1446
1447
1448
1449
1450
1451
1451
1452
1453
1454
1455
1456
1456
1457
1458
1459
1460
1461
1462
1462
1463
1464
1465
1466
1467
1467
1468
1469
1470
1471
1472
1472
1473
1474
1475
1476
1477
1477
1478
1479
1480
1481
1482
1482
1483
1484
1485
1486
1487
1488
1488
1489
1490
1491
1492
1493
1493
1494
1495
1496
1497
1498
1498
1499
1500
1501
1502
1503
1503
1504
1497
1506
1507
1500
1509
1509
1510
1511
1512
1513
1514
1514
1515
1516
1517
1518
1511
1519
1520
1521
1522
1523
1524
1524
1525
1518
1519
1520
1521
1522
1530
1523
1524
1525
1526
1527
1527
1528
1529
1530
1531
1532
1532
1533
1534
1535
1536
1545
1537
1538
1539
1540
1541
1542
1543
1543
1544
1545
1546
1547
1548
1548
1549
1550
1551
1552
1553
1553
1554
1555
1556
1557
1558
1559
1559
1560
1561
1562
1563
1564
1564
1565
1566
1567
1568
1569
1569
1570
1571
1572
1573
1574
1574
1575
1576
1577
1578
1579
1572
1580
1581
1582
1583
1584
1577
1585
1586
1587
1588
1589
1590
1590
1591
1592
1593
1594
1595
1588
1588
1597
1590
1591
1600
1593
1593
1602
1595
1604
1597
1606
1606
1607
1608
1609
1610
1611
1607
1608
1609
1614
1611
1608
1613
1613
1614
1615
1616
1613
1618
1618
1615
1620
1621
1622
1623
1623
1628
1625
1626
1627
1628
1629
1629
1630
1631
1632
1633
1634
1634
1635
1636
1637
1638
1639
1639
1644
1641
1642
1643
1644
1649
1645
1650
1647
1648
1649
1650
1654
1651
1652
1653
1654
1655
1655
1656
1657
1658
1659
1660
1661
1661
1662
1663
1664
1665
1666
1670
1671
1672
1673
1674
1675
1675
1676
1673
1678
1679
1680
1681
1677
1682
1683
1684
1685
1686
1686
1687
1688
1685
1690
1687
1691
1692
1689
1694
1695
1692
1697
1697
1698
1699
1700
1697
1702
1702
1703
1704
1705
1702
1707
1707
1708
1709
1710
1711
1712
1713
1713
1714
1715
1716
1717
1714
1718
1719
1720
1721
1722
1723
1723
1724
1725
1730
1727
1728
1729
1729
1730
1731
1732
1733
1734
1734
1735
1736
1737
1738
1739
1739
1740
1741
1742
1743
1744
1745
1745
1746
1747
1748
1749
1750
1750
1755
1752
1753
1758
1755
1755
1760
1757
1758
1759
1760
1765
1765
1766
1767
1768
1765
1770
1770
1771
1772
1769
1770
1775
1775
1776
1777
1774
1775
1776
1777
1781
1778
1779
1780
1785
1782
1786
1787
1788
1785
1790
1787
1796
1796
1797
1798
1799
1800
1801
1801
1802
1799
1804
1801
1806
1806
1807
1808
1809
1806
1807
1812
1812
1813
1814
1811
1816
1817
1817
1818
1819
1816
1817
1818
1822
1823
1824
1821
1826
1827
1822
1826
1823
1826
1827
1828
1827
1829
1830
1831
1834
1831
1834
1833
1833
1838
1837
1840
1839
1840
1840
1843
1844
1841
1844
1845
1847
1846
1847
1848
1849
1848
1851
1851
1852
1853
1854
1853
1856
1856
1859
1860
1859
1862
1861
1861
1864
1865
1864
1865
1868
1867
1867
1870
1871
1872
1873
1876
1874
1875
1878
1877
1878
1881
1880
1878
1883
1882
1883
1882
1885
1885
1886
1887
1892
1891
1892
1894
1891
1894
1895
1894
1893
1900
1896
1899
1900
1897
1904
1903
1899
1906
1905
1904
1905
1906
1905
1909
1908
1909
1910
1913
1916
1914
1915
1916
1917
1918
1917
1919
1920
1923
1924
1923
1924
1925
1929
1928
1929
1930
1931
1928
1930
1931
1932
1933
1934
1933
1936
1936
1937
1936
1937
1940
1941
1941
1944
1943
1942
1945
1944
1946
1947
1948
1947
1950
1951
1954
1954
1953
1956
1959
1956
1957
1959
1958
1961
1962
1961
1964
1963
1967
1968
1967
1968
1969
1968
1970
1969
1974
1973
1974
1973
1978
1978
1977
1978
1979
1978
1981
1979
1984
1981
1982
1985
1986
1984
1987
1992
1987
1992
1991
1994
1992
1995
1994
1995
1996
1997
1997
2000
2001
2002
2001
2000
2001
2005
2006
2005
2006
2007
2008
2010
2011
2010
2011
2010
2015
2016
2014
2019
2018
2017
2020
2021
2021
2022
2023
2022
2025
2026
2026
2027
2028
2027
2030
2031
2032
2032
2033
2036
2035
2036
2037
2037
2036
2041
2042
2041
2042
2041
2043
2046
2045
2044
2045
2048
2052
2053
2052
2053
2054
2055
2058
2058
2059
2060
2057
2060
2063
2061
2062
2065
2062
2065
2064
2064
2069
2068
2069
2070
2071
2072
2072
2073
2072
2075
2076
2075
2075
2080
2075
2080
2079
2080
2081
2083
2082
2083
2084
2089
2086
2090
2087
2090
2087
2090
2091
2090
2092
2093
2092
2095
2098
2097
2097
2098
2097
2100
2099
2102
2103
2105
2102
2103
2104
2105
2106
2106
2107
2106
2113
2112
2113
2115
2114
2113
2116
2117
2118
2119
2121
2120
2119
2124
2121
2124
2124
2125
2126
2127
2126
2129
2130
2130
2129
2134
2133
2132
2135
2135
2136
2137
2138
2137
2140
2137
2137
2142
2141
2142
2147
2146
2146
2149
2148
2149
2148
2149
2150
2150
2153
2154
2155
2156
2157
2157
2156
2159
2160
2161
2160
2159
2161
2162
2163
2166
2163
2168
2170
2167
2170
2171
2172
2169
2171
2176
2171
2176
2175
2178
2179
2179
2182
2179
2182
2185
2182
2186
2185
2184
2187
2190
2187
2190
2190
2191
2194
2193
2192
2195
2197
2198
2199
2198
2199
2200
2199
2201
2204
2203
2204
2203
2206
2206
2205
2212
2211
2210
2211
2212
2212
2213
2214
2215
2216
2217
2217
2220
2221
2220
2223
2222
2223
2223
2224
2223
2226
2227
2230
2230
2227
2230
2231
2234
2233
2234
2236
2235
2236
2237
2238
2239
2243
2238
2243
2242
2247
2244
2247
2245
2248
2247
2248
2249
2250
2250
2249
2252
2255
2254
2255
2255
2258
2255
2260
2257
2260
2261
2261
2260
2263
2264
2265
2266
2264
2265
2268
2271
2270
2271
2272
2274
2277
2278
2275
2278
2277
2279
2278
2281
2280
2281
2284
2283
2283
2286
2285
2286
2289
2288
2290
2291
2290
2291
2292
2295
2292
2296
2295
2298
2297
2300
2301
2301
2300
2301
2302
2303
2304
2303
2309
2304
2309
2310
2311
2310
2312
2313
2314
2315
2314
2315
2318
2318
2315
2322
2321
2322
2321
2323
2324
2323
2328
2327
2328
2333
2329
2332
2333
2334
2333
2336
2336
2337
2336
2337
2338
2341
2340
2340
2341
2344
2343
2344
2347
2345
2348
2347
2348
2349
2348
2353
2351
2354
2353
2356
2353
2356
2358
2357
2360
2357
2360
2361
2364
2362
2361
2366
2365
2368
2365
2367
2370
2373
2370
2369
2374
2373
2373
2372
2375
2376
2375
2378
2378
2379
2380
2383
2380
2383
2384
2388
2385
2388
2385
2388
2389
2389
2388
2393
2392
2391
2394
2395
2395
2396
2397
2398
2399
2400
2400
2403
2404
2403
2404
2405
2404
2404
2409
2408
2409
2412
2409
2409
2412
2413
2416
2413
2418
2417
2419
2416
2419
2424
2421
2424
2422
2423
2424
2425
2426
2425
2428
2426
2425
2428
2431
2432
2431
2437
2432
2437
2438
2439
2438
2439
2439
2440
2443
2442
2443
2444
2446
2447
2448
2447
2448
2453
2452
2450
2453
2454
2449
2454
2455
2453
2454
2455
2456
2459
2456
2457
2457
2462
2463
2462
2467
2466
2470
2467
2470
2469
2474
2471
2472
2472
2475
2474
2477
2476
2477
2479
2478
2479
2476
2483
2482
2483
2483
2484
2483
2488
2485
2486
2488
2487
2490
2489
2492
2493
2494
2492
2495
2498
2501
2498
2501
2501
2498
2505
2502
2505
2504
2505
2505
2506
2507
2506
2509
2510
2510
2509
2512
2513
2512
2513
2514
2514
2517
2518
2517
2520
2519
2521
2524
2523
2522
2525
2526
2525
2527
2528
2529
2528
2531
2532
2532
2535
2536
2535
2536
2539
2536
2542
2539
2540
2541
2542
2541
2545
2544
2545
2548
2547
2548
2549
2549
2550
2553
2550
2553
2552
2556
2555
2554
2557
2556
2557
2562
2562
2563
2564
2565
2564
2567
2567
2568
2567
2568
2567
2572
2571
2573
2572
2573
2576
2575
2578
2576
2581
2580
2581
2580
2583
2580
2580
2581
2580
2581
2586
2585
2585
2586
2587
2586
2591
2592
2587
2595
2592
2591
2596
2595
2596
2598
2597
2598
2599
2600
2599
2602
2602
2601
2602
2605
2606
2605
2607
2608
2609
2610
2611
2610
2613
2613
2614
2615
2614
2619
2618
2618
2619
2622
2621
2624
2625
2626
2624
2627
2628
2627
2628
2629
2629
2630
2631
2634
2631
2634
2635
2635
2638
2637
2638
2639
2640
2642
2643
2642
2643
2646
2643
2646
2646
2649
2648
2649
2652
2651
2648
2652
2653
2652
2653
2654
2653
2657
2658
2661
2664
2661
2660
2663
2665
2664
2665
2670
2669
2668
2668
2671
2672
2673
2674
2673
2674
2674
2679
2678
2677
2680
2679
2679
2680
2683
2682
2683
2682
2685
2687
2690
2691
2692
2693
2692
2692
2695
2694
2693
2698
2699
2698
2702
2701
2702
2703
2704
2703
2705
2706
2707
2708
2709
2712
2709
2711
2714
2713
2714
2715
2716
2720
2719
2718
2721
2722
2721
2722
2724
2725
2726
2725
2728
2729
2729
2730
2727
2730
2731
2730
2735
2735
2736
2737
2738
2739
2738
2740
2741
2744
2741
2744
2747
2744
2744
2749
2748
2751
2754
2753
2750
2754
2753
2756
2755
2756
2759
2759
2762
2761
2760
2763
2762
2763
2765
2764
2765
2768
2767
2770
2770
2769
2770
2775
2772
2773
2772
2776
2775
2778
2779
2778
2779
2781
2780
2781
2782
2785
2784
2787
2789
2788
2789
2790
2793
2792
2794
2793
2796
2795
2796
2799
2798
2798
2799
2802
2801
2802
2803
2803
2806
2803
2806
2809
2810
2809
2811
2810
2811
2814
2813
2814
2814
2815
2820
2819
2822
2823
2822
2822
2823
2828
2825
2828
2825
2829
2828
2829
2830
2831
2832
2833
2837
2834
2837
2836
2837
2840
2839
2841
2840
2841
2844
2843
2844
2848
2847
2848
2847
2850
2851
2852
2852
2855
2854
2853
2856
2857
2857
2860
2859
2862
2861
2864
2861
2865
2864
2865
2864
2867
2868
2870
2871
2870
2871
2876
2873
2874
2876
2877
2876
2877
2878
2877
2881
2882
2881
2886
2885
2886
2887
2887
2888
2889
2890
2889
2892
2892
2893
2892
2897
2898
2897
2900
2900
2899
2902
2901
2902
2903
2905
2904
2905
2908
2909
2910
2911
2907
2912
2911
2912
2913
2916
2917
2917
2918
2917
2920
2921
2920
2922
2923
2924
2921
2926
2925
2928
2928
2927
2930
2931
2932
2931
2933
2932
2935
2936
2937
2938
2939
2939
2940
2941
2942
2943
2944
2944
2945
2946
2947
2948
2949
2950
2950
2951
2952
2953
2954
2955
2955
2956
2957
2958
2959
2960
2961
2961
2962
2963
2964
2965
2966
2966
2967
2968
2969
2970
2971
2972
2972
2973
2974
2975
2976
2977
2978
2978
2979
2980
2981
2982
2983
2983
2984
2985
2986
2987
2988
2989
2989
2990
2991
2992
2993
2994
2994
2995
2996
2997
2998
2999
3000
3000
3001
3002
3003
3004
3005
3005
3006
3007
3008
3009
3010
3011
3011
3012
3013
3014
3015
3016
3016
3017
3018
3019
3020
3021
3022
3022
3023
3024
3025
3026
3027
3028
3028
3029
3030
3031
3032
3033
3033
3034
3035
3036
3037
3038
3039
3039
3040
3041
3042
3043
3044
3044
3045
3046
3047
3048
3049
3050
3050
3051
3052
3053
3054
3055
3055
3056
3057
3058
3059
3060
3061
3061
3062
3063
3064
3065
3066
3066
3067
3068
3069
3070
3071
3072
3072
3073
3074
3075
3076
3077
3077
3078
3079
3080
3081
3082
3083
3083
3084
3085
3086
3087
3088
3089
3091
3093
3096
3098
3100
3103
3105
3107
3109
3112
3114
3116
3119
3121
3121
3126
3126
3130
3129
3131
3133
3131
3136
3142
3142
3143
3143
3147
3147
3150
3150
3150
3153
3155
3157
3159
3158
3164
3164
3164
3165
3165
3173
3173
3176
3178
3176
3178
3179
3181
3183
3183
3186
3186
3190
3192
3192
3193
3193
3197
3199
3199
3204
3202
3206
3208
3209
3215
3215
3215
3219
3218
3220
3224
3224
3226
3228
3229
3231
3231
3237
3235
3246
3248
3250
3250
3250
3254
3253
3257
3259
3259
3261
3265
3266
3268
3268
3270
3274
3274
3274
3279
3279
3281
3281
3283
3287
3287
3287
3288
3290
3292
3294
3298
3298
3298
3300
3299
3303
3303
3307
3309
3309
3311
3311
3315
3316
3316
3320
3320
3322
3322
3324
3324
3324
3326
3332
3333
3335
3335
3337
3343
3343
3345
3345
3349
3351
3351
3353
3357
3357
3358
3358
3362
3362
3366
3368
3368
3370
3370
3376
3376
3376
3378
3378
3388
3390
3392
3392
3396
3398
3400
3400
3400
3403
3407
3409
3407
3411
3411
3413
3415
3415
3417
3419
3417
3421
3423
3425
3425
3425
3429
3429
3433
3433
3433
3435
3439
3439
3441
3443
3447
3447
3449
3449
3449
3451
3453
3455
3459
3461
3462
3462
3466
3466
3468
3470
3470
3476
3474
3476
3478
3478
3482
3482
3484
3486
3486
3490
3490
3492
3494
3494
3498
3498
3501
3501
3503
3505
3505
3509
3511
3511
3515
3515
3517
3517
3519
3531
3529
3534
3534
3536
3536
3538
3538
3542
3544
3546
3546
3550
3546
3551
3555
3557
3557
3557
3561
3563
3565
3565
3567
3568
3566
3572
3572
3574
3576
3578
3578
3580
3581
3587
3583
3589
3589
3593
3595
3595
3594
3598
3600
3602
3602
3604
3606
3608
3609
3611
3611
3613
3617
3619
3619
3620
3624
3624
3626
3628
3630
3632
3633
3635
3639
3639
3641
3645
3645
3648
3648
3650
3652
3654
3656
3657
3659
3661
3663
3665
3665
3668
3676
3674
3678
3678
3682
3683
3687
3687
3687
3689
3690
3690
3692
3692
3696
3698
3697
3701
3703
3705
3705
3708
3708
3712
3714
3716
3717
3719
3721
3723
3725
3726
3726
3730
3732
3732
3735
3737
3739
3741
3742
3744
3746
3748
3750
3751
3753
3755
3757
3759
3760
3762
3764
3766
3767
3769
3769
3771
3772
3774
3778
3778
3778
3777
3781
3783
3783
3786
3786
3788
3794
3795
3797
3797
3799
3802
3802
3806
3806
3809
3811
3811
3813
3820
3822
3824
3824
3827
3827
3831
3829
3832
3836
3836
3839
3839
3841
3843
3844
3846
3848
3850
3851
3851
3855
3856
3858
3860
3860
3863
3863
3865
3868
3868
3870
3870
3875
3875
3877
3880
3880
3882
3882
3883
3885
3889
3890
3890
3894
3894
3897
3897
3899
3900
3906
3904
3905
3909
3909
3910
3914
3916
3916
3919
3919
3921
3924
3924
3924
3925
3927
3931
3932
3936
3934
3937
3941
3941
3942
3942
3948
3947
3947
3951
3952
3952
3960
3961
3963
3965
3970
3972
3970
3975
3975
3975
3978
3982
3982
3983
3983
3987
3986
3990
3992
3995
3995
3995
3996
4002
4002
4003
4005
4005
4006
4008
4011
4013
4017
4014
4018
4018
4019
4025
4023
4024
4026
4028
4029
4031
4034
4034
4036
4039
4041
4043
4044
4044
4045
4049
4049
4052
4052
4054
4057
4057
4060
4060
4064
4063
4065
4067
4068
4070
4071
4075
4077
4078
4080
4079
4081
4083
4084
4086
4087
4089
4095
4094
4095
4095>;
};
};
