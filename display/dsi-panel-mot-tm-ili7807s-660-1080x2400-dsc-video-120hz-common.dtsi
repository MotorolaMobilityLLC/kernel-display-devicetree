&mdss_mdp {
	mot_tm_ili7807s_660_1080x2400_dsc_vid_120hz: qcom,mdss_dsi_mot_tm_ili7807s_660_1080x2400_dsc_vid_120hz {
		qcom,mdss-dsi-panel-name = "mipi_moto_vid_tm_1080p_dsc_660_120hz";
		qcom,mdss-dsi-panel-type = "dsi_video_mode";
		qcom,mdss-dsi-panel-physical-type = "lcd";
		qcom,mdss-dsi-virtual-channel-id = <0>;
		qcom,mdss-dsi-stream = <0>;
		qcom,dsi-ctrl-num = <0>;
		qcom,dsi-phy-num = <0>;
		qcom,mdss-pan-physical-width-dimension = <69>;
		qcom,mdss-pan-physical-height-dimension = <153>;
		qcom,mdss-dsi-bpp = <24>;
		qcom,mdss-dsi-underflow-color = <0xff>;
		qcom,mdss-dsi-border-color = <0>;
		qcom,mdss-dsi-h-sync-pulse = <0>;

		//qcom,mdss-dsi-panel-mode-switch;

		//qcom,dsi-sec-ctrl-num = <1>;
		//qcom,dsi-sec-phy-num = <1>;

		qcom,mdss-dsi-traffic-mode = "non_burst_sync_event";
		//qcom,mdss-dsi-lane-map = "lane_map_0123";
		qcom,mdss-dsi-bllp-eof-power-mode;
		qcom,mdss-dsi-bllp-power-mode;
		qcom,mdss-dsi-lane-0-state;
		qcom,mdss-dsi-lane-1-state;
		qcom,mdss-dsi-lane-2-state;
		qcom,mdss-dsi-lane-3-state;
		qcom,mdss-dsi-lp11-init;
		qcom,mdss-dsi-dma-trigger = "trigger_sw";
		qcom,mdss-dsi-mdp-trigger = "none";
		qcom,mdss-dsi-reset-sequence = <1 4>, <0 1>, <1 12>;
		qcom,mdss-dsi-bl-pmic-control-type = "bl_ctrl_i2c";

		qcom,mdss-dsi-cabc-mv-command = [15 01 00 00 00 00 02 55 03];
		qcom,mdss-dsi-cabc-mv-command-state =  "dsi_hs_mode";
		qcom,mdss-dsi-cabc-ui-command = [15 01 00 00 00 00 02 55 01];
		qcom,mdss-dsi-cabc-ui-command-state =  "dsi_hs_mode";
		qcom,mdss-dsi-cabc-dis-command = [15 01 00 00 00 00 02 55 00];
		qcom,mdss-dsi-cabc-dis-command-state =  "dsi_hs_mode";

		qcom,mdss-dsi-display-timings {
			timing@0 {
				cell-index = <0>;
				qcom,mdss-dsi-panel-framerate = <120>;
				qcom,mdss-dsi-panel-width = <1080>;
				qcom,mdss-dsi-panel-height = <2400>;
				qcom,mdss-dsi-h-front-porch = <19>;
				qcom,mdss-dsi-h-back-porch = <22>;
				qcom,mdss-dsi-h-pulse-width = <4>;
				qcom,mdss-dsi-h-sync-skew = <0>;
				qcom,mdss-dsi-v-back-porch = <46>;
				qcom,mdss-dsi-v-front-porch = <46>;
				qcom,mdss-dsi-v-pulse-width = <2>;
				qcom,mdss-dsi-h-left-border = <0>;
				qcom,mdss-dsi-h-right-border = <0>;
				qcom,mdss-dsi-v-top-border = <0>;
				qcom,mdss-dsi-v-bottom-border = <0>;

				qcom,mdss-dsi-on-command = [
 					39 01 00 00 00 00 04 FF 78 07 06
 					15 01 00 00 00 00 02 3E E2
					15 01 00 00 00 00 02 80 00
 					15 01 00 00 00 00 02 12 BD
 					15 01 00 00 00 00 02 08 20

 					39 01 00 00 00 00 04 FF 78 07 03
 					15 01 00 00 00 00 02 83 C8
 					15 01 00 00 00 00 02 84 04

 					39 01 00 00 00 00 04 FF 78 07 04
 					15 01 00 00 00 00 02 BD 01

 					39 01 00 00 00 00 04 FF 78 07 05
 					15 01 00 00 00 00 02 B5 50
 					15 01 00 00 00 00 02 B7 70

					39 01 00 00 00 00 04 FF 78 07 06
					15 01 00 00 00 00 02 4E 40
					15 01 00 00 00 00 02 4D 01
					15 01 00 00 00 00 02 48 09
					15 01 00 00 00 00 02 C7 05

 					39 01 00 00 00 00 04 FF 78 07 08
 					39 01 00 00 00 00 03 FD 00 9F
 					15 01 00 00 00 00 02 E1 E1
 					39 01 00 00 00 00 03 FD 00 00

 					39 01 00 00 00 00 04 FF 78 07 02
 					15 01 00 00 00 00 02 1B 00

 					39 01 00 00 00 00 04 FF 78 07 07
 					15 01 00 00 00 00 02 29 CF
					15 01 00 00 00 00 02 11 16

					39 01 00 00 00 00 04 FF 78 07 1E
					15 01 00 00 00 00 02 A5 7D
					15 01 00 00 00 00 02 A6 7D

 					39 01 00 00 00 00 04 FF 78 07 00
 					39 01 00 00 00 00 03 51 03 33
 					15 01 00 00 00 00 02 53 24
 					15 01 00 00 00 00 02 55 01
 					15 01 00 00 00 00 02 35 00

					05 01 00 00 41 00 02 11 00
					05 01 00 00 05 00 02 29 00
				];

				qcom,mdss-dsi-off-command = [
					39 01 00 00 01 00 04 FF 78 07 00
					05 01 00 00 14 00 02 28 00
					05 01 00 00 78 00 02 10 00];
				qcom,mdss-dsi-on-command-state = "dsi_lp_mode";
				qcom,mdss-dsi-off-command-state = "dsi_lp_mode";

				qcom,compression-mode = "dsc";
				qcom,mdss-dsc-slice-height = <8>;
				qcom,mdss-dsc-slice-width = <540>;
				qcom,mdss-dsc-slice-per-pkt = <2>;
				qcom,mdss-dsc-bit-per-component = <8>;
				qcom,mdss-dsc-bit-per-pixel = <8>;
				qcom,mdss-dsc-block-prediction-enable;
			};
		};
	};
};

