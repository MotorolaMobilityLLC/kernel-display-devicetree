/dts-v1/;
/plugin/;

#include "parrot-sde-display-monai-common.dtsi"

/ {
	model = "monai";
	compatible = "qcom,parrot-qrd", "qcom,parrot", "qcom,qrd", "moto,monai";
	qcom,msm-id = <613 0x10000>;
	qcom,board-id = <0x43 0xB100>;
};

