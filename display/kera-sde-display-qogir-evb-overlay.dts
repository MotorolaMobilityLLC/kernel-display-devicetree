// SPDX-License-Identifier: BSD-3-Clause
/*
 * Copyright (c) 2024 Qualcomm Innovation Center, Inc. All rights reserved.
 */

/dts-v1/;
/plugin/;

#include "kera-sde-display-qogir-common.dtsi"

/ {
	model = "qogir";
	compatible = "qcom,kera-qrd", "qcom,kera", "qcom,kerap-qrd", "qcom,kerap",
			"qcom,qrd";
	qcom,msm-id = <686 0x10000>, <659 0x10000>;
	qcom,board-id = <0x44 0x9000>;
};
