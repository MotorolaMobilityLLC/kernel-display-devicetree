
/* Copyright (c) 2019-2020, The Linux Foundation. All rights reserved.
 *
 * This program is free software; you can redistribute it and/or modify
 * it under the terms of the GNU General Public License version 2 and
 * only version 2 as published by the Free Software Foundation.
 *
 * This program is distributed in the hope that it will be useful,
 * but WITHOUT ANY WARRANTY; without even the implied warranty of
 * MERCHANTABILITY or FITNESS FOR A PARTICULAR PURPOSE.  See the
 * GNU General Public License for more details.
 */

&mot_csot_vtdr6126_c_667_1220x2712_dsc_vid {
qcom,mdss-dsi-panel-local-hbm-alpha-table = <
0
313
466
594
691
691
691
691
695
691
691
691
691
691
691
691
691
691
691
691
691
691
691
695
691
695
691
703
703
703
703
703
703
703
703
703
703
703
703
703
707
703
703
703
703
703
703
703
703
707
703
703
703
703
703
703
703
703
703
703
707
703
703
703
703
703
703
703
703
703
703
707
703
711
711
711
711
711
711
715
715
715
715
715
715
715
715
715
715
715
715
715
715
715
719
715
715
715
715
715
715
715
715
715
715
715
715
719
715
715
715
719
715
715
715
715
719
715
719
727
727
727
731
727
727
727
727
727
727
727
727
727
727
727
727
727
727
727
727
727
727
727
727
727
727
727
727
731
727
727
727
727
727
731
731
731
727
731
731
731
731
727
731
731
731
739
735
739
735
739
735
739
739
739
739
739
739
739
739
739
739
739
739
739
739
739
739
739
739
739
739
739
739
739
743
739
739
743
739
739
739
739
739
739
739
739
739
739
739
743
743
751
751
751
751
747
747
751
751
751
751
751
751
751
751
747
751
751
755
751
751
751
751
751
751
751
751
751
751
751
751
751
751
751
751
751
751
751
755
751
751
755
751
751
751
751
751
759
759
763
759
759
763
759
763
763
763
767
763
763
763
763
763
763
763
763
763
763
763
763
763
763
763
763
763
763
767
767
763
763
767
763
763
763
763
763
763
763
767
763
763
763
767
775
775
775
775
771
771
775
775
775
775
771
775
775
775
775
775
775
775
775
775
775
775
779
775
775
779
775
775
775
775
775
775
775
775
775
775
775
779
775
775
775
775
775
775
779
779
787
787
783
787
787
787
783
787
787
791
787
787
787
787
787
787
791
787
787
787
791
787
787
787
787
787
787
791
787
787
791
787
791
787
791
791
791
791
787
787
787
791
791
787
791
795
799
799
799
799
799
799
799
803
799
799
799
799
803
799
799
799
799
799
799
799
803
799
803
803
799
799
799
799
799
799
803
799
803
803
803
803
803
803
803
807
807
803
803
803
803
811
815
811
811
811
811
811
811
811
811
811
811
811
811
811
811
811
815
811
811
811
811
811
811
811
811
815
811
811
815
815
815
815
815
815
815
815
819
815
815
815
815
815
815
815
815
827
823
823
827
827
823
831
823
823
823
827
827
823
827
823
823
823
823
823
827
827
827
827
827
827
827
827
827
827
827
827
827
827
827
831
827
827
827
827
827
831
827
831
831
831
831
839
839
839
839
839
839
839
839
839
839
839
839
839
839
843
843
839
839
843
839
839
843
839
839
839
843
839
839
843
839
839
839
843
843
839
839
843
839
839
843
839
839
843
843
839
839
847
847
847
847
847
847
847
847
847
847
851
847
847
847
851
847
851
847
847
847
851
847
851
851
851
851
851
851
851
851
851
851
851
851
851
851
855
851
851
851
851
851
851
851
851
851
859
859
859
859
859
859
859
859
859
859
859
863
859
859
859
859
859
863
859
859
859
859
859
859
863
859
863
863
859
859
859
863
863
863
863
863
863
863
863
863
867
863
863
863
863
863
875
871
871
871
871
871
871
871
871
871
871
871
871
871
871
871
871
871
871
875
871
871
875
875
871
871
871
875
875
875
871
871
871
871
875
871
871
871
875
875
875
875
875
875
875
883
883
883
883
883
883
883
883
883
883
883
883
883
883
883
883
887
883
883
883
883
887
887
883
883
883
883
883
887
883
883
883
883
883
883
883
887
887
883
883
887
887
883
887
887
887
895
895
895
895
891
895
895
900
895
895
895
895
895
895
895
895
895
895
895
895
895
895
895
895
900
895
900
895
895
900
900
895
895
900
895
900
895
895
895
895
895
895
895
900
900
904
908
908
908
908
908
908
908
908
908
908
908
912
912
908
908
908
908
908
912
908
908
908
908
908
908
908
908
908
908
912
908
908
908
908
912
908
912
912
912
912
912
912
908
912
912
912
920
916
916
920
920
920
916
920
920
920
920
920
920
924
920
920
920
920
920
924
920
920
920
920
920
920
920
920
924
920
920
920
920
920
920
920
920
920
924
920
920
924
920
920
924
924
932
932
932
932
932
936
932
932
932
932
932
932
932
932
936
936
932
932
936
936
932
932
936
932
932
932
932
932
932
932
932
932
932
932
936
936
936
932
932
936
936
936
936
936
936
932
940
940
944
940
944
948
944
944
944
948
944
944
944
944
944
944
944
944
944
944
944
944
944
944
944
944
944
944
944
948
948
944
944
944
944
948
944
944
944
944
944
944
948
948
944
948
956
956
956
956
952
952
956
956
952
956
956
956
952
956
960
956
956
956
956
956
956
956
956
960
956
956
956
960
956
956
960
956
960
956
956
956
956
956
956
960
964
960
956
964
960
956
964
968
964
968
968
964
968
964
964
968
968
972
968
968
968
968
968
968
972
968
968
968
968
968
968
968
968
972
972
968
972
972
972
968
972
968
968
968
968
976
972
972
972
972
972
976
976
976
976
976
976
976
980
976
976
980
980
980
980
980
980
980
980
980
984
984
980
980
980
980
980
980
980
980
980
980
980
984
980
984
984
980
984
980
980
984
980
980
988
980
980
988
992
988
988
992
988
992
988
988
996
988
992
992
992
992
992
992
992
992
992
992
992
992
992
992
996
992
992
996
996
992
992
992
992
996
996
992
996
992
992
996
992
996
996
996
992
1004
1000
1004
1000
1000
1004
1000
1000
1004
1000
1004
1000
1000
1000
1000
1004
1000
1000
1000
1000
1000
1004
1004
1004
1004
1004
1004
1004
1004
1004
1004
1004
1004
1004
1004
1004
1004
1004
1004
1004
1004
1004
1004
1008
1004
1008
1008
1012
1012
1008
1012
1008
1008
1012
1008
1012
1012
1012
1012
1016
1012
1012
1012
1012
1012
1012
1016
1012
1012
1012
1012
1012
1016
1012
1012
1012
1012
1016
1012
1012
1016
1016
1012
1012
1016
1012
1012
1012
1012
1020
1012
1012
1024
1024
1024
1024
1028
1024
1028
1024
1028
1028
1024
1024
1024
1024
1024
1028
1024
1024
1028
1024
1028
1024
1028
1028
1028
1028
1028
1028
1028
1028
1028
1028
1028
1028
1028
1032
1028
1028
1028
1028
1028
1032
1028
1028
1032
1028
1036
1036
1036
1036
1040
1040
1036
1036
1036
1040
1036
1036
1036
1036
1040
1040
1036
1036
1036
1036
1036
1040
1036
1040
1040
1040
1040
1036
1036
1036
1036
1040
1040
1040
1040
1040
1044
1040
1040
1040
1040
1040
1040
1040
1044
1040
1044
1048
1044
1044
1048
1052
1048
1048
1048
1048
1048
1048
1048
1052
1048
1048
1048
1048
1048
1048
1048
1052
1052
1052
1052
1048
1052
1052
1048
1048
1056
1056
1064
1056
1060
1056
1060
1056
1064
1056
1060
1056
1056
1056
1064
1064
1064
1064
1064
1072
1068
1068
1064
1064
1064
1064
1072
1068
1072
1076
1076
1072
1072
1072
1080
1072
1072
1076
1076
1076
1080
1076
1080
1088
1084
1080
1084
1080
1088
1080
1080
1080
1080
1084
1084
1080
1088
1088
1088
1092
1092
1092
1092
1092
1092
1096
1092
1092
1092
1096
1100
1096
1096
1096
1096
1100
1096
1096
1100
1096
1096
1100
1096
1096
1104
1104
1104
1104
1108
1104
1104
1104
1104
1104
1104
1108
1104
1104
1112
1116
1112
1112
1116
1116
1112
1112
1112
1116
1112
1112
1112
1112
1120
1120
1120
1124
1120
1120
1120
1120
1120
1120
1120
1120
1120
1124
1128
1128
1128
1128
1128
1132
1128
1128
1128
1128
1128
1128
1128
1128
1136
1132
1132
1132
1132
1132
1132
1132
1132
1132
1132
1136
1132
1140
1140
1140
1144
1140
1140
1140
1140
1140
1140
1140
1140
1140
1144
1144
1148
1148
1153
1148
1153
1148
1148
1148
1148
1153
1148
1148
1148
1148
1157
1157
1157
1157
1157
1157
1157
1157
1157
1161
1157
1157
1157
1165
1165
1165
1169
1169
1165
1169
1165
1165
1165
1173
1169
1165
1165
1165
1173
1173
1173
1173
1177
1173
1177
1177
1173
1177
1177
1173
1173
1173
1181
1181
1181
1185
1181
1181
1185
1185
1181
1185
1185
1181
1181
1181
1189
1189
1189
1189
1189
1189
1189
1193
1189
1189
1193
1189
1189
1189
1193
1193
1193
1193
1193
1193
1193
1193
1193
1197
1197
1197
1197
1197
1201
1201
1201
1201
1201
1209
1205
1201
1201
1205
1201
1205
1201
1205
1213
1205
1209
1209
1209
1209
1213
1209
1209
1209
1209
1209
1213
1209
1213
1217
1217
1213
1217
1217
1217
1217
1213
1217
1217
1221
1217
1217
1221
1221
1225
1221
1225
1229
1225
1221
1221
1221
1225
1221
1221
1221
1233
1229
1229
1229
1229
1229
1229
1233
1233
1229
1229
1229
1229
1233
1237
1237
1237
1237
1237
1237
1241
1237
1237
1237
1241
1241
1237
1237
1245
1241
1245
1245
1249
1241
1241
1241
1245
1241
1245
1241
1245
1245
1249
1249
1249
1249
1249
1249
1249
1253
1249
1249
1257
1253
1253
1249
1253
1261
1261
1257
1257
1257
1257
1257
1257
1261
1257
1261
1257
1257
1257
1261
1261
1261
1265
1261
1265
1265
1261
1261
1261
1265
1269
1269
1265
1269
1269
1269
1269
1269
1269
1269
1269
1269
1269
1269
1269
1269
1273
1281
1277
1281
1277
1277
1281
1277
1277
1277
1285
1277
1281
1277
1281
1289
1285
1285
1289
1285
1285
1285
1285
1285
1285
1285
1285
1285
1285
1289
1293
1289
1293
1297
1289
1293
1289
1289
1289
1289
1289
1289
1297
1301
1297
1297
1297
1297
1297
1301
1301
1305
1301
1297
1297
1297
1301
1305
1305
1305
1309
1305
1305
1305
1305
1309
1309
1305
1305
1305
1305
1309
1309
1313
1309
1309
1313
1313
1317
1313
1313
1317
1313
1313
1317
1321
1321
1321
1321
1325
1321
1321
1321
1321
1321
1321
1321
1321
1321
1325
1325
1325
1329
1325
1325
1325
1325
1325
1325
1325
1329
1329
1329
1333
1333
1333
1337
1337
1333
1333
1337
1333
1333
1333
1337
1333
1333
1337
1341
1337
1337
1341
1341
1337
1341
1337
1337
1345
1337
1345
1337
1345
1349
1345
1349
1345
1345
1345
1345
1345
1345
1349
1345
1349
1345
1353
1357
1357
1353
1353
1353
1353
1353
1353
1357
1353
1353
1353
1353
1361
1361
1361
1361
1361
1361
1365
1361
1361
1369
1361
1361
1365
1369
1369
1369
1369
1369
1369
1373
1369
1369
1373
1369
1369
1369
1373
1369
1373
1377
1373
1381
1373
1373
1373
1373
1377
1373
1373
1377
1373
1377
1381
1381
1389
1385
1381
1381
1385
1385
1381
1381
1385
1385
1381
1381
1389
1385
1389
1389
1393
1389
1389
1389
1389
1389
1389
1389
1393
1385
1393
1393
1393
1393
1393
1393
1393
1397
1393
1393
1393
1393
1397
1393
1401
1401
1401
1401
1401
1405
1401
1401
1401
1401
1401
1401
1401
1401
1410
1410
1414
1405
1410
1414
1410
1405
1405
1405
1410
1410
1414
1410
1414
1414
1418
1414
1414
1414
1418
1418
1414
1414
1414
1414
1414
1414
1418
1418
1418
1418
1418
1418
1422
1422
1418
1418
1418
1418
1422
1422
1426
1422
1426
1430
1426
1426
1430
1426
1426
1426
1430
1430
1426
1426
1434
1438
1430
1430
1430
1430
1430
1430
1434
1434
1430
1430
1430
1430
1438
1434
1438
1442
1438
1438
1446
1442
1438
1438
1446
1446
1446
1450
1446
1446
1446
1450
1446
1446
1446
1454
1454
1450
1450
1450
1454
1454
1450
1450
1454
1458
1458
1458
1462
1458
1454
1454
1454
1454
1462
1462
1462
1462
1466
1462
1462
1462
1466
1470
1466
1466
1474
1466
1466
1466
1466
1466
1470
1470
1470
1474
1474
1474
1478
1474
1474
1482
1478
1478
1478
1478
1478
1478
1482
1482
1482
1482
1486
1482
1482
1482
1482
1482
1486
1490
1490
1490
1490
1490
1490
1494
1494
1490
1494
1494
1502
1498
1494
1498
1502
1498
1494
1498
1502
1498
1498
1498
1498
1498
1498
1502
1498
1510
1506
1506
1506
1506
1506
1510
1510
1506
1510
1514
1510
1514
1510
1514
1514
1510
1510
1522
1514
1514
1518
1518
1514
1514
1518
1514
1522
1526
1522
1522
1522
1526
1526
1526
1522
1526
1530
1534
1530
1526
1526
1530
1526
1526
1530
1534
1534
1534
1530
1530
1534
1534
1530
1538
1542
1538
1538
1542
1538
1546
1538
1542
1538
1546
1550
1546
1546
1546
1546
1546
1550
1554
1558
1550
1550
1558
1558
1550
1550
1554
1550
1554
1562
1558
1558
1558
1558
1562
1562
1558
1562
1562
1562
1562
1562
1566
1562
1562
1566
1566
1566
1566
1570
1570
1566
1566
1566
1574
1578
1570
1574
1574
1578
1574
1570
1574
1570
1570
1578
1578
1582
1578
1578
1582
1578
1582
1578
1582
1586
1590
1590
1586
1582
1582
1590
1582
1590
1590
1590
1598
1590
1590
1590
1590
1590
1594
1594
1594
1594
1594
1594
1602
1594
1594
1598
1602
1602
1598
1602
1598
1606
1610
1602
1606
1606
1606
1606
1614
1610
1610
1610
1614
1614
1610
1614
1614
1610
1614
1618
1610
1614
1610
1614
1614
1614
1622
1614
1618
1614
1614
1618
1626
1618
1618
1618
1618
1618
1618
1618
1618
1622
1626
1626
1626
1626
1630
1630
1626
1626
1638
1630
1630
1634
1630
1638
1630
1630
1634
1642
1638
1638
1638
1642
1638
1638
1638
1638
1646
1646
1642
1646
1646
1646
1642
1642
1642
1646
1650
1646
1646
1646
1646
1646
1646
1646
1646
1654
1650
1650
1650
1650
1654
1650
1650
1650
1654
1658
1654
1654
1654
1654
1654
1654
1654
1662
1662
1658
1667
1667
1662
1662
1662
1662
1667
1667
1671
1671
1667
1667
1667
1667
1671
1671
1671
1671
1671
1671
1679
1675
1675
1671
1683
1683
1679
1679
1675
1679
1675
1683
1675
1683
1687
1683
1687
1687
1679
1683
1683
1683
1683
1687
1687
1687
1691
1691
1687
1687
1687
1687
1691
1691
1695
1695
1695
1695
1691
1695
1695
1695
1703
1699
1703
1695
1699
1699
1699
1695
1699
1703
1699
1703
1707
1703
1699
1703
1703
1711
1703
1703
1711
1711
1711
1703
1707
1703
1715
1715
1711
1715
1711
1719
1711
1711
1711
1719
1719
1715
1715
1715
1719
1715
1719
1719
1715
1727
1723
1727
1723
1723
1723
1723
1727
1727
1727
1731
1727
1731
1727
1731
1735
1731
1727
1731
1731
1731
1731
1731
1731
1735
1731
1735
1739
1735
1735
1735
1735
1735
1739
1735
1735
1739
1739
1739
1747
1739
1739
1739
1739
1743
1743
1747
1743
1743
1747
1747
1743
1743
1747
1751
1755
1751
1751
1747
1755
1751
1747
1747
1747
1755
1759
1751
1755
1751
1755
1755
1755
1755
1763
1759
1759
1759
1759
1759
1763
1759
1759
1767
1767
1763
1763
1763
1759
1763
1759
1767
1763
1767
1767
1767
1767
1767
1771
1767
1771
1771
1771
1771
1771
1771
1775
1775
1771
1775
1779
1775
1779
1775
1775
1779
1775
1779
1775
1779
1779
1779
1779
1779
1783
1779
1779
1783
1779
1783
1783
1783
1787
1783
1783
1783
1783
1787
1791
1795
1795
1787
1791
1791
1795
1787
1791
1795
1803
1795
1795
1799
1795
1795
1791
1799
1803
1799
1803
1799
1799
1803
1803
1803
1807
1807
1807
1807
1811
1807
1807
1811
1811
1811
1811
1811
1811
1815
1811
1811
1815
1815
1811
1815
1815
1819
1823
1823
1815
1815
1815
1815
1819
1819
1819
1819
1819
1819
1823
1823
1819
1823
1831
1823
1823
1823
1831
1823
1823
1827
1823
1831
1835
1827
1831
1831
1831
1839
1831
1835
1839
1839
1835
1835
1835
1839
1843
1843
1839
1839
1843
1839
1839
1843
1839
1843
1847
1847
1847
1843
1851
1843
1847
1843
1843
1843
1843
1847
1847
1847
1847
1851
1855
1847
1847
1851
1855
1855
1855
1855
1855
1855
1859
1859
1855
1859
1867
1863
1863
1863
1863
1859
1867
1863
1859
1867
1867
1867
1871
1867
1867
1871
1867
1867
1875
1871
1875
1871
1871
1871
1871
1871
1875
1875
1875
1879
1879
1875
1879
1875
1875
1879
1883
1879
1879
1879
1879
1879
1879
1879
1879
1883
1887
1883
1883
1887
1883
1887
1883
1887
1883
1891
1895
1895
1891
1891
1887
1895
1891
1895
1891
1895
1895
1891
1895
1899
1895
1895
1899
1903
1895
1895
1903
1895
1899
1895
1903
1903
1903
1899
1907
1903
1903
1899
1903
1903
1907
1907
1907
1903
1903
1907
1903
1907
1911
1907
1911
1911
1911
1911
1911
1915
1911
1911
1915
1915
1924
1919
1919
1924
1919
1919
1915
1919
1919
1928
1924
1928
1924
1924
1924
1924
1924
1928
1932
1928
1932
1932
1928
1928
1928
1932
1932
1936
1940
1932
1932
1932
1932
1932
1932
1936
1940
1944
1940
1944
1940
1940
1940
1940
1936
1940
1944
1940
1940
1944
1940
1944
1944
1944
1948
1952
1944
1948
1948
1948
1944
1948
1948
1952
1952
1948
1952
1952
1952
1952
1952
1956
1952
1956
1956
1956
1960
1960
1956
1956
1956
1956
1964
1964
1960
1960
1960
1960
1960
1964
1964
1964
1964
1964
1964
1964
1964
1968
1964
1964
1968
1968
1968
1968
1972
1976
1972
1976
1976
1976
1976
1980
1976
1988
1988
1980
1980
1988
1988
1984
1984
1984
1984
1992
1992
1992
1988
1992
1988
1992
1992
1992
1992
1992
1996
1992
1996
1996
1996
1996
1996
2000
2000
2000
2004
2000
2000
2008
2004
2004
2008
2008
2004
2008
2012
2012
2008
2008
2008
2012
2016
2012
2012
2012
2012
2016
2012
2016
2020
2020
2016
2016
2020
2016
2016
2016
2020
2020
2020
2020
2020
2020
2024
2024
2024
2024
2028
2028
2032
2028
2028
2028
2032
2032
2036
2028
2032
2036
2036
2032
2036
2032
2032
2036
2036
2036
2036
2040
2044
2044
2048
2044
2048
2048
2044
2044
2044
2044
2048
2048
2048
2044
2052
2052
2048
2048
2052
2056
2052
2056
2060
2056
2056
2060
2060
2064
2060
2064
2060
2060
2068
2064
2064
2068
2072
2072
2064
2068
2072
2072
2068
2072
2076
2076
2072
2072
2072
2076
2076
2076
2072
2076
2076
2076
2080
2076
2080
2084
2084
2080
2080
2084
2080
2084
2084
2084
2088
2084
2084
2088
2088
2092
2088
2092
2092
2096
2096
2092
2092
2096
2096
2096
2100
2096
2092
2092
2104
2100
2096
2096
2096
2104
2104
2104
2104
2104
2100
2104
2108
2104
2104
2108
2104
2108
2108
2108
2108
2116
2108
2116
2116
2112
2112
2112
2120
2116
2120
2116
2116
2120
2120
2124
2124
2120
2124
2120
2124
2124
2128
2124
2124
2132
2124
2128
2128
2128
2132
2132
2128
2132
2136
2136
2128
2136
2136
2136
2140
2136
2140
2140
2140
2144
2140
2140
2144
2144
2148
2140
2140
2144
2144
2148
2144
2148
2148
2144
2148
2148
2148
2152
2148
2152
2156
2156
2152
2152
2152
2156
2156
2156
2156
2156
2160
2160
2156
2160
2160
2160
2160
2164
2164
2164
2160
2160
2164
2164
2168
2164
2164
2164
2164
2164
2168
2168
2172
2172
2168
2168
2177
2172
2172
2177
2185
2181
2181
2172
2177
2189
2181
2181
2185
2185
2181
2185
2185
2189
2185
2189
2189
2189
2189
2193
2189
2189
2193
2193
2193
2197
2197
2197
2197
2201
2197
2201
2197
2193
2205
2205
2201
2197
2201
2201
2205
2201
2201
2205
2205
2209
2205
2205
2205
2209
2205
2209
2213
2213
2213
2213
2213
2213
2213
2213
2217
2213
2217
2221
2221
2217
2217
2217
2221
2217
2221
2221
2225
2217
2225
2221
2225
2225
2225
2225
2225
2229
2229
2225
2225
2229
2229
2229
2233
2229
2229
2233
2233
2229
2237
2233
2241
2241
2241
2241
2233
2233
2237
2241
2241
2241
2237
2245
2249
2245
2249
2249
2241
2245
2249
2245
2245
2249
2245
2249
2253
2249
2253
2249
2253
2257
2253
2257
2253
2253
2257
2257
2257
2261
2257
2257
2261
2257
2257
2261
2261
2257
2265
2265
2261
2265
2261
2265
2265
2265
2269
2265
2265
2269
2265
2269
2269
2269
2273
2273
2273
2273
2273
2273
2273
2273
2273
2273
2277
2277
2277
2281
2281
2277
2277
2281
2277
2277
2281
2277
2277
2277
2281
2281
2281
2285
2285
2285
2289
2289
2285
2285
2285
2289
2293
2289
2293
2293
2289
2293
2293
2293
2293
2293
2289
2293
2297
2293
2293
2293
2297
2301
2297
2297
2301
2297
2305
2301
2305
2301
2305
2305
2309
2301
2305
2305
2305
2301
2309
2313
2309
2313
2313
2317
2309
2313
2317
2313
2313
2313
2313
2317
2321
2321
2321
2321
2325
2325
2325
2321
2325
2325
2329
2329
2325
2329
2333
2333
2329
2329
2329
2329
2337
2333
2333
2329
2333
2333
2341
2341
2337
2341
2337
2345
2341
2341
2345
2345
2341
2349
2341
2345
2349
2345
2349
2349
2345
2349
2345
2345
2349
2353
2349
2349
2349
2349
2353
2353
2353
2353
2353
2353
2353
2357
2361
2357
2357
2361
2361
2365
2361
2357
2361
2361
2361
2361
2365
2365
2361
2365
2369
2365
2365
2369
2369
2373
2373
2369
2369
2369
2369
2373
2369
2373
2373
2377
2373
2381
2377
2373
2373
2373
2377
2381
2381
2381
2381
2381
2381
2381
2381
2381
2381
2385
2381
2385
2385
2389
2389
2389
2389
2385
2389
2393
2389
2389
2389
2393
2389
2393
2393
2393
2397
2401
2393
2393
2397
2397
2401
2397
2401
2397
2401
2401
2405
2405
2405
2405
2405
2409
2405
2409
2409
2409
2409
2409
2409
2413
2409
2417
2413
2413
2409
2413
2413
2413
2417
2417
2417
2417
2417
2417
2421
2417
2417
2417
2421
2421
2421
2417
2421
2417
2421
2421
2421
2425
2421
2421
2425
2429
2429
2425
2429
2434
2434
2429
2429
2429
2438
2434
2442
2434
2442
2438
2442
2438
2442
2438
2442
2442
2442
2446
2446
2442
2446
2446
2450
2450
2450
2446
2442
2450
2446
2450
2450
2450
2450
2446
2454
2454
2454
2454
2454
2454
2454
2454
2454
2454
2454
2458
2458
2462
2462
2462
2458
2462
2462
2462
2458
2466
2466
2462
2466
2466
2466
2466
2466
2470
2470
2466
2470
2466
2470
2474
2474
2474
2470
2478
2474
2474
2474
2474
2474
2478
2478
2482
2478
2474
2474
2482
2478
2478
2478
2482
2482
2486
2486
2486
2486
2482
2490
2486
2482
2486
2486
2490
2490
2490
2490
2486
2490
2490
2490
2490
2490
2490
2490
2498
2498
2498
2498
2494
2494
2502
2494
2494
2498
2502
2498
2506
2506
2502
2502
2502
2498
2502
2502
2506
2506
2502
2506
2510
2510
2514
2506
2510
2514
2514
2510
2514
2514
2514
2518
2518
2514
2514
2518
2522
2518
2522
2518
2522
2514
2518
2522
2518
2522
2518
2522
2526
2526
2526
2526
2526
2522
2526
2522
2530
2526
2526
2526
2530
2526
2526
2526
2530
2530
2534
2530
2530
2534
2534
2538
2538
2538
2530
2538
2538
2538
2534
2538
2538
2534
2538
2538
2538
2542
2542
2542
2542
2538
2546
2546
2542
2550
2546
2546
2546
2546
2542
2550
2546
2546
2550
2546
2546
2554
2554
2550
2550
2554
2550
2558
2550
2554
2554
2554
2554
2554
2558
2558
2558
2558
2562
2562
2558
2562
2562
2562
2558
2558
2562
2562
2566
2562
2562
2566
2566
2570
2570
2570
2570
2570
2574
2566
2574
2578
2574
2574
2578
2574
2574
2578
2578
2574
2578
2574
2582
2578
2578
2578
2582
2582
2586
2586
2578
2578
2582
2582
2582
2586
2586
2586
2586
2590
2586
2590
2586
2586
2590
2590
2594
2594
2590
2594
2594
2590
2598
2598
2594
2598
2594
2598
2594
2598
2594
2598
2598
2602
2598
2602
2602
2602
2606
2602
2606
2602
2602
2606
2606
2606
2606
2606
2606
2610
2606
2610
2606
2610
2606
2610
2610
2610
2610
2610
2606
2610
2610
2614
2614
2614
2614
2610
2614
2614
2614
2614
2614
2614
2618
2618
2618
2618
2618
2622
2618
2618
2622
2618
2626
2626
2626
2622
2626
2630
2630
2630
2630
2630
2622
2626
2626
2630
2630
2630
2630
2630
2634
2634
2634
2634
2634
2634
2638
2638
2638
2638
2638
2642
2642
2638
2638
2638
2642
2638
2642
2638
2642
2642
2646
2642
2646
2646
2642
2650
2650
2650
2650
2646
2646
2646
2650
2650
2650
2650
2646
2650
2654
2654
2654
2650
2654
2654
2654
2654
2658
2654
2654
2654
2658
2654
2658
2658
2662
2658
2662
2662
2662
2658
2666
2666
2666
2662
2666
2670
2666
2662
2666
2666
2666
2670
2670
2666
2670
2666
2670
2670
2670
2666
2674
2670
2670
2674
2670
2674
2670
2670
2674
2674
2678
2674
2674
2674
2674
2678
2678
2678
2674
2678
2682
2678
2682
2682
2678
2682
2682
2678
2682
2682
2678
2686
2682
2682
2682
2682
2686
2686
2691
2695
2695
2695
2695
2695
2695
2699
2699
2703
2695
2695
2703
2703
2699
2699
2703
2703
2707
2703
2703
2707
2711
2703
2707
2711
2711
2711
2707
2715
2711
2711
2711
2711
2719
2719
2715
2715
2719
2719
2723
2719
2719
2723
2723
2727
2719
2727
2727
2727
2727
2727
2731
2727
2731
2731
2735
2735
2731
2735
2735
2739
2735
2735
2739
2739
2739
2739
2743
2743
2743
2743
2743
2743
2743
2743
2739
2747
2747
2747
2747
2747
2747
2743
2747
2747
2747
2751
2751
2751
2751
2747
2751
2751
2755
2755
2751
2755
2755
2759
2755
2755
2759
2763
2759
2759
2763
2759
2759
2763
2759
2763
2763
2763
2767
2767
2767
2767
2763
2767
2771
2771
2771
2767
2771
2771
2771
2771
2771
2771
2775
2775
2775
2779
2779
2775
2779
2779
2775
2779
2779
2779
2779
2779
2779
2783
2787
2787
2783
2783
2787
2791
2783
2783
2791
2791
2787
2791
2795
2791
2791
2795
2791
2791
2795
2795
2795
2799
2795
2799
2799
2799
2799
2799
2799
2803
2803
2795
2795
2799
2799
2803
2799
2803
2803
2803
2803
2799
2803
2807
2803
2803
2807
2807
2807
2807
2803
2811
2811
2807
2811
2811
2811
2811
2807
2815
2811
2811
2815
2815
2819
2815
2819
2819
2815
2823
2823
2819
2823
2827
2827
2827
2823
2823
2823
2827
2831
2831
2831
2831
2831
2835
2835
2831
2831
2835
2839
2839
2839
2839
2839
2839
2835
2839
2843
2839
2839
2843
2847
2847
2847
2843
2843
2847
2847
2847
2847
2847
2847
2847
2851
2851
2851
2851
2847
2851
2855
2855
2851
2851
2855
2855
2851
2855
2859
2859
2859
2855
2859
2863
2859
2859
2859
2859
2859
2863
2863
2867
2863
2867
2867
2867
2867
2867
2867
2863
2867
2871
2871
2871
2871
2875
2875
2875
2875
2879
2879
2883
2879
2883
2883
2883
2883
2887
2887
2887
2887
2887
2887
2891
2887
2891
2891
2891
2891
2895
2895
2895
2895
2891
2899
2895
2899
2895
2899
2899
2899
2899
2899
2903
2903
2903
2899
2907
2907
2903
2907
2907
2903
2907
2907
2911
2911
2911
2911
2911
2911
2915
2915
2911
2915
2915
2919
2915
2919
2919
2915
2919
2919
2923
2923
2923
2923
2919
2923
2923
2923
2923
2927
2927
2927
2927
2927
2927
2927
2927
2927
2931
2931
2931
2935
2935
2931
2931
2935
2935
2935
2935
2935
2939
2935
2935
2935
2939
2939
2935
2939
2943
2943
2939
2943
2943
2948
2943
2943
2948
2948
2948
2948
2943
2952
2952
2948
2948
2952
2956
2956
2956
2956
2956
2956
2956
2956
2960
2960
2960
2960
2960
2960
2960
2964
2964
2964
2964
2964
2964
2968
2968
2968
2968
2968
2972
2968
2972
2972
2972
2968
2972
2968
2976
2976
2976
2972
2984
2984
2976
2976
2980
2980
2980
2980
2980
2984
2980
2980
2984
2984
2984
2984
2984
2988
2984
2988
2984
2992
2992
2988
2992
2992
2992
2992
2992
2992
2996
2996
2996
2996
2996
2996
2996
2996
3000
3000
3000
3000
3000
3000
3004
3004
3004
3004
3004
3008
3004
3004
3008
3008
3008
3008
3012
3008
3012
3008
3012
3012
3012
3012
3012
3016
3016
3016
3016
3020
3016
3016
3020
3024
3020
3020
3020
3024
3024
3024
3024
3024
3024
3024
3024
3024
3028
3028
3028
3028
3028
3028
3028
3028
3028
3032
3032
3032
3032
3036
3032
3032
3036
3036
3036
3036
3036
3036
3040
3036
3036
3036
3040
3040
3040
3040
3044
3044
3040
3044
3048
3044
3044
3048
3048
3048
3048
3048
3048
3052
3052
3052
3052
3056
3056
3056
3052
3056
3056
3060
3056
3060
3060
3060
3060
3060
3064
3064
3060
3064
3064
3064
3064
3064
3064
3068
3068
3068
3068
3068
3072
3072
3072
3072
3072
3072
3072
3076
3076
3076
3076
3076
3080
3080
3076
3080
3080
3080
3080
3080
3084
3084
3080
3080
3084
3084
3080
3084
3084
3084
3084
3084
3084
3088
3088
3088
3088
3092
3092
3092
3088
3092
3092
3092
3092
3092
3096
3096
3096
3096
3096
3100
3100
3100
3096
3100
3100
3100
3100
3104
3104
3100
3104
3104
3104
3104
3104
3104
3104
3108
3104
3104
3108
3108
3108
3108
3112
3108
3112
3108
3112
3112
3112
3112
3112
3112
3112
3112
3116
3116
3116
3116
3116
3120
3120
3120
3120
3120
3120
3116
3120
3120
3124
3124
3124
3124
3128
3124
3128
3128
3128
3128
3128
3128
3128
3132
3132
3132
3132
3132
3132
3132
3132
3136
3136
3136
3136
3132
3140
3140
3136
3136
3136
3140
3140
3140
3140
3140
3140
3144
3144
3144
3144
3144
3144
3148
3148
3148
3148
3152
3152
3152
3148
3152
3152
3152
3152
3152
3152
3156
3156
3156
3160
3160
3160
3160
3160
3160
3160
3160
3160
3164
3164
3164
3164
3164
3164
3168
3168
3168
3168
3168
3168
3168
3172
3168
3168
3168
3172
3172
3168
3172
3176
3172
3176
3176
3176
3176
3176
3176
3176
3180
3176
3180
3180
3180
3180
3180
3180
3184
3184
3180
3184
3184
3184
3184
3184
3184
3188
3188
3188
3188
3188
3192
3192
3188
3192
3192
3192
3192
3192
3196
3192
3192
3192
3196
3196
3196
3196
3201
3201
3201
3201
3201
3201
3201
3201
3201
3205
3201
3205
3201
3205
3205
3205
3205
3209
3209
3205
3209
3209
3209
3209
3209
3209
3209
3213
3209
3209
3213
3213
3213
3213
3213
3217
3217
3217
3217
3217
3217
3217
3217
3221
3221
3221
3221
3221
3225
3225
3225
3225
3225
3225
3225
3225
3229
3229
3229
3229
3229
3229
3237
3237
3241
3245
3245
3245
3245
3249
3249
3249
3249
3249
3249
3253
3253
3253
3253
3249
3253
3253
3253
3253
3257
3257
3257
3261
3261
3261
3261
3261
3261
3261
3265
3261
3261
3265
3265
3265
3265
3265
3269
3269
3269
3269
3269
3269
3269
3273
3273
3269
3273
3273
3273
3273
3273
3273
3277
3277
3277
3277
3277
3281
3281
3281
3281
3277
3281
3281
3281
3281
3285
3285
3285
3285
3285
3289
3285
3289
3293
3293
3289
3289
3289
3289
3293
3293
3293
3293
3293
3297
3297
3297
3297
3297
3297
3301
3301
3297
3297
3301
3301
3301
3301
3301
3301
3301
3301
3305
3305
3305
3305
3305
3309
3305
3305
3305
3309
3309
3309
3309
3309
3309
3313
3313
3313
3313
3313
3313
3317
3313
3313
3313
3317
3317
3317
3317
3317
3321
3321
3321
3321
3325
3325
3325
3321
3321
3321
3325
3325
3325
3329
3329
3329
3329
3329
3333
3333
3333
3333
3333
3333
3333
3333
3333
3333
3333
3333
3337
3341
3341
3341
3341
3337
3341
3345
3345
3345
3341
3341
3341
3349
3353
3353
3353
3357
3357
3357
3357
3357
3357
3361
3361
3361
3357
3357
3361
3361
3361
3361
3361
3365
3361
3365
3365
3365
3365
3369
3369
3369
3369
3369
3369
3369
3369
3369
3369
3373
3373
3373
3377
3377
3377
3377
3377
3377
3373
3377
3377
3377
3377
3377
3381
3381
3381
3381
3385
3385
3385
3385
3389
3389
3385
3385
3385
3385
3389
3389
3389
3389
3389
3393
3393
3393
3397
3397
3397
3397
3393
3393
3397
3397
3397
3397
3401
3401
3401
3401
3405
3405
3405
3409
3409
3409
3405
3405
3409
3409
3409
3409
3409
3413
3413
3417
3413
3417
3417
3413
3413
3417
3417
3413
3417
3417
3417
3417
3421
3421
3421
3421
3425
3429
3425
3425
3429
3429
3425
3425
3425
3425
3429
3429
3429
3429
3433
3433
3433
3433
3433
3433
3437
3433
3433
3433
3437
3437
3437
3441
3441
3441
3441
3441
3441
3445
3441
3445
3445
3445
3441
3445
3445
3445
3445
3445
3445
3449
3449
3449
3449
3453
3453
3453
3453
3453
3453
3453
3453
3453
3453
3462
3462
3462
3462
3466
3466
3466
3466
3466
3470
3470
3466
3466
3470
3466
3470
3470
3470
3470
3470
3474
3474
3474
3478
3478
3478
3478
3474
3474
3474
3478
3478
3478
3478
3478
3482
3482
3482
3486
3486
3486
3486
3486
3482
3486
3486
3486
3486
3486
3486
3486
3490
3490
3490
3494
3494
3494
3494
3494
3490
3490
3494
3494
3494
3494
3498
3498
3498
3498
3498
3502
3502
3498
3502
3502
3498
3498
3502
3502
3502
3502
3502
3506
3506
3506
3506
3506
3506
3506
3510
3510
3506
3506
3510
3510
3510
3510
3510
3514
3514
3510
3514
3514
3514
3518
3518
3514
3514
3518
3518
3518
3518
3522
3518
3522
3522
3522
3522
3522
3526
3526
3526
3530
3526
3526
3526
3530
3530
3526
3530
3530
3530
3534
3534
3534
3534
3538
3538
3538
3534
3534
3538
3538
3534
3538
3538
3538
3542
3542
3542
3546
3546
3546
3546
3550
3546
3546
3546
3546
3550
3550
3550
3550
3550
3550
3554
3554
3554
3554
3558
3554
3554
3554
3554
3554
3558
3558
3558
3566
3566
3566
3566
3566
3570
3570
3570
3570
3566
3566
3570
3570
3570
3570
3570
3570
3570
3574
3574
3574
3574
3574
3574
3574
3574
3574
3574
3578
3578
3578
3578
3578
3578
3582
3578
3578
3582
3582
3582
3582
3582
3582
3582
3582
3586
3586
3586
3586
3586
3590
3590
3594
3594
3594
3594
3594
3590
3594
3598
3594
3598
3598
3598
3598
3598
3602
3602
3602
3606
3606
3606
3606
3606
3602
3606
3606
3610
3606
3610
3610
3610
3610
3614
3614
3614
3614
3618
3618
3614
3614
3618
3614
3618
3618
3618
3618
3622
3622
3622
3622
3626
3626
3626
3626
3626
3622
3622
3626
3626
3626
3626
3630
3630
3630
3634
3634
3634
3634
3634
3638
3634
3634
3634
3634
3638
3638
3638
3638
3642
3638
3638
3642
3646
3646
3646
3646
3642
3642
3642
3646
3646
3646
3646
3646
3646
3650
3650
3650
3650
3650
3654
3654
3650
3650
3654
3650
3654
3654
3654
3654
3658
3658
3658
3658
3658
3662
3658
3662
3658
3658
3658
3662
3662
3662
3662
3662
3666
3670
3670
3670
3674
3674
3674
3674
3674
3674
3674
3674
3678
3678
3682
3678
3678
3682
3678
3682
3682
3686
3686
3686
3682
3682
3686
3686
3686
3686
3686
3686
3690
3690
3690
3694
3694
3694
3694
3698
3694
3694
3694
3694
3694
3694
3698
3694
3698
3698
3698
3698
3698
3702
3702
3702
3702
3698
3702
3702
3702
3702
3702
3706
3706
3706
3706
3706
3706
3706
3710
3710
3706
3706
3706
3706
3710
3710
3710
3710
3715
3715
3715
3715
3719
3719
3719
3723
3719
3719
3719
3719
3723
3723
3723
3727
3727
3727
3727
3731
3727
3727
3731
3731
3727
3727
3731
3731
3731
3731
3731
3735
3735
3735
3735
3735
3735
3739
3739
3739
3735
3739
3739
3739
3739
3739
3739
3743
3743
3743
3743
3747
3747
3747
3747
3751
3747
3747
3747
3747
3751
3751
3751
3747
3751
3751
3751
3751
3755
3755
3755
3755
3755
3755
3755
3755
3755
3755
3755
3759
3759
3759
3759
3759
3759
3763
3763
3763
3763
3763
3763
3763
3763
3763
3767
3767
3767
3767
3767
3775
3775
3779
3775
3779
3775
3779
3775
3779
3779
3779
3779
3783
3783
3783
3783
3783
3783
3787
3787
3787
3779
3783
3787
3783
3787
3787
3787
3787
3791
3791
3791
3795
3795
3795
3795
3795
3791
3791
3791
3791
3795
3795
3795
3799
3799
3799
3799
3803
3799
3799
3803
3803
3799
3799
3803
3803
3803
3803
3807
3807
3807
3811
3811
3811
3811
3811
3811
3815
3811
3811
3811
3815
3815
3815
3815
3815
3819
3819
3819
3819
3819
3819
3823
3823
3819
3819
3823
3819
3823
3823
3827
3823
3827
3827
3827
3827
3827
3831
3831
3831
3831
3831
3831
3831
3831
3831
3831
3835
3835
3835
3835
3839
3839
3839
3839
3843
3835
3839
3839
3839
3839
3839
3839
3839
3843
3847
3847
3847
3847
3847
3847
3851
3847
3851
3847
3851
3851
3851
3851
3851
3855
3855
3855
3859
3855
3859
3859
3863
3855
3859
3855
3859
3859
3859
3863
3863
3863
3863
3863
3863
3867
3867
3867
3867
3863
3867
3867
3863
3867
3867
3871
3871
3871
3871
3875
3875
3871
3883
3883
3883
3879
3879
3883
3883
3883
3883
3883
3887
3887
3891
3887
3887
3887
3891
3891
3895
3891
3891
3891
3895
3895
3895
3895
3899
3899
3899
3899
3903
3903
3903
3903
3907
3903
3903
3903
3907
3907
3907
3907
3907
3907
3907
3911
3911
3911
3911
3911
3915
3911
3911
3911
3911
3915
3911
3915
3915
3915
3919
3919
3919
3919
3919
3919
3923
3919
3919
3919
3923
3919
3923
3923
3919
3923
3927
3927
3927
3927
3927
3927
3927
3927
3927
3927
3927
3927
3931
3931
3935
3935
3931
3935
3935
3939
3935
3939
3939
3935
3935
3939
3939
3939
3943
3939
3943
3943
3943
3943
3943
3947
3947
3943
3947
3943
3947
3947
3947
3947
3951
3947
3951
3951
3951
3951
3955
3955
3951
3955
3955
3951
3955
3955
3955
3955
3955
3959
3959
3959
3963
3963
3963
3963
3963
3963
3963
3963
3963
3963
3963
3967
3967
3967
3967
3972
3972
3972
3972
3976
3972
3976
3980
3972
3976
3976
3976
3976
3980
3980
3980
3980
3984
3984
3984
3984
3988
3988
3992
3992
3992
3992
3992
3996
3996
3992
3996
3996
3996
4000
4000
4000
4000
4004
4004
4000
4000
4000
4004
4000
4004
4008
4004
4008
4008
4008
4008
4012
4012
4012
4012
4008
4012
4012
4012
4012
4016
4012
4016
4020
4016
4020
4020
4020
4020
4024
4024
4020
4020
4020
4024
4024
4024
4024
4024
4028
4028
4028
4028
4032
4032
4032
4032
4028
4028
4028
4032
4032
4036
4036
4036
4036
4036
4040
4040
4040
4040
4040
4040
4036
4036
4040
4040
4040
4044
4044
4044
4048
4048
4048
4048
4048
4052
4052
4048
4048
4048
4048
4052
4052
4052
4052
4056
4056
4056
4056
4056
4060
4060
4060
4064
4056
4060
4060
4060
4060
4060
4064
4064
4064
4064
4064
4068
4068
4068
4068
4072
4068
4068
4068
4072
4072
4072
4072
4072
4076
4076
4076
4076
4080
4080
4080
4080
4076
4076
4080
4080
4076
4080
4080
4084
4084
4084
4084
4084
4084
4088
4088
4088
4084
4088
4088
4088
4088
4088
4088
4092
4092
4092
4092
4096
4096
4096
4096
4096
4096
4096
4096
4096
4096
4096
4096
4096
4096
4096
4096
4096
4096
4096
4096
4096
4096
4096
4096
4096
4096
4096
4096
4096
4096
4096
4096
4096
4096
4096
4096
4096
4096
4096
4096
4096
4096
4096
4096
4096
4096
4096
4096
4096
4096
4096
4096
4096
4096
4096
4096
4096
4096
4096
4096
4096
4096
4096
4096
4096
4096
4096
4096
4096
4096
4096
4096
4096
4096
4096
4096
4096
4096
4096
4096
4096
4096
4096
4096
4096
4096
4096
4096
4096
4096
4096
4096
4096
4096
4096
4096
4096
4096
4096
4096
4096
4096
4096
4096
4096
4096
4096
4096
4096
4096
4096
4096
4096
4096
4096
4096
4096
4096
4096
4096
4096
4096
4096
4096
4096
4096
4096
4096
4096
4096
4096
4096
4096
4096
4096
4096
4096
4096
4096
4096
4096
4096
4096
4096
4096
4096
4096
4096
4096
4096
4096
4096
4096
4096
4096
4096
4096
4096
4096
4096
4096
4096
4096
4096
4096
4096
4096
4096
4096
4096
4096
4096
4096
4096
4096
4096
4096
4096
4096
4096
4096
4096
4096
4096
4096
4096
4096
4096
4096
4096
4096
4096
4096
4096
4096
4096
4096
4096
4096
4096
4096
4096
4096
4096
4096
4096
4096
4096
4096
4096
4096
4096
4096
4096
4096
4096
4096
4096
4096
4096
4096
4096
4096
4096
4096
4096
4096
4096
4096
4096
4096
4096
4096
4096
4096
4096
4096
4096
4096
4096
4096
4096
4096
4096
4096
4096
4096
4096
4096
4096
4096
4096
4096
4096
4096
4096
4096
4096
4096
4096
4096
4096
4096
4096
4096
4096
4096
4096
4096
4096
4096
4096
4096
4096
4096
4096
4096
4096
4096
4096
4096
4096
4096
4096
4096
4096
4096
4096
4096
4096
4096
4096
4096
4096
4096
4096
4096
4096
4096
4096
4096
4096
4096
4096
4096
4096
4096
4096
4096
4096
4096
4096
4096
4096
4096
4096
4096
4096
4096
4096
4096
4096
4096
4096
4096
4096
4096
4096
4096
4096
4096
4096
4096
4096
4096
4096
4096
4096
4096
4096
4096
4096
4096
4096
4096
4096
4096
4096
4096
4096
4096
4096
4096
4096
4096
4096
4096
4096
4096
4096
4096
4096
4096
4096
4096
4096
4096
4096
4096
4096
4096
4096
4096
4096
4096
4096
4096
4096
4096
4096
4096
4096
4096
4096
4096
4096
4096
4096
4096
4096
4096
4096
4096
4096
4096
4096
4096
4096
4096
4096
4096
4096
4096
4096
4096
4096
4096
4096
4096
4096
4096
4096
4096
4096
4096
4096
4096
4096
4096
4096
4096
4096
4096
4096
4096
4096
4096
4096
4096
4096
4096
4096
4096
4096
4096
4096
4096
4096
4096
4096
4096
4096
4096
4096
4096
4096
4096
4096
4096
4096
4096
4096
4096
4096
4096
4096
4096
4096
4096
4096
4096
4096
4096
4096
4096
4096
4096
4096
4096
4096
4096
4096
4096
4096
4096
4096
4096
4096
4096
4096
4096
4096
4096
4096
4096
4096
4096
4096
4096
4096
4096
4096
4096
4096
4096
4096
4096
4096
4096
4096
4096
4096
4096
4096
4096
4096
4096
4096
4096
4096
4096
4096
4096
4096
4096
4096
4096
4096
4096
4096
4096
4096
4096
4096
4096
4096
4096
4096
4096
4096
4096
4096
4096
4096
4096
4096
4096
4096
4096
4096
4096
4096
4096
4096
4096
4096
4096
4096
4096
4096
4096
4096
4096
4096
4096
4096
4096
4096
4096
4096
4096
4096
4096
4096
4096
4096
4096
4096
4096
4096
4096
4096
4096
4096
4096
4096
4096
4096
4096
4096
4096
4096
4096
4096
4096
4096
4096
4096
4096
4096
4096
4096
4096
4096
4096
4096
4096
4096
4096
4096
4096
4096
4096
4096
4096
4096
4096
4096
4096
4096
4096
4096
4096
4096
4096
4096
4096
4096
4096
4096
4096
4096
4096
4096
4096
4096
4096
4096
4096
4096
4096
4096
4096
4096
4096
4096
4096
4096
4096
4096
4096
4096
4096
4096
4096
4096
4096
4096
4096
4096
4096
4096
4096
4096
4096
4096
4096
4096
4096
4096
4096
4096
4096
4096
4096
4096
4096
4096
4096
4096
4096
4096
4096
4096
4096
4096
4096
4096
4096
4096
4096
4096
4096
4096
4096
4096
4096
4096
4096
4096
4096
4096
4096
4096
4096
4096
4096
4096
4096
4096
4096
4096
4096
4096
4096
4096
4096
4096
4096
4096
4096
4096
4096
4096
4096
4096
4096
4096
4096
4096
4096
4096
4096
4096
4096
4096
4096
4096
4096
4096
4096
4096
4096
4096
4096
4096
4096
4096
4096
4096
4096
4096
4096
4096
4096
4096
4096
4096
4096
4096
4096
4096
4096
4096
4096
4096
4096
4096
4096
4096
4096
4096
4096
4096
4096
4096
4096
4096
4096
4096
4096
4096
4096
4096
4096
4096
4096
4096
4096
4096
4096
4096
4096
4096
4096
4096
4096
4096
4096
4096
4096
4096
4096
4096
4096
4096
4096
4096
4096
4096
4096
4096
4096
4096
4096
4096
4096
4096
4096
4096
4096
4096
4096
4096
4096
4096
4096
4096
4096
4096
4096
4096
4096
4096
4096
4096
4096
4096
4096
4096
4096
4096
4096
4096
4096
4096
4096
4096
4096
4096
4096
4096
4096
4096
4096
4096
4096
4096
4096
4096
4096
4096
4096
4096
4096
4096
4096
4096
4096
4096
4096
4096
4096
4096
4096
4096
4096
4096
4096
4096
4096
4096
4096
4096
4096
4096
4096
4096
4096
4096
4096
4096
4096
4096
4096
4096
4096
4096
4096
4096
4096
4096
4096
4096
4096
4096
4096
4096
4096
4096
4096
4096
4096
4096
4096
4096
4096
4096
4096
4096
4096
4096
4096
4096
4096
4096
4096
4096
4096
4096
4096
4096
4096
4096
4096
4096
4096
4096
4096
4096
4096
4096
4096
4096
4096
4096
4096
4096
4096
4096
4096
4096
4096
4096
4096
4096
4096
4096
4096
4096
4096
4096
4096
4096
4096
4096
4096
4096
4096
4096
4096
4096
4096
4096
4096
4096
4096
4096
4096
4096
4096
4096
4096
4096
4096
4096
4096
4096
4096
4096
4096
4096
4096
4096
4096
4096
4096
4096
4096
4096
4096
4096
4096
4096
4096
4096
4096
4096
4096
4096
4096
4096
4096
4096
4096
4096
4096
4096
4096
4096
4096
4096
4096
4096
4096
4096
4096
4096
4096
4096
4096
4096
4096
4096
4096
4096
4096
4096
4096
4096
4096
4096
4096
4096
4096
4096
4096
4096
4096
4096
4096
4096
4096
4096
4096
4096
4096
4096
4096
4096
4096
4096
4096
4096
4096
4096
4096
4096
4096
4096
4096
4096
4096
4096
4096
4096
4096
4096
4096
4096
4096
4096
4096
4096
4096
4096
4096
4096
4096
4096
4096
4096
4096
4096
4096
4096
4096
4096
4096
4096
4096
4096
4096
4096
4096
4096
4096
4096
4096
4096
4096
4096
4096
4096
4096
4096
4096
4096
4096
4096
4096
4096
4096
4096
4096
4096
4096
4096
4096
4096
4096
4096
4096
4096
4096
4096
4096
4096
4096
4096
4096
4096
4096
4096
4096
4096
4096
4096
4096
4096
4096
4096
4096
4096
4096
4096
4096
4096
4096
4096
4096
4096
4096
4096
4096
4096
4096
4096
4096
4096
4096
4096
4096
4096
4096
4096
4096
4096
4096
4096
4096
4096
4096
4096
4096
4096
4096
4096
4096
4096
4096
4096
4096
4096
4096
4096
4096
4096
4096
4096
4096
4096
4096
4096
4096
4096
4096
4096
4096
4096
4096
4096
4096
4096
4096
4096
4096
4096
4096
4096
4096
4096
4096
4096
4096
4096
4096
4096
4096
4096
4096
4096
4096
4096
4096
4096
4096
4096
4096
4096
4096
4096
4096
4096
4096
4096
4096
4096
4096
4096
4096
4096
4096
4096
4096
4096
4096
4096
4096
4096
4096
4096
4096
4096
4096
4096
4096
4096
4096
4096
4096
4096
4096
4096
4096
4096
4096
4096
4096
4096
4096
4096
4096
4096
4096
4096
4096
4096
4096
4096
4096
4096
4096
4096
4096
4096
4096
4096
4096
4096
4096
4096
4096
4096
4096
4096
4096
4096
4096
4096
4096
4096
4096
4096
4096
4096
4096
4096
4096
4096
4096
4096
4096
4096
4096
4096
4096
4096
4096
4096
4096
4096
4096
4096
4096
4096
4096
4096
4096
4096
4096
4096
4096
4096
4096
4096
4096
4096
4096
4096
4096
4096
4096
4096
4096
4096
4096
4096
4096
4096
4096
4096
4096
4096
4096
4096
4096
4096
4096
4096
4096
4096
4096
4096
4096
4096
4096
4096
4096
4096
4096
4096
4096
4096
4096
4096
4096
4096
4096
4096
4096
4096
4096
4096
4096
4096
4096
4096
4096
4096
4096
4096
4096
4096
4096
4096
4096
4096
4096
4096
4096
4096
4096
4096
4096
4096
4096
4096
4096
4096
4096
4096
4096
4096
4096
4096
4096
4096
4096
4096
4096
4096
4096
4096
4096
4096
4096
4096
4096
4096
4096
4096
4096
4096
4096
4096
4096
4096
4096
4096
4096
4096
4096
4096
4096
4096
4096
4096
4096
4096
4096
4096
4096
4096
4096
4096
4096
4096
4096
4096
4096
4096
4096
4096
4096
4096
4096
4096
4096
4096
4096
4096
4096
4096
4096
4096
4096
4096
4096
4096
4096
4096
4096
4096
4096
4096
4096
4096
4096
4096
4096
4096
4096
4096
4096
4096
4096
4096
4096
4096
4096
4096
4096
4096
4096
4096
4096
4096
4096
4096
4096
4096
4096
4096
4096
4096
4096
4096
4096
4096
4096
4096
4096
4096
4096
4096
4096
4096
4096
4096
4096
4096
4096
4096
4096
4096
4096
4096
4096
4096
4096
4096
4096
4096
4096
4096
4096
4096
4096
4096
4096
4096
4096
4096
4096
4096
4096
4096
4096
4096
4096
4096
4096
4096
4096
4096
4096
4096
4096
4096
4096
4096
4096
4096
4096
4096
4096
4096
4096
4096
4096
4096
4096
4096
4096
4096
4096
4096
4096
4096
4096
4096
4096
4096
4096
4096
4096
4096
4096
4096
4096
4096
4096
4096
4096
4096
4096
4096
4096
4096
4096
4096
4096
4096
4096
4096
4096
4096
4096
4096
4096
4096
4096
4096
4096
4096
4096
4096
4096
4096
4096
4096
4096
4096
4096
4096
4096
4096
4096
4096
4096
4096
4096
4096
4096
4096
4096
4096
4096
4096
4096
4096
4096
4096
4096
4096
4096
4096
4096
4096
4096
4096
4096
4096
4096
4096
4096
4096
4096
4096
4096
4096
4096
4096
4096
4096
4096
4096
4096
4096
4096
4096
4096
4096
4096
4096
4096
4096
4096
4096
4096
4096
4096
4096
4096
4096
4096
4096
4096
4096
4096
4096
4096
4096
4096
4096
4096
4096
4096
4096
4096
4096
4096
4096
4096
4096
4096
4096
4096
4096
4096
4096
4096
4096
4096
4096
4096
4096
4096
4096
4096
4096
4096
4096
4096
4096
4096
4096
4096
4096
4096
4096
4096
4096
4096
4096
4096
4096
4096
4096
4096
4096
4096
4096
4096
4096
4096
4096
4096
4096
4096
4096
4096
4096
4096
4096
4096
4096
4096
4096
4096
4096
4096
4096
4096
4096
4096
4096
4096
4096
4096
4096
4096
4096
4096
4096
4096
4096
4096
4096
4096
4096
4096
4096
4096
4096
4096
4096
4096
4096
4096
4096
4096
4096
4096
4096
4096
4096
4096
4096
4096
4096
4096
4096
4096
4096
4096
4096
4096
4096
4096
4096
4096
4096
4096
4096
4096
4096
4096
4096
4096
4096
4096
4096
4096
4096
4096
4096
4096
4096
4096
4096
4096
4096
4096
4096
4096
4096
4096
4096
4096
4096
4096
4096
4096
4096
4096
4096
4096
4096
4096
4096
4096
4096
4096
4096
4096
4096
4096
4096
4096
4096
4096
4096
4096
4096
4096
4096
4096
4096
4096
4096
4096
4096
4096
4096
4096
4096
4096
4096
4096
4096
4096
4096
4096
4096
4096
4096
4096
4096
4096
4096
4096
4096
4096
4096
4096
4096
4096
4096
4096
4096
4096
4096
4096
4096
4096
4096
4096
4096
4096
4096
4096
4096
4096
4096
4096
4096
4096
4096
4096
4096
4096
4096
4096
4096
4096
4096
4096
4096
4096
4096
4096
4096
4096
4096
4096
4096
4096
4096
4096
4096
4096
4096
4096
4096
4096
4096
4096
4096
4096
4096
4096
4096
4096
4096
4096
4096
4096
4096
4096
4096
4096
4096
4096
4096
4096
4096
4096
4096
4096
4096
4096
4096
4096
4096
4096
4096
4096
4096
4096
4096
4096
4096
4096
4096
4096
4096
4096
4096
4096
4096
4096
4096
4096
4096
4096
4096
4096
4096
4096
4096
4096
4096
4096
4096
4096
4096
4096
4096
4096
4096
4096
4096
4096
4096
4096
4096
4096
4096
4096
4096
4096
4096
4096
4096
4096
4096
4096
4096
4096
4096
4096
4096
4096
4096
4096
4096
4096
4096
4096
4096
4096
4096
4096
4096
4096
4096
4096
4096
4096
4096
4096
4096
4096
4096
4096
4096
4096
4096
4096
4096
4096
4096
4096
4096
4096
4096
4096
4096
4096
4096
4096
4096
4096
4096
4096
4096
4096
4096
4096
4096
4096
4096
4096
4096
4096
4096
4096
4096
4096
4096
4096
4096
4096
4096
4096
4096
4096
4096
4096
4096
4096
4096
4096
4096
4096
4096
4096
4096
4096
4096
4096
4096
4096
4096
4096
4096
4096
4096
4096
4096
4096
4096
4096
4096
4096
4096
4096
4096
4096
4096
4096
4096
4096
4096
4096
4096
4096
4096
4096
4096
4096
4096
4096
4096
4096
4096
4096
4096
4096
4096
4096
4096
4096
4096
4096
4096
4096
4096
4096
4096
4096
4096
4096
4096
4096
4096
4096
4096
4096
4096
4096
4096
4096
4096
4096
4096
4096
4096
4096
4096
4096
4096
4096
4096
4096
4096
4096
4096
4096
4096
4096
4096
4096
4096
4096
4096
4096
4096
4096
4096
4096
4096
4096
4096
4096
4096
4096
4096
4096
4096
4096
4096
4096
4096
4096
4096
4096
4096
4096
4096
4096
4096
4096
4096
4096
4096
4096
4096
4096
4096
4096
4096
4096
4096
4096
4096
4096
4096
4096
4096
4096
4096
4096
4096
4096
4096
4096
4096
4096
4096
4096
4096
4096
4096
4096
4096
4096
4096
4096
4096
4096
4096
4096
4096
4096
4096
4096
4096
4096
4096
4096
4096
4096
4096
4096
4096
4096
4096
4096
4096
4096
4096
4096
4096
4096
4096
4096
4096
4096
4096
4096
4096
4096
4096
4096
4096
4096
4096
4096
4096
4096
4096
4096
4096
4096
4096
4096
4096
4096
4096
4096
4096
4096
4096
4096
4096
4096
4096
4096
4096
4096
4096
4096
4096
4096
4096
4096
4096
4096
4096
4096
4096
4096
4096
4096
4096
4096
4096
4096
4096
4096
4096
4096
4096
4096
4096
4096
4096
4096
4096
4096
4096
4096
4096
4096
4096
4096
4096
4096
4096
4096
4096
4096
4096
4096
4096
4096
4096
4096
4096
4096
4096
4096
4096
4096
4096
4096
4096
4096
4096
4096
4096
4096
4096
4096
4096
4096
4096
4096
4096
4096
4096
4096
4096
4096
4096
4096
4096
4096
4096
4096
4096
4096
4096
4096
4096
4096
4096
4096
4096
4096
4096
4096
4096
4096
4096
4096
4096
4096
4096
4096
4096
4096
4096
4096
4096
4096
4096
4096
4096
4096
4096
4096
4096
4096
4096
4096
4096
4096
4096
4096
4096
4096
4096
4096
4096
4096
4096
4096
4096
4096
4096
4096
4096
4096
4096
4096
4096
4096
4096
4096
4096
4096
4096
4096
4096
4096
4096
4096
4096
4096
4096
4096
4096
4096
4096
4096
4096
4096
4096
4096
4096
4096
4096
4096
4096
4096
4096
4096
4096
4096
4096
4096
4096
4096
4096
4096
4096
4096
4096
4096
4096
4096
4096
4096
4096
4096
4096
4096
4096
4096
4096
4096
4096
4096
4096
4096
4096
4096
4096
4096
4096
4096
4096
4096
4096
4096
4096
4096
4096
4096
4096
4096
4096
4096
4096
4096
4096
4096
4096
4096
4096
4096
4096
4096
4096
4096
4096
4096
4096
4096
4096
4096
4096
4096
4096
4096
4096
4096
4096
4096
4096
4096
4096
4096
4096
4096
4096
4096
4096
4096
4096
4096
4096
4096
4096
4096
4096
4096
4096
4096
4096
4096
4096
4096
4096
4096
4096
4096
4096
4096
4096
4096
4096
4096
4096
4096
4096
4096
4096
4096
4096
4096
4096
4096
4096
4096
4096
4096
4096
4096
4096
4096
4096
4096
4096
4096
4096
4096
4096
4096
4096
4096
4096
4096
4096
4096
4096
4096
4096
4096
4096
4096
4096
4096
4096
4096
4096
4096
4096
4096
4096
4096
4096
4096
4096
4096
4096
4096
4096
4096
4096
4096
4096
4096
4096
4096
4096
4096
4096
4096
4096
4096
4096
4096
4096
4096
4096
4096
4096
4096
4096
4096
4096
4096
4096
4096
4096
4096
4096
4096
4096
4096
4096
4096
4096
4096
4096
4096
4096
4096
4096
4096
4096
4096
4096
4096
4096
4096
4096
4096
4096
4096
4096
4096
4096
4096
4096
4096
4096
4096
4096
4096
4096
4096
4096
4096
4096
4096
4096
4096
4096
4096
4096
4096
4096
4096
4096
4096
4096
4096
4096
4096
4096
4096
4096
4096
4096
4096
4096
4096
4096
4096
4096
4096
4096
4096
4096
4096
4096
4096
4096
4096
4096
4096
4096
4096
4096
4096
4096
4096
4096
4096
4096
4096
4096
4096
4096
4096
4096
4096
4096
4096
4096
4096
4096
4096
4096
4096
4096
4096
4096
4096
4096
4096
4096
4096
4096
4096
4096
4096
4096
4096
4096
4096
4096
4096
4096
4096
4096
4096
4096
4096
4096
4096
4096
4096
4096
4096
4096
4096
4096
4096
4096
4096
4096
4096
4096
4096
4096
4096
4096
4096
4096
4096
4096
4096
4096
4096
4096
4096
4096
4096
4096
4096
4096
4096
4096
4096
4096
4096
4096
4096
4096
4096
4096
4096
4096
4096
4096
4096
4096
4096
4096
4096
4096
4096
4096
4096
4096
4096
4096
4096
4096
4096
4096
4096
4096
4096
4096
4096
4096
4096
4096
4096
4096
4096
4096
4096
4096
4096
4096
4096
4096
4096
4096
4096
4096
4096
4096
4096
4096
4096
4096
4096
4096
4096
4096
4096
4096
4096
4096
4096
4096
4096
4096
4096
4096
4096
4096
4096
4096
4096
4096
4096
4096
4096
4096
4096
4096
4096
4096
4096
4096
4096
4096
4096
4096
4096
4096
4096
4096
4096
4096
4096
4096
4096
4096
4096
4096
4096
4096
4096
4096
4096
4096
4096
4096
4096
4096
4096
4096
4096
4096
4096
4096
4096
4096
4096
4096
4096
4096
4096
4096
4096
4096
4096
4096
4096
4096
4096
4096
4096
4096
4096
4096
4096
4096
4096
4096
4096
4096
4096
4096
4096
4096
4096
4096
4096
4096
4096
4096
4096
4096
4096
4096
4096
4096
4096
4096
4096
4096
4096
4096
4096
4096
4096
4096
4096
4096
4096
4096
4096
4096
4096
4096
4096
4096
4096
4096
4096
4096
4096
4096
4096
4096
4096
4096
4096
4096
4096
4096
4096
4096
4096
4096
4096
4096
4096
4096
4096
4096
4096
4096
4096
4096
4096
4096
4096
4096
4096
4096
4096
4096
4096
4096
4096
4096
4096
4096
4096
4096
4096
4096
4096
4096
4096
4096
4096
4096
4096
4096
4096
4096
4096
4096
4096
4096
4096
4096
4096
4096
4096
4096
4096
4096
4096
4096
4096
4096
4096
4096
4096
4096
4096
4096
4096
4096
4096
4096
4096
4096
4096
4096
4096
4096
4096
4096
4096
4096
4096
4096
4096
4096
4096
4096
4096
4096
4096
4096
4096
4096
4096
4096
4096
4096
4096
4096
4096
4096
4096
4096
4096
4096
4096
4096
4096
4096
4096
4096
4096
4096
4096
4096
4096
4096
4096
4096
4096
4096
4096
4096
4096
4096
4096
4096
4096
4096
4096
4096
4096
4096
4096
4096
4096
4096
4096
4096
4096
4096
4096
4096
4096
4096
4096
4096
4096
4096
4096
4096
4096
4096
4096
4096
4096
4096
4096
4096
4096
4096
4096
4096
4096
4096
4096
4096
4096
4096
4096
4096
4096
4096
4096
4096
4096
4096
4096
4096
4096
4096
4096
4096
4096
4096
4096
4096
4096
4096
4096
4096
4096
4096
4096
4096
4096
4096
4096
4096
4096
4096
4096
4096
4096
4096
4096
4096
4096
4096
4096
4096
4096
4096
4096
4096
4096
4096
4096
4096
4096
4096
4096
4096
4096
4096
4096
4096
4096
4096
4096
4096
4096
4096
4096
4096
4096
4096
4096
4096
4096
4096
4096
4096
4096
4096
4096
4096
4096
4096
4096
4096
4096
4096
4096
4096
4096
4096
4096
4096
4096
4096
4096
4096
4096
4096
4096
4096
4096
4096
4096
4096
4096
4096
4096
4096
4096
4096
4096
4096
4096
4096
4096
4096
4096
4096
4096
4096
4096
4096
4096
4096
4096
4096
4096
4096
4096
4096
4096
4096
4096
4096
4096
4096
4096
4096
4096
4096
4096
4096
4096
4096
4096
4096
4096
4096
4096
4096
4096
4096
4096
4096
4096
4096
4096
4096
4096
4096
4096
4096
4096
4096
4096
4096
4096
4096
4096
4096
4096
4096
4096
4096
4096
4096
4096
4096
4096
4096
4096
4096
4096
4096
4096
4096
4096
4096
4096
4096
4096
4096
4096
4096
4096
4096
4096
4096
4096
4096
4096
4096
4096
4096
4096
4096
4096
4096
4096
4096
4096
4096
4096
4096
4096
4096
4096
4096
4096
4096
4096
4096
4096
4096
4096
4096
4096
4096
4096
4096
4096
4096
4096
4096
4096
4096
4096
4096
4096
4096
4096
4096
4096
4096
4096
4096
4096
4096
4096
4096
4096
4096
4096
4096
4096
4096
4096
4096
4096
4096
4096
4096
4096
4096
4096
4096
4096
4096
4096
4096
4096
4096
4096
4096
4096
4096
4096
4096
4096
4096
4096
4096
4096
4096
4096
4096
4096
4096
4096
4096
4096
4096
4096
4096
4096
4096
4096
4096
4096
4096
4096
4096
4096
4096
4096
4096
4096
4096
4096
4096
4096
4096
4096
4096
4096
4096
4096
4096
4096
4096
4096
4096
4096
4096
4096
4096
4096
4096
4096
4096
4096
4096
4096
4096
4096
4096
4096
4096
4096
4096
4096
4096
4096
4096
4096
4096
4096
4096
4096
4096
4096
4096
4096
4096
4096
4096
4096
4096
4096
4096
4096
4096
4096
4096
4096
4096
4096
4096
4096
4096
4096
4096
4096
4096
4096
4096
4096
4096
4096
4096
4096
4096
4096
4096
4096
4096
4096
4096
4096
4096
4096
4096
4096
4096
4096
4096
4096
4096
4096
4096
4096
4096
4096
4096
4096
4096
4096
4096
4096
4096
4096
4096
4096
4096
4096
4096
4096
4096
4096
4096
4096
4096
4096
4096
4096
4096
4096
4096
4096
4096
4096
4096
4096
4096
4096
4096
4096
4096
4096
4096
4096
4096
4096
4096
4096
4096
4096
4096
4096
4096
4096
4096
4096
4096
4096
4096
4096
4096
4096
4096
4096
4096
4096
4096
4096
4096
4096
4096
4096
4096
4096
4096
4096
4096
4096
4096
4096
4096
4096
4096
4096
4096
4096
4096
4096
4096
4096
4096
4096
4096
4096
4096
4096
4096
4096
4096
4096
4096
4096
4096
4096
4096
4096
4096
4096
4096
4096
4096
4096
4096
4096
4096
4096
4096
4096
4096
4096
4096
4096
4096
4096
4096
4096
4096
4096
4096
4096
4096
4096
4096
4096
4096
4096
4096
4096
4096
4096
4096
4096
4096
4096
4096
4096
4096
4096
4096
4096
4096
4096
4096
4096
4096
4096
4096
4096
4096
4096
4096
4096
4096
4096
4096
4096
4096
4096
4096
4096
4096
4096
4096
4096
4096
4096
4096
4096
4096
4096
4096
4096
4096
4096
4096
4096
4096
4096
4096
4096
4096
4096
4096
4096
4096
4096
4096
4096
4096
4096
4096
4096
4096
4096
4096
4096
4096
4096
4096
4096
4096
4096
4096
4096
4096
4096
4096
4096
4096
4096
4096
4096
4096
4096
4096
4096
4096
4096
4096
4096
4096
4096
4096
4096
4096
4096
4096
4096
4096
4096
4096
4096
4096
4096
4096
4096
4096
4096
4096
4096
4096
4096
4096
4096
4096
4096
4096
4096
4096
4096
4096
4096
4096
4096
4096
4096
4096
4096
4096
4096
4096
4096
4096
4096
4096
4096
4096
4096
4096
4096
4096
4096
4096
4096
4096
4096
4096
4096
4096
4096
4096
4096
4096
4096
4096
4096
4096
4096
4096
4096
4096
4096
4096
4096
4096
4096
4096
4096
4096
4096
4096
4096
4096
4096
4096
4096
4096
4096
4096
4096
4096
4096
4096
4096
4096
4096
4096
4096
4096
4096
4096
4096
4096
4096
4096
4096
4096
4096
4096
4096
4096
4096
4096
4096
4096
4096
4096
4096
4096
4096
4096
4096
4096
4096
4096
4096
4096
4096
4096
4096
4096
4096
4096
4096
4096
4096
4096
4096
4096
4096
4096
4096
4096
4096
4096
4096
4096
4096
4096
4096
4096
4096
4096
4096
4096
4096
4096
4096
4096
4096
4096
4096
4096
4096
4096
4096
4096
4096
4096
4096
4096
4096
4096
4096
4096
4096
4096
4096
4096
4096
4096
4096
4096
4096
4096
4096
4096
4096
4096
4096
4096
4096
4096
4096
4096
4096
4096
4096
4096
4096
4096
4096
4096
4096
4096
4096
4096
4096
4096
4096
4096
4096
4096
4096
4096
4096
4096
4096
4096
4096
4096
4096
4096
4096
4096
4096
4096
4096
4096
4096
4096
4096
4096
4096
4096
4096
4096
4096
4096
4096
4096
4096
4096
4096
4096
4096
4096
4096
4096
4096
4096
4096
4096
4096
4096
4096
4096
4096
4096
4096
4096
4096
4096
4096
4096
4096
4096
4096
4096
4096
4096
4096
4096
4096
4096
4096
4096
4096
4096
4096
4096
4096
4096
4096
4096
4096
4096
4096
4096
4096
4096
4096
4096
4096
4096
4096
4096
4096
4096
4096
4096
4096
4096
4096
4096
4096
4096
4096
4096
4096
4096
4096
4096
4096
4096
4096
4096
4096
4096
4096
4096
4096
4096
4096
4096
4096
4096
4096
4096
4096
4096
4096
4096
4096
4096
4096
4096
4096
4096
4096
4096
4096
4096
4096
4096
4096
4096
4096
4096
4096
4096
4096
4096
4096
4096
4096
4096
4096
4096
4096
4096
4096
4096
4096
4096
4096
4096
4096
4096
4096
4096
4096
4096
4096
4096
4096
4096
4096
4096
4096
4096
4096
4096
4096
4096
4096
4096
4096
4096
4096
4096
4096
4096
4096
4096
4096
4096
4096
4096
4096
4096
4096
4096
4096
4096
4096
4096
4096
4096
4096
4096
4096
4096
4096
4096
4096
4096
4096
4096
4096
4096
4096
4096
4096
4096
4096
4096
4096
4096
4096
4096
4096
4096
4096
4096
4096
4096
4096
4096
4096
4096
4096
4096
4096
4096
4096
4096
4096
4096
4096
4096
4096
4096
4096
4096
4096
4096
4096
4096
4096
4096
4096
4096
4096
4096
4096
4096
4096
4096
4096
4096
4096
4096
4096
4096
4096
4096
4096
4096
4096
4096
4096
4096
4096
4096
4096
4096
4096
4096
4096
4096
4096
4096
4096
4096
4096
4096
4096
4096
4096
4096
4096
4096
4096
4096
4096
4096
4096
4096
4096
4096
4096
4096
4096
4096
4096
4096
4096
4096
4096
4096
4096
4096
4096
4096
4096
4096
4096
4096
4096
4096
4096
4096
4096
4096
4096
4096
4096
4096
4096
4096
4096
4096
4096
4096
4096
4096
4096
4096
4096
4096
4096
4096
4096
4096
4096
4096
4096
4096
4096
4096
4096
4096
4096
4096
4096
4096
4096
4096
4096
4096
4096
4096
4096
4096
4096
4096
4096
4096
4096
4096
4096
4096
4096
4096
4096
4096
4096
4096
4096
4096
4096
4096
4096
4096
4096
4096
4096
4096
4096
4096
4096
4096
4096
4096
4096
4096
4096
4096
4096
4096
4096
4096
4096
4096
4096
4096
4096
4096
4096
4096
4096
4096
4096
4096
4096
4096
4096
4096
4096
4096
4096
4096
4096
4096
4096
4096
4096
4096
4096
4096
4096
4096
4096
4096
4096
4096
4096
4096
4096
4096
4096
4096
4096
4096
4096
4096
4096
4096
4096
4096
4096
4096
4096
4096
4096
4096
4096
4096
4096
4096
4096
4096
4096
4096
4096
4096
4096
4096
4096
4096
4096
4096
4096
4096
4096
4096
4096
4096
4096
4096
4096
4096
4096
4096
4096
4096
4096
4096
4096
4096
4096
4096
4096
4096
4096
4096
4096
4096
4096
4096
4096
4096
4096
4096
4096
4096
4096
4096
4096
4096
4096
4096
4096
4096
4096
4096
4096
4096
4096
4096
4096
4096
4096
4096
4096
4096
4096
4096
4096
4096
4096
4096
4096
4096
4096
4096
4096
4096
4096
4096
4096
4096
4096
4096
4096
4096
4096
4096
4096
4096
4096
4096
4096
4096
4096
4096
4096
4096
4096
4096
4096
4096
4096
4096
4096
4096
4096
4096
4096
4096
4096
4096
4096
4096
4096
4096
4096
4096
4096
4096
4096
4096
4096
4096
4096
4096
4096
4096
4096
4096
4096
4096
4096
4096
4096
4096
4096
4096
4096
4096
4096
4096
4096
4096
4096
4096
4096
4096
4096
4096
4096
4096
4096
4096
4096
4096
4096
4096
4096
4096
4096
4096
4096
4096
4096
4096
4096
4096
4096
4096
4096
4096
4096
4096
4096
4096
4096
4096
4096
4096
4096
4096
4096
4096
4096
4096
4096
4096
4096
4096
4096
4096
4096
4096
4096
4096
4096
4096
4096
4096
4096
4096
4096
4096
4096
4096
4096
4096
4096
4096
4096
4096
4096
4096
4096
4096
4096
4096
4096
4096
4096
4096
4096
4096
4096
4096
4096
4096
4096
4096
4096
4096
4096
4096
4096
4096
4096
4096
4096
4096
4096
4096
4096
4096
4096
4096
4096
4096
4096
4096
4096
4096
4096
4096
4096
4096
4096
4096
4096
4096
4096
4096
4096
4096
4096
4096
4096
4096
4096
4096
4096
4096
4096
4096
4096
4096
4096
4096
4096
4096
4096
4096
4096
4096
4096
4096
4096
4096
4096
4096
4096
4096
4096
4096
4096
4096
4096
4096
4096
4096
4096
4096
4096
4096
4096
4096
4096
4096
4096
4096
4096
4096
4096
4096
4096
4096
4096
4096
4096
4096
4096
4096
4096
4096
4096
4096
4096
4096
4096
4096
4096
4096
4096
4096
4096
4096
4096
4096
4096
4096
4096
4096
4096
4096
4096
4096
4096
4096
4096
4096
4096
4096
4096
4096
4096
4096
4096
4096
4096
4096
4096
4096
4096
4096
4096
4096
4096
4096
4096
4096
4096
4096
4096
4096
4096
4096
4096
4096
4096
4096
4096
4096
4096
4096
4096
4096
4096
4096
4096
4096
4096
4096
4096
4096
4096
4096
4096
4096
4096
4096
4096
4096
4096
4096
4096
4096
4096
4096
4096
4096
4096
4096
4096
4096
4096
4096
4096
4096
4096
4096
4096
4096
4096
4096
4096
4096
4096
4096
4096
4096
4096
4096
4096
4096
4096
4096
4096
4096
4096
4096
4096
4096
4096
4096
4096
4096
4096
4096
4096
4096
4096
4096
4096
4096
4096
4096
4096
4096
4096
4096
4096
4096
4096
4096
4096
4096
4096
4096
4096
4096
4096
4096
4096
4096
4096
4096
4096
4096
4096
4096
4096
4096
4096
4096
4096
4096
4096
4096
4096
4096
4096
4096
4096
4096
4096
4096
4096
4096
4096
4096
4096
4096
4096
4096
4096
4096
4096
4096
4096
4096
4096
4096
4096
4096
4096
4096
4096
4096
4096
4096
4096
4096
4096
4096
4096
4096
4096
4096
4096
4096
4096
4096
4096
4096
4096
4096
4096
4096
4096
4096
4096
4096
4096
4096
4096
4096
4096
4096
4096
4096
4096
4096
4096
4096
4096
4096
4096
4096
4096
4096
4096
4096
4096
4096
4096
4096
4096
4096
4096
4096
4096
4096
4096
4096
4096
4096
4096
4096
4096
4096
4096
4096
4096
4096
4096
4096
4096
4096
4096
4096
4096
4096
4096
4096
4096
4096
4096
4096
4096
4096
4096
4096
4096
4096
4096
4096
4096
4096
4096
4096
4096
4096
4096
4096
4096
4096
4096
4096
4096
4096
4096
4096
4096
4096
4096
4096
4096
4096
4096
4096
4096
4096
4096
4096
4096
4096
4096
4096
4096
4096
4096
4096
4096
4096
4096
4096
4096
4096
4096
4096
4096
4096
4096
4096
4096
4096
4096
4096
4096
4096
4096
4096
4096
4096
4096
4096
4096
4096
4096
4096
4096
4096
4096
4096
4096
4096
4096
4096
4096
4096
4096
4096
4096
4096
4096
4096
4096
4096
4096
4096
4096
4096
4096
4096
4096
4096
4096
4096
4096
4096
4096
4096
4096
4096
4096
4096
4096
4096
4096
4096
4096
4096
4096
4096
4096
4096
4096
4096
4096
4096
4096
4096
4096
4096
4096
4096
4096
4096
4096
4096
4096
4096
4096
4096
4096
4096
4096
4096
4096
4096
4096
4096
4096
4096
4096
4096
4096
4096
4096
4096
4096
4096
4096
4096
4096
4096
4096
4096
4096
4096
4096
4096
4096
4096
4096
4096
4096
4096
4096
4096
4096
4096
4096
4096
4096
4096
4096
4096
4096
4096
4096
4096
4096
4096
4096
4096
4096
4096
4096
4096
4096
4096
4096
4096
4096
4096
4096
4096
4096
4096
4096
4096
4096
4096
4096
4096
4096
4096
4096
4096
4096
4096
4096
4096
4096
4096
4096
4096
4096
4096
4096
4096
4096
4096
4096
4096
4096
4096
4096
4096
4096
4096
4096
4096
4096
4096
4096
4096
4096
4096
4096
4096
4096
4096
4096
4096
4096
4096
4096
4096
4096
4096
4096
4096
4096
4096
4096
4096
4096
4096
4096
4096
4096
4096
4096
4096
4096
4096
4096
4096
4096
4096
4096
4096
4096
4096
4096
4096
4096
4096
4096
4096
4096
4096
4096
4096
4096
4096
4096
4096
4096
4096
4096
4096
4096
4096
4096
4096
4096
4096
4096
4096
4096
4096
4096
4096
4096
4096
4096
4096
4096
4096
4096
4096
4096
4096
4096
4096
4096
4096
4096
4096
4096
4096
4096
4096
4096
4096
4096
4096
4096
4096
4096
4096
4096
4096
4096
4096
4096
4096
4096
4096
4096
4096
4096
4096
4096
4096
4096
4096
4096
4096
4096
4096
4096
4096
4096
4096
4096
4096
4096
4096
4096
4096
4096
4096
4096
4096
4096
4096
4096
4096
4096
4096
4096
4096
4096
4096
4096
4096
4096
4096
4096
4096
4096
4096
4096
4096
4096
4096
4096
4096
4096
4096
4096
4096
4096
4096
4096
4096
4096
4096
4096
4096
4096
4096
4096
4096
4096
4096
4096
4096
4096
4096
4096
4096
4096
4096
4096
4096
4096
4096
4096
4096
4096
4096
4096
4096
4096
4096
4096
4096
4096
4096
4096
4096
4096
4096
4096
4096
4096
4096
4096
4096
4096
4096
4096
4096
4096
4096
4096
4096
4096
4096
4096
4096
4096
4096
4096
4096
4096
4096
4096
4096
4096
4096
4096
4096
4096
4096
4096
4096
4096
4096
4096
4096
4096
4096
4096
4096
4096
4096
4096
4096
4096
4096
4096
4096
4096
4096
4096
4096
4096
4096
4096
4096
4096
4096
4096
4096
4096
4096
4096
4096
4096
4096
4096
4096
4096
4096
4096
4096
4096
4096
4096
4096
4096
4096
4096
4096
4096
4096
4096
4096
4096
4096
4096
4096
4096
4096
4096
4096
4096
4096
4096
4096
4096
4096
4096
4096
4096
4096
4096
4096
4096
4096
4096
4096
4096
4096
4096
4096
4096
4096
4096
4096
4096
4096
4096
4096
4096
4096
4096
4096
4096
4096
4096
4096
4096
4096
4096
4096
4096
4096
4096
4096
4096
4096
4096
4096
4096
4096
4096
4096
4096
4096
4096
4096
4096
4096
4096
4096
4096
4096
4096
4096
4096
4096
4096
4096
4096
4096
4096
4096
4096
4096
4096
4096
4096
4096
4096
4096
4096
4096
4096
4096
4096
4096
4096
4096
4096
4096
4096
4096
4096
4096
4096
4096
4096
4096
4096
4096
4096
4096
4096
4096
4096
4096
4096
4096
4096
4096
4096
4096
4096
4096
4096
4096
4096
4096
4096
4096
4096
4096
4096
4096
4096
4096
4096
4096
4096
4096
4096
4096
4096
4096
4096
4096
4096
4096
4096
4096
4096
4096
4096
4096
4096
4096
4096
4096
4096
4096
4096
4096
4096
4096
4096
4096
4096
4096
4096
4096
4096
4096
4096
4096
4096
4096
4096
4096
4096
4096
4096
4096
4096
4096
4096
4096
4096
4096
4096
4096
4096
4096
4096
4096
4096
4096
4096
4096
4096
4096
4096
4096
4096
4096
4096
4096
4096
4096
4096
4096
4096
4096
4096
4096
4096
4096
4096
4096
4096
4096
4096
4096
4096
4096
4096
4096
4096
4096
4096
4096
4096
4096
4096
4096
4096
4096
4096
4096
4096
4096
4096
4096
4096
4096
4096
4096
4096
4096
4096
4096
4096
4096
4096
4096
4096
4096
4096
4096
4096
4096
4096
4096
4096
4096
4096
4096
4096
4096
4096
4096
4096
4096
4096
4096
4096
4096
4096
4096
4096
4096
4096
4096
4096
4096
4096
4096
4096
4096
4096
4096
4096
4096
4096
4096
4096
4096
4096
4096
4096
4096
4096
4096
4096
4096
4096
4096
4096
4096
4096
4096
4096
4096
4096
4096
4096
4096
4096
4096
4096
4096
4096
4096
4096
4096
4096
4096
4096
4096
4096
4096
4096
4096
4096
4096
4096
4096
4096
4096
4096
4096
4096
4096
4096
4096
4096
4096
4096
4096
4096
4096
4096
4096
4096
4096
4096
4096
4096
4096
4096
4096
4096
4096
4096
4096
4096
4096
4096
4096
4096
4096
4096
4096
4096
4096
4096
4096
4096
4096
4096
4096
4096
4096
4096
4096
4096
4096
4096
4096
4096
4096
4096
4096
4096
4096
4096
4096
4096
4096
4096
4096
4096
4096
4096
4096
4096
4096
4096
4096
4096
4096
4096
4096
4096
4096
4096
4096
4096
4096
4096
4096
4096
4096
4096
4096
4096
4096
4096
4096
4096
4096
4096
4096
4096
4096
4096
4096
4096
4096
4096
4096
4096
4096
4096
4096
4096
4096
4096
4096
4096
4096
4096
4096
4096
4096
4096
4096
4096
4096
4096
4096
4096
4096
4096
4096
4096
4096
4096
4096
4096
4096
4096
4096
4096
4096
4096
4096
4096
4096
4096
4096
4096
4096
4096
4096
4096
4096
4096
4096
4096
4096
4096
4096
4096
4096
4096
4096
4096
4096
4096
4096
4096
4096
4096
4096
4096
4096
4096
4096
4096
4096
4096
4096
4096
4096
4096
4096
4096
4096
4096
4096
4096
4096
4096
4096
4096
4096
4096
4096
4096
4096
4096
4096
4096
4096
4096
4096
4096
4096
4096
4096
4096
4096
4096
4096
4096
4096
4096
4096
4096
4096
4096
4096
4096
4096
4096
4096
4096
4096
4096
4096
4096
4096
4096
4096
4096
4096
4096
4096
4096
4096
4096
4096
4096
4096
4096
4096
4096
4096
4096
4096
4096
4096
4096
4096
4096
4096
4096
4096
4096
4096
4096
4096
4096
4096
4096
4096
4096
4096
4096
4096
4096
4096
4096
4096
4096
4096
4096
4096
4096
4096
4096
4096
4096
4096
4096
4096
4096
4096
4096
4096
4096
4096
4096
4096
4096
4096
4096
4096
4096
4096
4096
4096
4096
4096
4096
4096
4096
4096
4096
4096
4096
4096
4096
4096
4096
4096
4096
4096
4096
4096
4096
4096
4096
4096
4096
4096
4096
4096
4096
4096
4096
4096
4096
4096
4096
4096
4096
4096
4096
4096
4096
4096
4096
4096
4096
4096
4096
4096
4096
4096
4096
4096
4096
4096
4096
4096
4096
4096
4096
4096
4096
4096
4096
4096
4096
4096
4096
4096
4096
4096
4096
4096
4096
4096
4096
4096
4096
4096
4096
4096
4096
4096
4096
4096
4096
4096
4096
4096
4096
4096
4096
4096
4096
4096
4096
4096
4096
4096
4096
4096
4096
4096
4096
4096
4096
4096
4096
4096
4096
4096
4096
4096
4096
4096
4096
4096
4096
4096
4096
4096
4096
4096
4096
4096
4096
4096
4096
4096
4096
4096
4096
4096
4096
4096
4096
4096
4096
4096
4096
4096
4096
4096
4096
4096
4096
4096
4096
4096
4096
4096
4096
4096
4096
4096
4096
4096
4096
4096
4096
4096
4096
4096
4096
4096
4096
4096
4096
4096
4096
4096
4096
4096
4096
4096
4096
4096
4096
4096
4096
4096
4096
4096
4096
4096
4096
4096
4096
4096
4096
4096
4096
4096
4096
4096
4096
4096
4096
4096
4096
4096
4096
4096
4096
4096
4096
4096
4096
4096
4096
4096
4096
4096
4096
4096
4096
4096
4096
4096
4096
4096
4096
4096
4096
4096
4096
4096
4096
4096
4096
4096
4096
4096
4096
4096
4096
4096
4096
4096
4096
4096
4096
4096
4096
4096
4096
4096
4096
4096
4096
4096
4096
4096
4096
4096
4096
4096
4096
4096
4096
4096
4096
4096
4096
4096
4096
4096
4096
4096
4096
4096
4096
4096
4096
4096
4096
4096
4096
4096
4096
4096
4096
4096
4096
4096
4096
4096
4096
4096
4096
4096
4096
4096
4096
4096
4096
4096
4096
4096
4096
4096
4096
4096
4096
4096
4096
4096
4096
4096
4096
4096
4096
4096
4096
4096
4096
4096
4096
4096
4096
4096
4096
4096
4096
4096
4096
4096
4096
4096
4096
4096
4096
4096
4096
4096
4096
4096
4096
4096
4096
4096
4096
4096
4096
4096
4096
4096
4096
4096
4096
4096
4096
4096
4096
4096
4096
4096
4096
4096
4096
4096
4096
4096
4096
4096
4096
4096
4096
4096
4096
4096
4096
4096
4096
4096
4096
4096
4096
4096
4096
4096
4096
4096
4096
4096
4096
4096
4096
4096
4096
4096
4096
4096
4096
4096
4096
4096
4096
4096
4096
4096
4096
4096
4096
4096
4096
4096
4096
4096
4096
4096
4096
4096
4096
4096
4096
4096
4096
4096
4096
4096
4096
4096
4096
4096
4096
4096
4096
4096
4096
4096
4096
4096
4096
4096
4096
4096
4096
4096
4096
4096
4096
4096
4096
4096
4096
4096
4096
4096
4096
4096
4096
4096
4096
4096
4096
4096
4096
4096
4096
4096
4096
4096
4096
4096
4096
4096
4096
4096
4096
4096
4096
4096
4096
4096
4096
4096
4096
4096
4096
4096
4096
4096
4096
4096
4096
4096
4096
4096
4096
4096
4096
4096
4096
4096
4096
4096
4096
4096
4096
4096
4096
4096
4096
4096
4096
4096
4096
4096
4096
4096
4096
4096
4096
4096
4096
4096
4096
4096
4096
4096
4096
4096
4096
4096
4096
4096
4096
4096
4096
4096
4096
4096
4096
4096
4096
4096
4096
4096
4096
4096
4096
4096
4096
4096
4096
4096
4096
4096
4096
4096
4096
4096
4096
4096
4096
4096
4096
4096
4096
4096
4096
4096
4096
4096
4096
4096
4096
4096
4096
4096
4096
4096
4096
4096
4096
4096
4096
4096
4096
4096
4096
4096
4096
4096
4096
4096
4096
4096
4096
4096
4096
4096
4096
4096
4096
4096
4096
4096
4096
4096
4096
4096
4096
4096
4096
4096
4096
4096
4096
4096
4096
4096
4096
4096
4096
4096
4096
4096
4096
4096
4096
4096
4096
4096
4096
4096
4096
4096
4096
4096
4096
4096
4096
4096
4096
4096
4096
4096
4096
4096
4096
4096
4096
4096
4096
4096
4096
4096
4096
4096
4096
4096
4096
4096
4096
4096
4096
4096
4096
4096
4096
4096
4096
4096
4096
4096
4096
4096
4096
4096
4096
4096
4096
4096
4096
4096
4096
4096
4096
4096
4096
4096
4096
4096
4096
4096
4096
4096
4096
4096
4096
4096
4096
4096
4096
4096
4096
4096
4096
4096
4096
4096
4096
4096
4096
4096
4096
4096
4096
4096
4096
4096
4096
4096
4096
4096
4096
4096
4096
4096
4096
4096
4096
4096
4096
4096
4096
4096
4096
4096
4096
4096
4096
4096
4096
4096
4096
4096
4096
4096
4096
4096
4096
4096
4096
4096
4096
4096
4096
4096
4096
4096
4096
4096
4096
4096
4096
4096
4096
4096
4096
4096
4096
4096
4096
4096
4096
4096
4096
4096
4096
4096
4096
4096
4096
4096
4096
4096
4096
4096
4096
4096
4096
4096
4096
4096
4096
4096
4096
4096
4096
4096
4096
4096
4096
4096
4096
4096
4096
4096
4096
4096
4096
4096
4096
4096
4096
4096
4096
4096
4096
4096
4096
4096
4096
4096
4096
4096
4096
4096
4096
4096
4096
4096
4096
4096
4096
4096
4096
4096
4096
4096
4096
4096
4096
4096
4096
4096
4096
4096
4096
4096
4096
4096
4096
4096
4096
4096
4096
4096
4096
4096
4096
4096
4096
4096
4096
4096
4096
4096
4096
4096
4096
4096
4096
4096
4096
4096
4096
4096
4096
4096
4096
4096
4096
4096
4096
4096
4096
4096
4096
4096
4096
4096
4096
4096
4096
4096
4096
4096
4096
4096
4096
4096
4096
4096
4096
4096
4096
4096
4096
4096
4096
4096
4096
4096
4096
4096
4096
4096
4096
4096
4096
4096
4096
4096
4096
4096
4096
4096
4096
4096
4096
4096
4096
4096
4096
4096
4096
4096
4096
4096
4096
4096
4096
4096
4096
4096
4096
4096
4096
4096
4096
4096
4096
4096
4096
4096
4096
4096
4096
4096
4096
4096
4096
4096
4096
4096
4096
4096
4096
4096
4096
4096
4096
4096
4096
4096
4096
4096
4096
4096
4096
4096
4096
4096
4096
4096
4096
4096
4096
4096
4096
4096
4096
4096
4096
4096
4096
4096
4096
4096
4096
4096
4096
4096
4096
4096
4096
4096
4096
4096
4096
4096
4096
4096
4096
4096
4096
4096
4096
4096
4096
4096
4096
4096
4096
4096
4096
4096
4096
4096
4096
4096
4096
4096
4096
4096
4096
4096
4096
4096
4096
4096
4096
4096
4096
4096
4096
4096
4096
4096
4096
4096
4096
4096
4096
4096
4096
4096
4096
4096
4096
4096
4096
4096
4096
4096
4096
4096
4096
4096
4096
4096
4096
4096
4096
4096
4096
4096
4096
4096
4096
4096
4096
4096
4096
4096
4096
4096
4096
4096
4096
4096
4096
4096
4096
4096
4096
4096
4096
4096
4096
4096
4096
4096
4096
4096
4096
4096
4096
4096
4096
4096
4096
4096
4096
4096
4096
4096
4096
4096
4096
4096
4096
4096
4096
4096
4096
4096
4096
4096
4096
4096
4096
4096
4096
4096
4096
4096
4096
4096
4096
4096
4096
4096
4096
4096
4096
4096
4096
4096
4096
4096
4096
4096
4096
4096
4096
4096
4096
4096
4096
4096
4096
4096
4096
4096
4096
4096
4096
4096
4096
4096
4096
4096
4096
4096
4096
4096
4096
4096
4096
4096
4096
4096
4096
4096
4096
4096
4096
4096
4096
4096
4096
4096
4096
4096
4096
4096
4096
4096
4096
4096
4096
4096
4096
4096
4096
4096
4096
4096
4096
4096
4096
4096
4096
4096
4096
4096
4096
4096
4096
4096
4096
4096
4096
4096
4096
4096
4096
4096
4096
4096
4096
4096
4096
4096
4096
4096
4096
4096
4096
4096
4096
4096
4096
4096
4096
4096
4096
4096
4096
4096
4096
4096
4096
4096
4096
4096
4096
4096
4096
4096
4096
4096
4096
4096
4096
4096
4096
4096
4096
4096
4096
4096
4096
4096
4096
4096
4096
4096
4096
4096
4096
4096
4096
4096
4096
4096
4096
4096
4096
4096
4096
4096
4096
4096
4096
4096
4096
4096
4096
4096
4096
4096
4096
4096
4096
4096
4096
4096
4096
4096
4096
4096
4096
4096
4096
4096
4096
4096
4096
4096
4096
4096
4096
4096
4096
4096
4096
4096
4096
4096
4096
4096
4096
4096
4096
4096
4096
4096
4096
4096
4096
4096
4096
4096
4096
4096
4096
4096
4096
4096
4096
4096
4096
4096
4096
4096
4096
4096
4096
4096
4096
4096
4096
4096
4096
4096
4096
4096
4096
4096
4096
4096
4096
4096
4096
4096
4096
4096
4096
4096
4096
4096
4096
4096
4096
4096
4096
4096
4096
4096
4096
4096
4096
4096
4096
4096
4096
4096
4096
4096
4096
4096
4096
4096
4096
4096
4096
4096
4096
4096
4096
4096
4096
4096
4096
4096
4096
4096
4096
4096
4096
4096
4096
4096
4096
4096
4096
4096
4096
4096
4096
4096
4096
4096
4096
4096
4096
4096
4096
4096
4096
4096
4096
4096
4096
4096
4096
4096
4096
4096
4096
4096
4096
4096
4096
4096
4096
4096
4096
4096
4096
4096
4096
4096
4096
4096
4096
4096
4096
4096
4096
4096
4096
4096
4096
4096
4096
4096
4096
4096
4096
4096
4096
4096
4096
4096
4096
4096
4096
4096
4096
4096
4096
4096
4096
4096
4096
4096
4096
4096
4096
4096
4096
4096
4096
4096
4096
4096
4096
4096
4096
4096
4096
4096
4096
4096
4096
4096
4096
4096
4096
4096
4096
4096
4096
4096
4096
4096
4096
4096
4096
4096
4096
4096
4096
4096
4096
4096
4096
4096
4096
4096
4096
4096
4096
4096
4096
4096
4096
4096
4096
4096
4096
4096
4096
4096
4096
4096
4096
4096
4096
4096
4096
4096
4096
4096
4096
4096
4096
4096
4096
4096
4096
4096
4096
4096
4096
4096
4096
4096
4096
4096
4096
4096
4096
4096
4096
4096
4096
4096
4096
4096
4096
4096
4096
4096
4096
4096
4096
4096
4096
4096
4096
4096
4096
4096
4096
4096
4096
4096
4096
4096
4096
4096
4096
4096
4096
4096
4096
4096
4096
4096
4096
4096
4096
4096
4096
4096
4096
4096
4096
4096
4096
4096
4096
4096
4096
4096
4096
4096
4096
4096
4096
4096
4096
4096
4096
4096
4096
4096
4096
4096
4096
4096
4096
4096
4096
4096
4096
4096
4096
4096
4096
4096
4096
4096
4096
4096
4096
4096
4096
4096
4096
4096
4096
4096
4096
4096
4096
4096
4096
4096
4096
4096
4096
4096
4096
4096
4096
4096
4096
4096
4096
4096
4096
4096
4096
4096
4096
4096
4096
4096
4096
4096
4096
4096
4096
4096
4096
4096
4096
4096
4096
4096
4096
4096
4096
4096
4096
4096
4096
4096
4096
4096
4096
4096
4096
4096
4096
4096
4096
4096
4096
4096
4096
4096
4096
4096
4096
4096
4096
4096
4096
4096
4096
4096
4096
4096
4096
4096
4096
4096
4096
4096
4096
4096
4096
4096
4096
4096
4096
4096
4096
4096
4096
4096
4096
4096
4096
4096
4096
4096
4096
4096
4096
4096
4096
4096
4096
4096
4096
4096
4096
4096
4096
4096
4096
4096
4096
4096
4096
4096
4096
4096
4096
4096
4096
4096
4096
4096
4096
4096
4096
4096
4096
4096
4096
4096
4096
4096
4096
4096
4096
4096
4096
4096
4096
4096
4096
4096
4096
4096
4096
4096
4096
4096
4096
4096
4096
4096
4096
4096
4096
4096
4096
4096
4096
4096
4096
4096
4096
4096
4096
4096
4096
4096
4096
4096
4096
4096
4096
4096
4096
4096
4096
4096
4096
4096
4096
4096
4096
4096
4096
4096
4096
4096
4096
4096
4096
4096
4096
4096
4096
4096
4096
4096
4096
4096
4096
4096
4096
4096
4096
4096
4096
4096
4096
4096
4096
4096
4096
4096
4096
4096
4096
4096
4096
4096
4096
4096
4096
4096
4096
4096
4096
4096
4096
4096
4096
4096
4096
4096
4096
4096
4096
4096
4096
4096
4096
4096
4096
4096
4096
4096
4096
4096
4096
4096
4096
4096
4096
4096
4096
4096
4096
4096
4096
4096
4096
4096
4096
4096
4096
4096
4096
4096
4096
4096
4096
4096
4096
4096
4096
4096
4096
4096
4096
4096
4096
4096
4096
4096
4096
4096
4096
4096
4096
4096
4096
4096
4096
4096
4096
4096
4096
4096
4096
4096
4096
4096
4096
4096
4096
4096
4096
4096
4096
4096
4096
4096
4096
4096
4096
4096
4096
4096
4096
4096
4096
4096
4096
4096
4096
4096
4096
4096
4096
4096
4096
4096
4096
4096
4096
4096
4096
4096
4096
4096
4096
4096
4096
4096
4096
4096
4096
4096
4096
4096
4096
4096
4096
4096
4096
4096
4096
4096
4096
4096
4096
4096
4096
4096
4096
4096
4096
4096
4096
4096
4096
4096
4096
4096
4096
4096
4096
4096
4096
4096
4096
4096
4096
4096
4096
4096
4096
4096
4096
4096
4096
4096
4096
4096
4096
4096
4096
4096
4096
4096
4096
4096
4096
4096
4096
4096
4096
4096
4096
4096
4096
4096
4096
4096
4096
4096
4096
4096
4096
4096
4096
4096
4096
4096
4096
4096
4096
4096
4096
4096
4096
4096
4096
4096
4096
4096
4096
4096
4096
4096
4096
4096
4096
4096
4096
4096
4096
4096
4096
4096
4096
4096
4096
4096
4096
4096
4096
4096
4096
4096
4096
4096
4096
4096
4096
4096
4096
4096
4096
4096
4096
4096
4096
4096
4096
4096
4096
4096
4096
4096
4096
4096
4096
4096
4096
4096
4096
4096
4096
4096
4096
4096
4096
4096
4096
4096
4096
4096
4096
4096
4096
4096
4096
4096
4096
4096
4096
4096
4096
4096
4096
4096
4096
4096
4096
4096
4096
4096
4096
4096
4096
4096
4096
4096
4096
4096
4096
4096
4096
4096
4096
4096
4096
4096
4096
4096
4096
4096
4096
4096
4096
4096
4096
4096
4096
4096
4096
4096
4096
4096
4096
4096
4096
4096
4096
4096
4096
4096
4096
4096
4096
4096
4096
4096
4096
4096
4096
4096
4096
4096
4096
4096
4096
4096
4096
4096
4096
4096
4096
4096
4096
4096
4096
4096
4096
4096
4096
4096
4096
4096
4096
4096
4096
4096
4096
4096
4096
4096
4096
4096
4096
4096
4096
4096
4096
4096
4096
4096
4096
4096
4096
4096
4096
4096
4096
4096
4096
4096
4096
4096
4096
4096
4096
4096
4096
4096
4096
4096
4096
4096
4096
4096
4096
4096
4096
4096
4096
4096
4096
4096
4096
4096
4096
4096
4096
4096
4096
4096
4096
4096
4096
4096
4096
4096
4096
4096
4096
4096
4096
4096
4096
4096
4096
4096
4096
4096
4096
4096
4096
4096
4096
4096
4096
4096
4096
4096
4096
4096
4096
4096
4096
4096
4096
4096
4096
4096
4096
4096
4096
4096
4096
4096
4096
4096
4096
4096
4096
4096
4096
4096
4096
4096
4096
4096
4096
4096
4096
4096
4096
4096
4096
4096
4096
4096
4096
4096
4096
4096
4096
4096
4096
4096
4096
4096
4096
4096
4096
4096
4096
4096
4096
4096
4096
4096
4096
4096
4096
4096
4096
4096
4096
4096
4096
4096
4096
4096
4096
4096
4096
4096
4096
4096
4096
4096
4096
4096
4096
4096
4096
4096
4096
4096
4096
4096
4096
4096
4096
4096
4096
4096
4096
4096
4096
4096
4096
4096
4096
4096
4096
4096
4096
4096
4096
4096
4096
4096
4096
4096
4096
4096
4096
4096
4096
4096
4096
4096
4096
4096
4096
4096
4096
4096
4096
4096
4096
4096
4096
4096
4096
4096
4096
4096
4096
4096
4096
4096
4096
4096
4096
4096
4096
4096
4096
4096
4096
4096
4096
4096
4096
4096
4096
4096
4096
4096
4096
4096
4096
4096
4096
4096
4096
4096
4096
4096
4096
4096
4096
4096
4096
4096
4096
4096
4096
4096
4096
4096
4096
4096
4096
4096
4096
4096
4096
4096
4096
4096
4096
4096
4096
4096
4096
4096
4096
4096
4096
4096
4096
4096
4096
4096
4096
4096
4096
4096
4096
4096
4096
4096
4096
4096
4096
4096
4096
4096
4096
4096
4096
4096
4096
4096
4096
4096
4096
4096
4096
4096
4096
4096
4096
4096
4096
4096
4096
4096
4096
4096
4096
4096
4096
4096
4096
4096
4096
4096
4096
4096
4096
4096
4096
4096
4096
4096
4096
4096
4096
4096
4096
4096
4096
4096
4096
4096
4096
4096
4096
4096
4096
4096
4096
4096
4096
4096
4096
4096
4096
4096
4096
4096
4096
4096
4096
4096
4096
4096
4096
4096
4096
4096
4096
4096
4096
4096
4096
4096
4096
4096
4096
4096
4096
4096
4096
4096
4096
4096
4096
4096
4096
4096
4096
4096
4096
4096
4096
4096
4096
4096
4096
4096
4096
4096
4096
4096
4096
4096
4096
4096
4096
4096
4096
4096
4096
4096
4096
4096
4096
4096
4096
4096
4096
4096
4096
4096
4096
4096
4096
4096
4096
4096
4096
4096
4096
4096
4096
4096
4096
4096
4096
4096
4096
4096
4096
4096
4096
4096
4096
4096
4096
4096
4096
4096
4096
4096
4096
4096
4096
4096
4096
4096
4096
4096
4096
4096
4096
4096
4096
4096
4096
4096
4096
4096
4096
4096
4096
4096
4096
4096
4096
4096
4096
4096
4096
4096
4096
4096
4096
4096
4096
4096
4096
4096
4096
4096
4096
4096
4096
4096
4096
4096
4096
4096
4096
4096
4096
4096
4096
4096
4096
4096
4096
4096
4096
4096
4096
4096
4096
4096
4096
4096
4096
4096
4096
4096
4096
4096
4096
4096
4096
4096
4096
4096
4096
4096
4096
4096
4096
4096
4096
4096
4096
4096
4096
4096
4096
4096
4096
4096
4096
4096
4096
4096
4096
4096
4096
4096
4096
4096
4096
4096
4096
4096
4096
4096
4096
4096
4096
4096
4096
4096
4096
4096
4096
4096
4096
4096
4096
4096
4096
4096
4096
4096
4096
4096
4096
4096
4096
4096
4096
4096
4096
4096
4096
4096
4096
4096
4096
4096
4096
4096
4096
4096
4096
4096
4096
4096
4096
4096
4096
4096
4096
4096
4096
4096
4096
4096
4096
4096
4096
4096
4096
4096
4096
4096
4096
4096
4096
4096
4096
4096
4096
4096
4096
4096
4096
4096
4096
4096
4096
4096
4096
4096
4096
4096
4096
4096
4096
4096
4096
4096
4096
4096
4096
4096
4096
4096
4096
4096
4096
4096
4096
4096
4096
4096
4096
4096
4096
4096
4096
4096
4096
4096
4096
4096
4096
4096
4096
4096
4096
4096
4096
4096
4096
4096
4096
4096
4096
4096
4096
4096
4096
4096
4096
4096
4096
4096
4096
4096
4096
4096
4096
4096
4096
4096
4096
4096
4096
4096
4096
4096
4096
4096
4096
4096
4096
4096
4096
4096
4096
4096
4096
4096
4096
4096
4096
4096
4096
4096
4096
4096
4096
4096
4096
4096
4096
4096
4096
4096
4096
4096
4096
4096
4096
4096
4096
4096
4096
4096
4096
4096
4096
4096
4096
4096
4096
4096
4096
4096
4096
4096
4096
4096>;
};
