/* Copyright (c) 2019-2020, The Linux Foundation. All rights reserved.
 *
 * This program is free software; you can redistribute it and/or modify
 * it under the terms of the GNU General Public License version 2 and
 * only version 2 as published by the Free Software Foundation.
 *
 * This program is distributed in the hope that it will be useful,
 * but WITHOUT ANY WARRANTY; without even the implied warranty of
 * MERCHANTABILITY or FITNESS FOR A PARTICULAR PURPOSE.  See the
 * GNU General Public License for more details.
 */
&mdss_mdp {
	mot_csot_vtdr6115_gt9916_667_1080x2400_dsc_vid: qcom,mdss_dsi_mot_csot_vtdr6115_gt9916_667_1080x2400_dsc_vid {
		qcom,mdss-dsi-panel-name = "mipi_mot_vid_csot_vtdr6115_1080p_dsc_667";
		qcom,mdss-dsi-panel-supplier = "csot";
		qcom,mdss-dsi-panel-type = "dsi_video_mode";
		qcom,mdss-dsi-panel-physical-type = "oled";
		qcom,mdss-dsi-virtual-channel-id = <0>;
		qcom,mdss-dsi-stream = <0>;
		qcom,mdss-dsi-bpp = <24>;
		qcom,mdss-dsi-underflow-color = <0xff>;
		qcom,mdss-dsi-border-color = <0>;
		qcom,dsi-ctrl-num = <0>;
		qcom,dsi-phy-num = <0>;
		qcom,mdss-pan-physical-width-dimension = <69>;
		qcom,mdss-pan-physical-height-dimension = <154>;

		qcom,mdss-dsi-traffic-mode = "non_burst_sync_event";
		qcom,mdss-dsi-bllp-eof-power-mode;
		qcom,mdss-dsi-bllp-power-mode;
		qcom,mdss-dsi-lane-0-state;
		qcom,mdss-dsi-lane-1-state;
		qcom,mdss-dsi-lane-2-state;
		qcom,mdss-dsi-lane-3-state;
		qcom,mdss-dsi-dma-trigger = "trigger_sw";
		qcom,mdss-dsi-mdp-trigger = "none";
		qcom,mdss-dsi-reset-sequence = <1 10>, <0 10>, <1 20>;
		qcom,mdss-dsi-display-timings {
			timing@0 {
				cell-index = <0>;
				qcom,mdss-dsi-panel-framerate = <120>;
				qcom,mdss-dsi-panel-width = <1080>;
				qcom,mdss-dsi-panel-height = <2400>;
				qcom,mdss-dsi-h-front-porch = <24>;
				qcom,mdss-dsi-h-back-porch = <20>;
				qcom,mdss-dsi-h-pulse-width = <4>;
				qcom,mdss-dsi-h-sync-skew = <0>;
				qcom,mdss-dsi-v-back-porch = <8>;
				qcom,mdss-dsi-v-front-porch = <516>;
				qcom,mdss-dsi-v-pulse-width = <4>;
				qcom,mdss-dsi-h-left-border = <0>;
				qcom,mdss-dsi-h-right-border = <0>;
				qcom,mdss-dsi-v-top-border = <0>;
				qcom,mdss-dsi-v-bottom-border = <0>;

				qcom,mdss-dsi-on-command = [
					39 01 00 00 00 00 02 03 01
					39 01 00 00 00 00 02 53 20
					39 01 00 00 00 00 03 51 0D BA
					39 01 00 00 00 00 02 6F 01
					39 01 00 00 00 00 02 35 00
					39 01 00 00 00 00 02 59 09
					39 01 00 00 00 00 02 6C 01
					39 01 00 00 00 00 03 F0 AA 10
					39 01 00 00 00 00 17 D0 84 15 50 14 20 00 39 05 1D 0B 00 00 05 2F 0B 00 00 1b 05 05 1D 1D
					39 01 00 00 00 00 03 FF 5A 12
					39 01 00 00 00 00 02 65 10
					39 01 00 00 00 00 02 D9 41
					39 01 00 00 00 00 03 F0 AA 13
					39 01 00 00 00 00 07 C5 02 D6 02 AF 03 72
					39 01 00 00 00 00 03 FF 5A 80
					39 01 00 00 00 00 02 65 0a
					39 01 00 00 00 00 02 F9 A8
					39 01 00 00 00 00 03 FF 5A 81
					39 01 00 00 00 00 02 65 03
					39 01 00 00 00 00 02 F4 03
					39 01 00 00 00 00 02 65 08
					39 01 00 00 00 00 03 F6 51 44
					05 01 00 00 78 00 01 11
					39 01 00 00 00 00 03 FF 5A 12
					39 01 00 00 00 00 02 65 10
					39 01 00 00 00 00 02 D9 0B
					39 01 00 00 00 00 03 FF 5A 81
					39 01 00 00 00 00 02 F3 08
					39 01 00 00 00 00 03 FF 5A 00
					39 01 00 00 00 00 03 F0 AA 00
					05 01 00 00 14 00 01 29
				];

				qcom,mdss-dsi-off-command = [
					05 01 00 00 14 00 01 28
					05 01 00 00 78 00 01 10];
				qcom,mdss-dsi-on-command-state = "dsi_lp_mode";
				qcom,mdss-dsi-off-command-state = "dsi_hs_mode";
				qcom,mdss-dsi-h-sync-pulse = <0>;
				qcom,compression-mode = "dsc";
				qcom,mdss-dsc-slice-height = <12>;
				qcom,mdss-dsc-slice-width = <540>;
				qcom,mdss-dsc-slice-per-pkt = <2>;
				qcom,mdss-dsc-bit-per-component = <8>;
				qcom,mdss-dsc-bit-per-pixel = <8>;
				qcom,mdss-dsc-block-prediction-enable;

				qcom,mdss-dsi-dfps-60-command = [
					39 00 00 00 00 00 02 6C 00
					39 01 00 00 00 00 02 62 00];
				qcom,mdss-dsi-dfps-60-command-state = "dsi_hs_mode";

				qcom,mdss-dsi-dfps-90-command = [
					39 00 00 00 00 00 02 6c 01
					39 00 00 00 00 00 02 62 01
					39 00 00 00 00 00 03 F0 AA 10
					39 01 00 00 00 00 0E B1 01 57 00 0C 0D 74 00 01 57 00 0C 05 D4];
				qcom,mdss-dsi-dfps-90-command-state = "dsi_hs_mode";

				qcom,mdss-dsi-dfps-120-command = [
					39 00 00 00 00 00 02 6c 01
					39 00 00 00 00 00 02 62 00
					39 00 00 00 00 00 03 F0 AA 10
					39 01 00 00 00 00 0E B1 01 57 00 0C 0D 74 00 01 57 00 0C 02 04];
				qcom,mdss-dsi-dfps-120-command-state = "dsi_hs_mode";
			};
		};
	};
};
