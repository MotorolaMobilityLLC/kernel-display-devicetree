/* Copyright (c) 2019-2021, The Linux Foundation. All rights reserved.
 *
 * This program is free software; you can redistribute it and/or modify
 * it under the terms of the GNU General Public License version 2 and
 * only version 2 as published by the Free Software Foundation.
 *
 * This program is distributed in the hope that it will be useful,
 * but WITHOUT ANY WARRANTY; without even the implied warranty of
 * MERCHANTABILITY or FITNESS FOR A PARTICULAR PURPOSE.  See the
 * GNU General Public License for more details.
 */
&mdss_mdp {
	mot_tianma_nt37703_655_1080x2400_dsc_vid_144hz: qcom,mdss_dsi_mot_tianma_nt37703_655_1080x2400_dsc_vid_144hz {
		qcom,mdss-dsi-panel-name = "mipi_mot_vid_tianma_1080p_dsc_655_144hz";
		qcom,mdss-dsi-panel-supplier = "tianma";
		qcom,mdss-dsi-panel-type = "dsi_video_mode";
		qcom,mdss-dsi-panel-physical-type = "oled";
		qcom,dsi-ctrl-num = <0>;
		qcom,dsi-phy-num = <0>;
		qcom,mdss-dsi-virtual-channel-id = <0>;
		qcom,mdss-dsi-stream = <0>;
		qcom,mdss-pan-physical-width-dimension = <68>;
		qcom,mdss-pan-physical-height-dimension = <152>;
		qcom,mdss-dsi-bpp = <30>;
		qcom,mdss-dsi-underflow-color = <0xff>;
		qcom,mdss-dsi-border-color = <0>;

		qcom,mdss-dsi-traffic-mode = "non_burst_sync_event";
		qcom,mdss-dsi-bllp-eof-power-mode;
		qcom,mdss-dsi-bllp-power-mode;
		qcom,mdss-dsi-lp11-init;
		qcom,mdss-dsi-lane-0-state;
		qcom,mdss-dsi-lane-1-state;
		qcom,mdss-dsi-lane-2-state;
		qcom,mdss-dsi-lane-3-state;
		qcom,mdss-dsi-dma-trigger = "trigger_sw";
		qcom,mdss-dsi-mdp-trigger = "none";
		qcom,mdss-dsi-reset-sequence = <1 1>, <0 1>, <1 10>;


		qcom,bklt-dcs-2bytes-enabled;
		qcom,mdss-dsi-bl-min-level = <1>;
		qcom,mdss-dsi-bl-max-level = <4095>;
		qcom,mdss-dsi-bl-pmic-control-type = "bl_ctrl_dcs";

		qcom,mdss-dsi-panel-hdr-enabled;
		qcom,mdss-dsi-panel-hdr-color-primaries = <14500 15500 32000
			        17000 15500 30000 8000 3000>;
		qcom,mdss-dsi-panel-peak-brightness = <4200000>;

		qcom,mdss-dsi-panel-blackness-level = <3230>;

		qcom,mdss-dsi-dc-off-command = [
				39 01 00 00 00 00 03 8B 00 00];
		qcom,mdss-dsi-dc-off-command-state = "dsi_hs_mode";
		qcom,mdss-dsi-dc-on-command = [
				39 01 00 00 00 00 03 8B 00 81];
		qcom,mdss-dsi-dc-on-command-state = "dsi_hs_mode";

		qcom,mdss-dsi-hbm-on-command = [
				39 00 00 40 00 00 02 87 20
				39 00 00 40 00 00 02 6F 09
				39 01 00 00 00 00 03 51 8F FF];
		qcom,mdss-dsi-hbm-on-command-state = "dsi_hs_mode";

		qcom,mdss-dsi-hbm-off-command = [
				39 00 00 40 00 00 02 87 20
				39 01 00 00 00 00 02 6F 09
				39 01 00 00 00 00 03 51 00 00];
		qcom,mdss-dsi-hbm-off-command-state = "dsi_hs_mode";

		qcom,mdss-dsi-hbm-fod;
		qcom,mdss-dsi-hbm-fod-on-command = [
				39 00 00 40 00 00 02 87 20
				39 00 00 40 00 00 02 6F 09
				39 01 00 00 00 00 03 51 8F FF];
		qcom,mdss-dsi-hbm-fod-on-command-state = "dsi_hs_mode";

		qcom,mdss-dsi-display-timings {
			timing@0 {
				cell-index = <0>;
				qcom,mdss-dsi-panel-framerate = <60>;
				qcom,mdss-dsi-panel-width = <1080>;
				qcom,mdss-dsi-panel-height = <2400>;
				qcom,mdss-dsi-h-front-porch = <16>;
				qcom,mdss-dsi-h-back-porch = <16>;
				qcom,mdss-dsi-h-pulse-width = <4>;
				qcom,mdss-dsi-h-sync-skew = <0>;
				qcom,mdss-dsi-v-back-porch = <14>;
				qcom,mdss-dsi-v-front-porch = <3488>;
				qcom,mdss-dsi-v-pulse-width = <2>;
				qcom,mdss-dsi-h-left-border = <0>;
				qcom,mdss-dsi-h-right-border = <0>;
				qcom,mdss-dsi-v-top-border = <0>;
				qcom,mdss-dsi-v-bottom-border = <0>;

				qcom,mdss-dsi-on-command = [
					39 01 00 00 00 00 05 2A 00 00 04 37
					39 01 00 00 00 00 05 2B 00 00 09 5F
					39 01 00 00 00 00 03 90 03 03
					39 01 00 00 00 00 13 91 AB 28 00 14 D2 00 02 25 01 D5 00 07 05 7A 05 16 10 F0
					39 01 00 00 00 00 02 53 20
					39 01 00 00 00 00 11 3B 00 10 00 2C 00 10 00 2C 00 10 00 2C 00 10 00 2C
					39 01 00 00 00 00 05 FF AA 55 A5 80
					39 01 00 00 00 00 02 6F 15
					39 01 00 00 00 00 03 F8 01 E1
					39 01 00 00 00 00 06 F0 55 AA 52 08 04
					39 01 00 00 00 00 02 C0 20
					39 01 00 00 00 00 05 FF AA 55 A5 80
					39 01 00 00 00 00 02 6F 17
					39 01 00 00 00 00 02 F4 02
					39 01 00 00 00 00 05 FF AA 55 A5 81
					39 01 00 00 00 00 02 6F 13
					39 01 00 00 00 00 02 F9 01
					39 01 00 00 00 00 05 FF AA 55 A5 81
					39 01 00 00 00 00 02 6F 3C
					39 01 00 00 00 00 02 F5 87
					39 01 00 00 00 00 02 35 00
					39 01 00 00 00 00 02 0A 9C
					39 01 00 00 00 00 03 51 0D BA
					39 01 00 00 00 00 28 A9 01 00 2F 00 00 02 02 00 E4 02 03 05 99 02 00 C0 0E 0E 07 02 00 C0 03 03 31 02 00 C0 2E 2F 14 26 02 00 C0 30 31 01 42
					05 01 00 00 78 00 01 11
					05 01 00 00 00 00 01 29
				];

				qcom,mdss-dsi-off-command = [
					05 01 00 00 00 00 01 28
					05 01 00 00 78 00 01 10];
				qcom,mdss-dsi-on-command-state = "dsi_lp_mode";
				qcom,mdss-dsi-off-command-state = "dsi_lp_mode";
				qcom,mdss-dsi-h-sync-pulse = <0>;
				qcom,compression-mode = "dsc";
				qcom,mdss-dsc-slice-height = <20>;
				qcom,mdss-dsc-slice-width = <540>;
				qcom,mdss-dsc-slice-per-pkt = <2>;
				qcom,mdss-dsc-bit-per-component = <10>;
				qcom,mdss-dsc-bit-per-pixel = <8>;
				qcom,mdss-dsc-block-prediction-enable;
/*
				qcom,mdss-dsi-dfps-48-command = [
						39 00 00 40 00 00 02 6C 00
						39 00 00 40 00 00 02 62 00
						39 00 00 40 00 00 03 F0 AA 10
						39 00 00 40 00 00 07 B1 01 98 00 0C 0E 7C
						39 00 00 40 00 00 03 F0 AA 13
						39 00 00 40 00 00 09 C8 10 90 10 42 13 0E 00 29
						39 00 00 40 00 00 21 CB 17 E8 16 78 15 B0 14 48 11 98 0C 18 01 E4 00 28 00 28 00 28 00 28 00 28 00 28 00 28 00 28 00 28
						39 00 00 40 00 00 03 F0 AA 1B
						39 01 00 00 00 00 10 C0 00 07 0B 03 09 05 0D 01 08 0C 04 0A 06 0E 02];
				qcom,mdss-dsi-dfps-48-command-state = "dsi_lp_mode";
*/
				qcom,mdss-dsi-dfps-60-command = [
						39 01 00 00 00 00 28 A9 01 00 2F 00 00 02 02 00 E4 02 03 05 99 02 00 C0 0E 0E 07 02 00 C0 03 03 31 02 00 C0 2E 2F 14 26 02 00 C0 30 31 01 42];
				qcom,mdss-dsi-dfps-60-command-state = "dsi_hs_mode";

				qcom,mdss-dsi-dfps-90-command = [
						39 01 00 00 00 00 28 A9 01 00 2F 00 00 02 02 00 E4 02 03 02 65 02 00 C0 0E 0E 03 02 00 C0 03 03 21 02 00 C0 2E 2F 13 26 02 00 C0 30 31 01 32];
				qcom,mdss-dsi-dfps-90-command-state = "dsi_hs_mode";

				qcom,mdss-dsi-dfps-120-command = [
						39 00 00 40 00 00 06 F0 55 AA 52 08 00
						39 01 00 00 00 00 02 2F 01];
				qcom,mdss-dsi-dfps-120-command-state = "dsi_hs_mode";

				qcom,mdss-dsi-dfps-144-command = [
						39 00 00 40 00 00 06 F0 55 AA 52 08 00
						39 01 00 00 00 00 02 2F 00];
				qcom,mdss-dsi-dfps-144-command-state = "dsi_hs_mode";
			};
		};
	};
};
