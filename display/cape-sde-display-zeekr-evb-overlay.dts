/dts-v1/;
/plugin/;

#include "cape-sde-display-zeekr-common.dtsi"

/ {
	model = "zeekr";
	compatible = "qcom,cape-mtp", "qcom,cape", "qcom,mtp", "moto,zeekr";
	qcom,msm-id = <530 0x10000>, <531 0x10000>, <540 0x10000>;
	qcom,board-id = <0x4B 0x9100>;
};
