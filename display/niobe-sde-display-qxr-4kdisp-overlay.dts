/dts-v1/;
/plugin/;

#include "niobe-sde-display-idp-4kdisp.dtsi"

/ {
	model = "Qualcomm Technologies, Inc. Niobe QXR";
	compatible = "qcom,niobe-qxr", "qcom,niobe", "qcom,qxr";
	qcom,msm-id = <652 0x10000>;
	qcom,board-id = <0x10026 0>;
};
