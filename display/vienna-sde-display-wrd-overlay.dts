// SPDX-License-Identifier: BSD-3-Clause
/*
 * Copyright (c) Qualcomm Technologies, Inc. and/or its subsidiaries.
 */

/dts-v1/;
/plugin/;

#include "vienna-sde-display.dtsi"
#include "vienna-sde-display-wrd.dtsi"

/ {
	model = "Qualcomm Technologies, Inc. Vienna WRD";
	compatible = "qcom,vienna-wrd", "qcom,vienna", "qcom,wrd";
	qcom,msm-id = <669 0x10000>, <670 0x10000>;
	qcom,board-id = <0x1002d 0x0>, <0x1002d 0x01>, <0x2002d 0x0>;
};
