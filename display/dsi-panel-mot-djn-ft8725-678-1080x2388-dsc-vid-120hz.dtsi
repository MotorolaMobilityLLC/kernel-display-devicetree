&mdss_mdp {
	mot_djn_ft8725_678_1080x2388_dsc_vid_120hz: qcom,mdss_dsi_mot_djn_ft8725_678_1080x2388_dsc_120hz_vid_fhd {
		qcom,mdss-dsi-panel-name = "mipi_moto_vid_djn_1080p_dsc_678_120hz";
		qcom,mdss-dsi-panel-type = "dsi_video_mode";
		qcom,mdss-dsi-panel-physical-type = "lcd";
		qcom,dsi-ctrl-num = <0>;
		qcom,dsi-phy-num = <0>;
		qcom,mdss-dsi-virtual-channel-id = <0>;
		qcom,mdss-dsi-stream = <0>;
		qcom,mdss-dsi-bpp = <24>;
		qcom,mdss-dsi-underflow-color = <0xff>;
		qcom,mdss-dsi-border-color = <0>;
		qcom,mdss-dsi-traffic-mode = "non_burst_sync_event";
		qcom,mdss-dsi-bllp-power-mode;
		qcom,mdss-dsi-bllp-eof-power-mode;
		qcom,mdss-dsi-lane-0-state;
		qcom,mdss-dsi-lane-1-state;
		qcom,mdss-dsi-lane-2-state;
		qcom,mdss-dsi-lane-3-state;
		qcom,mdss-dsi-lp11-init;
		qcom,mdss-dsi-dma-trigger = "trigger_sw";
		qcom,mdss-dsi-mdp-trigger = "none";
		qcom,mdss-dsi-reset-sequence = <1 4>, <0 1>, <1 11>;
		qcom,mdss-pan-physical-width-dimension = <71>;
		qcom,mdss-pan-physical-height-dimension = <157>;
		//qcom,mdss-dsi-panel-hdr-enabled;
		//qcom,mdss-dsi-panel-hdr-color-primaries = <15000 16000 33750
		//				 15800 13250 34450 7500 3000>;
		//qcom,mdss-dsi-panel-peak-brightness = <6450000>;
		//qcom,mdss-dsi-panel-blackness-level = <4961>;

		qcom,mdss-dsi-cabc-mv-command = [15 01 00 00 00 00 02 55 03];
		qcom,mdss-dsi-cabc-mv-command-state =  "dsi_hs_mode";
		qcom,mdss-dsi-cabc-ui-command = [15 01 00 00 00 00 02 55 01];
		qcom,mdss-dsi-cabc-ui-command-state =  "dsi_hs_mode";
		qcom,mdss-dsi-cabc-dis-command = [15 01 00 00 00 00 02 55 00];
		qcom,mdss-dsi-cabc-dis-command-state =  "dsi_hs_mode";

		qcom,mdss-dsi-display-timings {
			timing@0 {
				cell-index = <0>;
				qcom,mdss-dsi-panel-width = <1080>;
				qcom,mdss-dsi-panel-height = <2388>;
				qcom,mdss-dsi-h-front-porch = <70>;
				qcom,mdss-dsi-h-back-porch = <56>;
				qcom,mdss-dsi-h-pulse-width = <8>;
				qcom,mdss-dsi-h-sync-skew = <0>;
				qcom,mdss-dsi-v-back-porch = <20>;
				qcom,mdss-dsi-v-front-porch = <10>;
				qcom,mdss-dsi-v-pulse-width = <10>;
				qcom,mdss-dsi-panel-framerate = <120>;
				qcom,mdss-dsi-h-left-border = <0>;
				qcom,mdss-dsi-h-right-border = <0>;
				qcom,mdss-dsi-v-top-border = <0>;
				qcom,mdss-dsi-v-bottom-border = <0>;
				qcom,mdss-dsi-on-command = [
					15 01 00 00 00 00 02 00 00
					39 01 00 00 00 00 04 ff 87 25 01
					15 01 00 00 00 00 02 00 80
					39 01 00 00 00 00 03 ff 87 25
					15 01 00 00 00 00 02 00 b0
					39 01 00 00 00 00 0f b4 00 0c 02 00 01 1f 00 07 08 bb 08 7a 10 f0
					39 01 00 00 00 00 03 51 ff 0f
					15 01 00 00 00 00 02 53 2c
					15 01 00 00 00 00 02 55 01
					15 01 00 00 00 00 02 35 00
					15 01 00 00 00 00 02 00 80
					39 01 00 00 00 00 0D CA ED D6 C5 B8 AD A4 9D 96 90 8C 87 83
					15 01 00 00 00 00 02 00 90
					39 01 00 00 00 00 0A CA FE D6 13 FC D6 CC FA D6 8E
					15 01 00 00 00 00 02 00 B0
					39 01 00 00 00 00 04 CA 05 05 0B
					15 01 00 00 00 00 02 00 A0
					39 01 00 00 00 00 04 CA 06 06 06
					15 01 00 00 00 00 02 00 8A
					39 01 00 00 00 00 05 C0 10 10 10 04
					15 01 00 00 00 00 02 00 FC
					39 01 00 00 00 00 03 C0 00 14
					15 01 00 00 00 00 02 00 C1
					39 01 00 00 00 00 03 C5 00 00
					15 01 00 00 00 00 02 00 C4
					39 01 00 00 00 00 04 C5 FF FF FF
					15 01 00 00 00 00 02 00 00
					39 01 00 00 00 00 04 FF FF FF FF

					05 01 00 00 5A 00 02 11 00
					05 01 00 00 05 00 02 29 00
				];
				qcom,mdss-dsi-on-command-state = "dsi_lp_mode";
				qcom,mdss-dsi-off-command = [
					/*S88528AA1-5111,huangxinglue.wt,mod,20240204,improve suspend sequence*/
					05 01 00 00 14 00 01 28
					05 01 00 00 64 00 01 10
					15 01 00 00 00 00 02 00 00
					39 01 00 00 00 00 05 f7 5A A5 95 27
				];
				qcom,mdss-dsi-off-command-state = "dsi_lp_mode";
				qcom,compression-mode = "dsc";
				qcom,mdss-dsc-slice-height = <12>;
				qcom,mdss-dsc-slice-width = <540>;
				qcom,mdss-dsc-slice-per-pkt = <2>;
				qcom,mdss-dsc-bit-per-component = <8>;
				qcom,mdss-dsc-bit-per-pixel = <8>;
				qcom,mdss-dsc-block-prediction-enable;
			};
		};
	};
};
