/dts-v1/;
/plugin/;

#include "crow-sde-display-rumi.dtsi"

/ {
	model = "Qualcomm Technologies, Inc. Crow RUMI";
	compatible = "qcom,crow-rumi", "qcom,crow", "qcom,rumi";
	qcom,msm-id = <608 0x10000>;
	qcom,board-id = <15 0>;
};
