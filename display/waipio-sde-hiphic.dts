/dts-v1/;
/plugin/;

#include "waipio-sde.dtsi"

/ {
	qcom,msm-id = <457 0x10000>, <482 0x10000>, <457 0x20000>, <482 0x20000>, <552 0x10000>;
	qcom,board-id = <0 0>;
};

/* Can not do delete-property in overlay dtsi, have to add cap-sde-hiphic file */
&sde_dp {
	/delete-property/ qcom,mst-enable;
};